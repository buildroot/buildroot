## board/opendingux/lepus/linux_defconfig
```kconfig
CONFIG_LOCALVERSION="-opendingux"
# CONFIG_LOCALVERSION_AUTO is not set
CONFIG_KERNEL_ZSTD=y
CONFIG_DEFAULT_INIT="/mininit-syspart"
CONFIG_SYSVIPC=y
CONFIG_NO_HZ_IDLE=y
CONFIG_HIGH_RES_TIMERS=y
CONFIG_PREEMPT_VOLUNTARY=y
CONFIG_LD_DEAD_CODE_DATA_ELIMINATION=y
CONFIG_EMBEDDED=y
CONFIG_PROFILING=y
CONFIG_MACH_INGENIC_SOC=y
CONFIG_JZ4760_RS97=y
CONFIG_ZBOOT_LOAD_ADDRESS=0x81000000
CONFIG_HZ_24=y
CONFIG_MIPS_O32_FP64_SUPPORT=y
CONFIG_MIPS_RAW_APPENDED_DTB=y
CONFIG_CPU_FREQ=y
CONFIG_CPU_FREQ_DEFAULT_GOV_USERSPACE=y
CONFIG_CPUFREQ_DT=y
CONFIG_JUMP_LABEL=y
# CONFIG_SECCOMP is not set
CONFIG_MODULES=y
CONFIG_MODULE_UNLOAD=y
CONFIG_TRIM_UNUSED_KSYMS=y
# CONFIG_MQ_IOSCHED_DEADLINE is not set
# CONFIG_MQ_IOSCHED_KYBER is not set
CONFIG_CMA=y
CONFIG_NET=y
CONFIG_PACKET=y
CONFIG_UNIX=y
CONFIG_INET=y
# CONFIG_WIRELESS is not set
CONFIG_DEVTMPFS=y
CONFIG_DEVTMPFS_MOUNT=y
CONFIG_BLK_DEV_LOOP=y
CONFIG_BLK_DEV_LOOP_MIN_COUNT=0
CONFIG_SCSI=m
CONFIG_BLK_DEV_SD=m
# CONFIG_BLK_DEV_BSG is not set
CONFIG_NETDEVICES=y
# CONFIG_ETHERNET is not set
# CONFIG_WLAN is not set
CONFIG_INPUT_EVDEV=y
# CONFIG_KEYBOARD_ATKBD is not set
CONFIG_KEYBOARD_GPIO=y
# CONFIG_INPUT_MOUSE is not set
CONFIG_INPUT_MISC=y
CONFIG_INPUT_UINPUT=y
CONFIG_INPUT_PWM_VIBRA=y
# CONFIG_SERIO is not set
CONFIG_SERIAL_8250=y
# CONFIG_SERIAL_8250_DEPRECATED_OPTIONS is not set
CONFIG_SERIAL_8250_CONSOLE=y
CONFIG_SERIAL_8250_INGENIC=y
CONFIG_HW_RANDOM=y
# CONFIG_DEVMEM is not set
CONFIG_SPI=y
CONFIG_SPI_GPIO=y
CONFIG_BATTERY_INGENIC=y
# CONFIG_HWMON is not set
CONFIG_THERMAL=y
CONFIG_WATCHDOG=y
CONFIG_JZ4740_WDT=y
CONFIG_REGULATOR=y
CONFIG_REGULATOR_FIXED_VOLTAGE=y
CONFIG_DRM=y
CONFIG_DRM_PANEL_AUO_A030JTN01=y
CONFIG_DRM_PANEL_ABT_Y030XX067A=y
CONFIG_DRM_PANEL_SIMPLE=y
CONFIG_DRM_PANEL_INNOLUX_EJ030NA=y
CONFIG_DRM_INGENIC=y
CONFIG_DRM_INGENIC_IPU=y
CONFIG_FB=y
CONFIG_BACKLIGHT_CLASS_DEVICE=y
CONFIG_BACKLIGHT_PWM=y
# CONFIG_VGA_CONSOLE is not set
CONFIG_FRAMEBUFFER_CONSOLE=y
CONFIG_LOGO=y
# CONFIG_LOGO_LINUX_MONO is not set
# CONFIG_LOGO_LINUX_VGA16 is not set
CONFIG_SOUND=y
CONFIG_SND=y
# CONFIG_SND_PCM_TIMER is not set
# CONFIG_SND_SUPPORT_OLD_API is not set
# CONFIG_SND_PROC_FS is not set
# CONFIG_SND_SPI is not set
# CONFIG_SND_MIPS is not set
CONFIG_SND_SOC=y
CONFIG_SND_JZ4740_SOC_I2S=y
CONFIG_SND_SOC_JZ4760_CODEC=y
CONFIG_SND_SOC_SIMPLE_AMPLIFIER=y
CONFIG_SND_SIMPLE_CARD=y
CONFIG_HID_ZEROPLUS=m
CONFIG_ZEROPLUS_FF=y
CONFIG_USB_CONN_GPIO=y
CONFIG_USB_MUSB_HDRC=y
CONFIG_USB_MUSB_JZ4740=y
CONFIG_USB_INVENTRA_DMA=y
CONFIG_USB_GADGET=y
CONFIG_USB_GADGET_VBUS_DRAW=500
CONFIG_USB_CONFIGFS=y
CONFIG_USB_CONFIGFS_ECM=y
CONFIG_USB_CONFIGFS_RNDIS=y
CONFIG_USB_CONFIGFS_F_FS=y
CONFIG_MMC=y
# CONFIG_PWRSEQ_EMMC is not set
# CONFIG_PWRSEQ_SIMPLE is not set
CONFIG_MMC_JZ4740=y
CONFIG_NEW_LEDS=y
CONFIG_LEDS_CLASS=y
CONFIG_LEDS_GPIO=y
CONFIG_LEDS_TRIGGERS=y
CONFIG_LEDS_TRIGGER_TIMER=y
CONFIG_LEDS_TRIGGER_DEFAULT_ON=y
CONFIG_LEDS_TRIGGER_PANIC=y
CONFIG_RTC_CLASS=y
# CONFIG_RTC_NVMEM is not set
CONFIG_RTC_DRV_JZ4740=y
CONFIG_DMADEVICES=y
CONFIG_DMA_JZ4780=y
# CONFIG_VIRTIO_MENU is not set
CONFIG_INGENIC_OST=y
# CONFIG_IOMMU_SUPPORT is not set
CONFIG_REMOTEPROC=y
CONFIG_INGENIC_VPU_RPROC=m
CONFIG_IIO=y
CONFIG_IIO_BUFFER_CB=y
CONFIG_INGENIC_ADC=y
CONFIG_IIO_RESCALE=y
CONFIG_PWM=y
CONFIG_PWM_JZ4740=y
CONFIG_PHY_INGENIC_USB=y
CONFIG_EXT4_FS=m
# CONFIG_EXT4_USE_FOR_EXT2 is not set
CONFIG_F2FS_FS=m
# CONFIG_F2FS_STAT_FS is not set
# CONFIG_F2FS_FS_XATTR is not set
CONFIG_F2FS_FS_COMPRESSION=y
# CONFIG_F2FS_FS_LZO is not set
# CONFIG_F2FS_FS_LZ4 is not set
# CONFIG_DNOTIFY is not set
CONFIG_VFAT_FS=y
CONFIG_EXFAT_FS=m
CONFIG_TMPFS=y
CONFIG_SQUASHFS=y
CONFIG_SQUASHFS_FILE_DIRECT=y
CONFIG_SQUASHFS_ZSTD=y
# CONFIG_NETWORK_FILESYSTEMS is not set
CONFIG_NLS_CODEPAGE_437=y
CONFIG_NLS_ISO8859_1=y
CONFIG_NLS_UTF8=y
CONFIG_KEYS=y
CONFIG_LSM="lockdown,yama,loadpin,safesetid,integrity"
CONFIG_CRYPTO_RSA=m
CONFIG_CRYPTO_CCM=m
CONFIG_CRYPTO_GCM=m
CONFIG_CRYPTO_ECHAINIV=m
CONFIG_CRYPTO_CMAC=m
CONFIG_CRYPTO_AES=m
# CONFIG_CRYPTO_HW is not set
CONFIG_ASYMMETRIC_KEY_TYPE=y
CONFIG_ASYMMETRIC_PUBLIC_KEY_SUBTYPE=m
CONFIG_X509_CERTIFICATE_PARSER=m
CONFIG_PKCS7_MESSAGE_PARSER=m
CONFIG_SYSTEM_TRUSTED_KEYRING=y
CONFIG_DMA_CMA=y
CONFIG_FONTS=y
CONFIG_FONT_6x10=y
CONFIG_DEBUG_FS=y
```

## board/opendingux/package/bennugd/Config.in
```kconfig
config BR2_PACKAGE_BENNUGD
	bool "bennugd"
	select BR2_PACKAGE_ZLIB
	select BR2_PACKAGE_LIBPNG
	select BR2_PACKAGE_SDL
	select BR2_PACKAGE_SDL_MIXER
	select BR2_PACKAGE_OPENSSL
	help
	  - Bennu Game Development -
	  Game development framework.
	
	  Used by Streets of Rage Remake v5a and King of Fighters.

	  http://www.bennugd.org
```

## board/opendingux/package/fonts-droid/Config.in
```kconfig
config BR2_PACKAGE_FONTS_DROID
	bool "fonts-droid"
	help
	  Android (AOSP) "droid" family of fonts
```

## board/opendingux/package/gcwconnect/Config.in
```kconfig
config BR2_PACKAGE_GCWCONNECT
	bool "gcwconnect"
	depends on BR2_PACKAGE_PYTHON3
	select BR2_PACKAGE_PYTHON_URLLIB3
	select BR2_PACKAGE_PYTHON_PYGAME
	select BR2_PACKAGE_PYTHON_PYGAME_FONT
	select BR2_PACKAGE_WLAN_SCAN
	select BR2_PACKAGE_HOST_DOS2UNIX
	help
	  Wireless configuration tool for OpenDingux
```

## board/opendingux/package/gl4es/Config.in
```kconfig
config BR2_PACKAGE_GL4ES
	bool "gl4es"
	depends on BR2_PACKAGE_HAS_LIBGLES
	depends on !BR2_PACKAGE_MESA3D_OPENGL_GLX
	select BR2_PACKAGE_MESA3D_INSTALL_GL_HEADERS
	select BR2_PACKAGE_HAS_LIBGL
	help
	  OpenGL-over-ES compatibility layer.

	  https://github.com/ptitSeb/gl4es

config BR2_PACKAGE_PROVIDES_LIBGL
	default "gl4es" if BR2_PACKAGE_GL4ES

comment "gl4es requires Mesa3D without GLX"
	depends on !BR2_PACKAGE_MESA3D || BR2_PACKAGE_MESA3D_OPENGL_GLX
```

## board/opendingux/package/gmenu2x/Config.in
```kconfig
config BR2_PACKAGE_GMENU2X
	bool "gmenu2x"
	select BR2_PACKAGE_LIBPNG
	select BR2_PACKAGE_SDL
	select BR2_PACKAGE_SDL_TTF
	select BR2_PACKAGE_SDL_GFX
	select BR2_PACKAGE_DEJAVU
	help
	  Application menu for devices with a 320x240 screen and buttons.

	  This is a forked version with cleanups, targeted at the Ben NanoNote
	  and the Dingoo A320/A330.

	  http://projects.qi-hardware.com/index.php/p/gmenu2x

if BR2_PACKAGE_GMENU2X

config BR2_PACKAGE_GMENU2X_PLATFORM
	string "Target platform"

config BR2_PACKAGE_GMENU2X_SHOW_CLOCK
	bool "Show clock"

config BR2_PACKAGE_GMENU2X_CPUFREQ
	bool "Support CPU frequency control"

endif
```

## board/opendingux/package/kmsgrab/Config.in
```kconfig
config BR2_PACKAGE_KMSGRAB
	bool "kmsgrab"
	depends on BR2_TOOLCHAIN_HAS_THREADS # libdrm
	select BR2_PACKAGE_LIBDRM
	select BR2_PACKAGE_LIBPNG
	help
	  A simple screenshot tool for DRM/KMS.

	  https://github.com/opendingux/kmsgrab
```

## board/opendingux/package/libhugetlbfs/Config.in
```kconfig
config BR2_PACKAGE_LIBHUGETLBFS
	bool "libhugetlbfs"
	help
	  Library for easy use of Linux hugetlbfs (huge pages of RAM).

	  https://github.com/libhugetlbfs/libhugetlbfs
```

## board/opendingux/package/libini/Config.in
```kconfig
config BR2_PACKAGE_LIBINI
	bool "libini"
	help
	  Tiny library to help reading INI files.

	  https://github.com/pcercuei/libini
```

## board/opendingux/package/libjpeg8/Config.in
```kconfig
config BR2_PACKAGE_LIBJPEG8
	bool "libjpeg8"
	help
	  Old version of libjpeg for binary backwards compatibility.
```

## board/opendingux/package/libmikmod/Config.in
```kconfig
config BR2_PACKAGE_LIBMIKMOD
	bool "libmikmod"
	help
	  Mikmod is a module player and library supporting many formats,
	  including mod, s3m, it, and xm.

	  https://sourceforge.net/projects/mikmod/
```

## board/opendingux/package/libopk/Config.in
```kconfig
config BR2_PACKAGE_LIBOPK
        bool "libopk"
        select BR2_PACKAGE_ZLIB
        select BR2_PACKAGE_LIBINI
        help
          Library to handle OPK packages.

          https://github.com/pcercuei/libopk
```
