## board/bcm/bcm7250_defconfig
```kconfig
# CONFIG_BCM7145A0 is not set
CONFIG_BCM7250B0=y
# CONFIG_BCM7145 is not set
CONFIG_BCM7250=y
# Not sure if that below GENET part is needed by all 7439 family
# Will save below to separate file for specified platform, if not.
CONFIG_BRCM_GENET_V4=y
CONFIG_BRCM_GENET_VERSION=4

# CONFIG_DETECT_HUNG_TASK is not set
CONFIG_SMP=n

CONFIG_USB_VIDEO_CLASS=y
CONFIG_USB_VIDEO_CLASS_INPUT_EVDEV=y

CONFIG_SND_USB_AUDIO=y
CONFIG_WATCHDOG=y
CONFIG_WATCHDOG_CORE=y
# CONFIG_SOFT_WATCHDOG is not set
CONFIG_BCM7038_WDT=y
CONFIG_MAGIC_SYSRQ=n
```

## board/bcm/bcm72604_defconfig
```kconfig
CONFIG_KERNEL_LZ4=y
CONFIG_SYSVIPC=y
CONFIG_POSIX_MQUEUE=y
CONFIG_FHANDLE=y
CONFIG_NO_HZ=y
CONFIG_HIGH_RES_TIMERS=y
CONFIG_IRQ_TIME_ACCOUNTING=y
CONFIG_LOG_BUF_SHIFT=16
CONFIG_CGROUPS=y
CONFIG_CGROUP_DEBUG=y
CONFIG_CGROUP_FREEZER=y
CONFIG_CGROUP_DEVICE=y
CONFIG_CPUSETS=y
CONFIG_CGROUP_CPUACCT=y
CONFIG_CGROUP_SCHED=y
CONFIG_BLK_CGROUP=y
CONFIG_NAMESPACES=y
CONFIG_USER_NS=y
CONFIG_RELAY=y
CONFIG_BLK_DEV_INITRD=y
# CONFIG_RD_GZIP is not set
# CONFIG_RD_BZIP2 is not set
# CONFIG_RD_LZMA is not set
# CONFIG_RD_XZ is not set
# CONFIG_RD_LZO is not set
CONFIG_EMBEDDED=y
CONFIG_PERF_EVENTS=y
CONFIG_SLAB=y
CONFIG_MODULES=y
CONFIG_MODULE_FORCE_LOAD=y
CONFIG_MODULE_UNLOAD=y
CONFIG_MODVERSIONS=y
CONFIG_PARTITION_ADVANCED=y
CONFIG_ARCH_BCM=y
CONFIG_ARCH_BRCMSTB=y
CONFIG_ARM_LPAE=y
# CONFIG_VDSO is not set
CONFIG_PCI=y
CONFIG_PCI_MSI=y
CONFIG_PCIEPORTBUS=y
# CONFIG_PCIEAER is not set
CONFIG_SMP=y
CONFIG_ARM_PSCI=y
CONFIG_HZ_1000=y
CONFIG_AEABI=y
CONFIG_HIGHMEM=y
CONFIG_HIGHPTE=y
CONFIG_SPARSEMEM_MANUAL=y
CONFIG_CMA=y
CONFIG_ARM_APPENDED_DTB=y
CONFIG_ARM_ATAG_DTB_COMPAT=y
CONFIG_CPU_FREQ=y
CONFIG_CPU_FREQ_GOV_POWERSAVE=y
CONFIG_CPU_FREQ_GOV_USERSPACE=y
CONFIG_CPU_FREQ_GOV_ONDEMAND=y
CONFIG_CPU_FREQ_GOV_CONSERVATIVE=y
CONFIG_CPUFREQ_DT=y
CONFIG_ARM_BRCMSTB_AVS_CPUFREQ=y
CONFIG_CPU_IDLE=y
CONFIG_VFP=y
CONFIG_NEON=y
CONFIG_NET=y
CONFIG_PACKET=y
CONFIG_UNIX=y
CONFIG_INET=y
CONFIG_IP_MULTICAST=y
CONFIG_IP_PNP=y
CONFIG_IP_PNP_DHCP=y
CONFIG_IP_PNP_BOOTP=y
CONFIG_IP_PNP_RARP=y
CONFIG_NET_IPIP=y
CONFIG_SYN_COOKIES=y
# CONFIG_INET_XFRM_MODE_TRANSPORT is not set
# CONFIG_INET_XFRM_MODE_TUNNEL is not set
# CONFIG_INET_XFRM_MODE_BEET is not set
# CONFIG_INET_LRO is not set
CONFIG_IPV6=y
CONFIG_IPV6_SIT_6RD=y
CONFIG_NETFILTER=y
CONFIG_NF_CONNTRACK=y
CONFIG_NF_CONNTRACK_FTP=y
CONFIG_NF_CONNTRACK_H323=y
CONFIG_NF_CONNTRACK_SNMP=y
CONFIG_NF_CONNTRACK_SIP=y
CONFIG_NF_CONNTRACK_TFTP=y
CONFIG_NETFILTER_XT_TARGET_DSCP=y
CONFIG_NETFILTER_XT_TARGET_MARK=y
CONFIG_NETFILTER_XT_TARGET_TCPMSS=y
CONFIG_NETFILTER_XT_MATCH_CONNMARK=y
CONFIG_NETFILTER_XT_MATCH_CONNTRACK=y
CONFIG_NETFILTER_XT_MATCH_DSCP=y
CONFIG_NETFILTER_XT_MATCH_MAC=y
CONFIG_NETFILTER_XT_MATCH_STATE=y
CONFIG_NETFILTER_XT_MATCH_TCPMSS=y
CONFIG_NF_CONNTRACK_IPV4=y
CONFIG_IP_NF_IPTABLES=y
CONFIG_IP_NF_FILTER=y
CONFIG_IP_NF_TARGET_REJECT=y
CONFIG_IP_NF_NAT=y
CONFIG_IP_NF_TARGET_MASQUERADE=y
CONFIG_IP_NF_TARGET_REDIRECT=y
CONFIG_IP_NF_MANGLE=y
CONFIG_IP_NF_TARGET_ECN=y
CONFIG_IP_NF_ARPTABLES=y
CONFIG_IP6_NF_IPTABLES=y
CONFIG_IP6_NF_FILTER=y
CONFIG_IP6_NF_MANGLE=y
CONFIG_BT=y
CONFIG_BT_RFCOMM=y
CONFIG_BT_RFCOMM_TTY=y
CONFIG_BT_BNEP=y
CONFIG_BT_BNEP_MC_FILTER=y
CONFIG_BT_BNEP_PROTO_FILTER=y
CONFIG_BT_HIDP=y
CONFIG_BT_HCIBTUSB=y
CONFIG_CFG80211=y
CONFIG_UEVENT_HELPER_PATH="/sbin/hotplug"
CONFIG_DEVTMPFS=y
CONFIG_DEVTMPFS_MOUNT=y
CONFIG_DMA_CMA=y
CONFIG_CMA_ALIGNMENT=9
CONFIG_CONNECTOR=y
CONFIG_MTD=y
CONFIG_MTD_CMDLINE_PARTS=y
CONFIG_MTD_BLOCK=y
CONFIG_MTD_CFI=y
CONFIG_MTD_JEDECPROBE=y
CONFIG_MTD_CFI_INTELEXT=y
CONFIG_MTD_CFI_AMDSTD=y
CONFIG_MTD_CFI_STAA=y
CONFIG_MTD_ROM=y
CONFIG_MTD_ABSENT=y
CONFIG_MTD_PHYSMAP_OF=y
CONFIG_MTD_M25P80=y
CONFIG_MTD_NAND=y
CONFIG_MTD_NAND_BRCMNAND=y
CONFIG_MTD_SPI_NOR=y
# CONFIG_MTD_SPI_NOR_USE_4K_SECTORS is not set
CONFIG_MTD_UBI=y
CONFIG_MTD_UBI_GLUEBI=y
CONFIG_BLK_DEV_LOOP=y
CONFIG_BLK_DEV_RAM=y
CONFIG_BLK_DEV_RAM_SIZE=8192
CONFIG_EEPROM_93CX6=y
CONFIG_BLK_DEV_SD=y
CONFIG_BLK_DEV_SR=y
CONFIG_CHR_DEV_SG=y
CONFIG_ATA=y
CONFIG_SATA_AHCI_PLATFORM=y
CONFIG_AHCI_BRCMSTB=y
CONFIG_NETDEVICES=y
# CONFIG_NET_VENDOR_ADAPTEC is not set
# CONFIG_NET_VENDOR_ALTEON is not set
# CONFIG_NET_VENDOR_AMD is not set
# CONFIG_NET_VENDOR_ARC is not set
# CONFIG_NET_VENDOR_ATHEROS is not set
# CONFIG_NET_CADENCE is not set
CONFIG_BCMGENET=y
CONFIG_SYSTEMPORT=y
# CONFIG_NET_VENDOR_BROCADE is not set
# CONFIG_NET_VENDOR_CHELSIO is not set
# CONFIG_NET_VENDOR_CIRRUS is not set
# CONFIG_NET_VENDOR_CISCO is not set
# CONFIG_NET_VENDOR_DEC is not set
# CONFIG_NET_VENDOR_DLINK is not set
# CONFIG_NET_VENDOR_EMULEX is not set
# CONFIG_NET_VENDOR_EXAR is not set
# CONFIG_NET_VENDOR_FARADAY is not set
# CONFIG_NET_VENDOR_HP is not set
CONFIG_E1000E=y
# CONFIG_NET_VENDOR_MARVELL is not set
# CONFIG_NET_VENDOR_MELLANOX is not set
# CONFIG_NET_VENDOR_MICREL is not set
# CONFIG_NET_VENDOR_MICROCHIP is not set
# CONFIG_NET_VENDOR_MYRI is not set
# CONFIG_NET_VENDOR_NATSEMI is not set
# CONFIG_NET_VENDOR_NVIDIA is not set
# CONFIG_NET_VENDOR_OKI is not set
# CONFIG_NET_PACKET_ENGINE is not set
# CONFIG_NET_VENDOR_QLOGIC is not set
# CONFIG_NET_VENDOR_REALTEK is not set
# CONFIG_NET_VENDOR_RDC is not set
# CONFIG_NET_VENDOR_SEEQ is not set
# CONFIG_NET_VENDOR_SILAN is not set
# CONFIG_NET_VENDOR_SIS is not set
# CONFIG_NET_VENDOR_SMSC is not set
# CONFIG_NET_VENDOR_STMICRO is not set
# CONFIG_NET_VENDOR_SUN is not set
# CONFIG_NET_VENDOR_TEHUTI is not set
# CONFIG_NET_VENDOR_TI is not set
# CONFIG_NET_VENDOR_VIA is not set
# CONFIG_NET_VENDOR_WIZNET is not set
CONFIG_BRCMFMAC=y
CONFIG_BRCMFMAC_PCIE=y
CONFIG_INPUT_EVDEV=y
CONFIG_INPUT_MISC=y
CONFIG_INPUT_UINPUT=y
# CONFIG_SERIO_SERPORT is not set
CONFIG_VT_HW_CONSOLE_BINDING=y
# CONFIG_LEGACY_PTYS is not set
CONFIG_SERIAL_8250=y
CONFIG_SERIAL_8250_CONSOLE=y
CONFIG_SERIAL_8250_DW=y
CONFIG_SERIAL_OF_PLATFORM=y
CONFIG_HW_RANDOM=y
CONFIG_I2C=y
CONFIG_SPI=y
CONFIG_SPI_BITBANG=y
CONFIG_GPIOLIB=y
CONFIG_GPIO_SYSFS=y
CONFIG_POWER_SUPPLY=y
CONFIG_POWER_RESET=y
# CONFIG_HWMON is not set
CONFIG_THERMAL=y
CONFIG_THERMAL_DEFAULT_GOV_USER_SPACE=y
CONFIG_THERMAL_GOV_STEP_WISE=y
CONFIG_INTEL_POWERCLAMP=y
CONFIG_BRCMSTB_THERMAL=y
CONFIG_MFD_SYSCON=y
CONFIG_REGULATOR=y
CONFIG_REGULATOR_FIXED_VOLTAGE=y
# CONFIG_VGA_ARB is not set
CONFIG_SOUND=y
CONFIG_SND=y
CONFIG_SND_SOC=y
CONFIG_USB=y
CONFIG_USB_MON=y
CONFIG_USB_XHCI_HCD=y
CONFIG_USB_EHCI_HCD=y
CONFIG_USB_OHCI_HCD=y
CONFIG_USB_STORAGE=y
CONFIG_USB_GADGET=y
CONFIG_USB_BDC_UDC=y
CONFIG_USB_MASS_STORAGE=y
CONFIG_MMC=y
CONFIG_MMC_BLOCK_MINORS=16
CONFIG_MMC_SDHCI=y
CONFIG_MMC_SDHCI_PLTFM=y
CONFIG_RTC_CLASS=y
# CONFIG_IOMMU_SUPPORT is not set
CONFIG_BRCMSTB_BMEM=y
CONFIG_BRCMSTB_CMA=y
CONFIG_BRCMSTB_SRPD=y
CONFIG_BRCMSTB_NEXUS_API=y
CONFIG_RESET_CONTROLLER=y
CONFIG_PHY_BRCMSTB_SATA=y
CONFIG_EXT4_FS=y
CONFIG_FANOTIFY=y
CONFIG_MSDOS_FS=y
CONFIG_VFAT_FS=y
CONFIG_TMPFS=y
CONFIG_NFS_FS=y
CONFIG_NFS_V3_ACL=y
CONFIG_NFS_V4=y
CONFIG_NFS_V4_1=y
CONFIG_NFS_V4_2=y
CONFIG_ROOT_NFS=y
CONFIG_NLS_DEFAULT="utf8"
CONFIG_NLS_CODEPAGE_437=y
CONFIG_NLS_CODEPAGE_850=y
CONFIG_NLS_ASCII=y
CONFIG_NLS_ISO8859_1=y
CONFIG_NLS_ISO8859_15=y
CONFIG_NLS_UTF8=y
CONFIG_DYNAMIC_DEBUG=y
CONFIG_DEBUG_INFO=y
CONFIG_DEBUG_INFO_REDUCED=y
CONFIG_DEBUG_FS=y
CONFIG_MAGIC_SYSRQ=y
CONFIG_LOCKUP_DETECTOR=y
# CONFIG_CRYPTO_ANSI_CPRNG is not set
# CONFIG_CRYPTO_HW is not set
CONFIG_ARM_CRYPTO=y
CONFIG_CRYPTO_SHA1_ARM=y
CONFIG_CRYPTO_SHA256_ARM=y
CONFIG_CRYPTO_AES_ARM=y
CONFIG_CRC_CCITT=y
```

## board/bcm/bcm74371A0_defconfig
```kconfig
#
# A convenient place to add config options, nothing more.
#

# CPU Core family selection

# CONFIG_BCM7145A0 is not set
CONFIG_BCM74371A0=y
# CONFIG_BCM7145 is not set
CONFIG_BCM74371=y
# Not sure if that below GENET part is needed by all 7439 family
# Will save below to separate file for specified platform, if not.
CONFIG_BRCM_GENET_V4=y
CONFIG_BRCM_GENET_VERSION=4

# CONFIG_LEGACY_PTYS is not set

#
# Debug Lockups and Hangs
#
CONFIG_LOCKUP_DETECTOR=y
# CONFIG_BOOTPARAM_SOFTLOCKUP_PANIC is not set
CONFIG_BOOTPARAM_SOFTLOCKUP_PANIC_VALUE=0
# CONFIG_DETECT_HUNG_TASK is not set
# CONFIG_PANIC_ON_OOPS is not set
CONFIG_PANIC_ON_OOPS_VALUE=0
CONFIG_PANIC_TIMEOUT=0
CONFIG_SCHED_DEBUG=y
# CONFIG_SCHEDSTATS is not set
# CONFIG_TIMER_STATS is not set
```

## board/beagleboard/beaglev_fire/beaglev_fire.its
```
// SPDX-License-Identifier: (GPL-2.0+ OR MIT)
/*
 * Flattened Image Tree file for BVF
 *
 * Copyright (C) 2024 Microchip Technology Inc. and its subsidiaries.
 *
 */

/dts-v1/;

/ {
	description = "U-Boot fitImage for the BeagleV-Fire";
	#address-cells = <2>;

		images {
			kernel {
				description = "Linux kernel";
				data = /incbin/("./Image.gz");
				type = "kernel";
				arch = "riscv";
				os = "linux";
				compression = "gzip";
				load = <0x80200000>;
				entry = <0x80200000>;
				hash-1 {
					algo = "sha256";
				};
			};
			base_fdt {
				description = "Flattened Device Tree blob";
				data = /incbin/("./mpfs-beaglev-fire.dtb");
				type = "flat_dt";
				arch = "riscv";
				compression = "none";
				load = <0x8a000000>;
				hash-1 {
					algo = "sha256";
				};
			};
		};

		configurations {
			default = "kernel_dtb";
			kernel_dtb {
				description = "1 Linux kernel, FDT blob";
				kernel = "kernel";
				fdt = "base_fdt";
			};

			base_dtb {
				description = "Base FDT blob for BeagleV-Fire board";
				fdt = "base_fdt";
			};
		};
};
```

## board/digilent/zybo/fit.its
```
/dts-v1/;
/ {
	description = "Simple image with single Linux kernel and FDT blob";
	#address-cells = <1>;
	images {
		kernel@1 {
			description = "Linux Kernel";
			data = /incbin/("./zImage");
			type = "kernel";
			arch = "arm";
			os = "linux";
			compression = "none";
			load = <0x8000>;
			entry = <0x8000>;
			hash@1 {
				algo = "crc32";
			};
			hash@2 {
				algo = "sha1";
			};
		};
		fdt@1 {
			description = "Flattened Device Tree blob";
			data = /incbin/("./zynq-zybo.dtb");
			type = "flat_dt";
			arch = "arm";
			compression = "none";
			hash@1 {
				algo = "crc32";
			};
			hash@2 {
				algo = "sha1";
			};
		};
		ramdisk@1 {
		    description = "Root FS";
		    data = /incbin/("./rootfs.cpio.gz");
		    type = "ramdisk";
		    os = "linux";
		    arch = "arm";
		    compression = "gzip";
			hash@1 {
				algo = "crc32";
			};
			hash@2 {
				algo = "sha1";
			};
	    };
	};
	configurations {
		default = "conf@1";
		conf@1 {
			description = "Boot zynq kernel";
			kernel = "kernel@1";
			fdt = "fdt@1";
            ramdisk = "ramdisk@1";
		};
	};
};
```

## board/microchip/mpfs_icicle/mpfs_icicle.its
```
// SPDX-License-Identifier: (GPL-2.0+ OR MIT)
/*
 * Flattened Image Tree file for Icicle Kit
 *
 */

/dts-v1/;

/ {
	description = "U-Boot fitImage for the MPFS";
	address-cells = <1>;

		images {
			kernel {
				description = "Linux kernel";
				data = /incbin/("./Image");
				type = "kernel";
				arch = "riscv";
				os = "linux";
				compression = "none";
				load = <0x80200000>;
				entry = <0x80200000>;
				hash-1 {
					algo = "sha256";
				};
			};
			base_fdt {
				description = "Flattened Device Tree blob";
				data = /incbin/("./mpfs-icicle-kit.dtb");
				type = "flat_dt";
				arch = "riscv";
				compression = "none";
				load = <0x8a000000>;
				hash-1 {
					algo = "sha256";
				};
			};
		};

		configurations {
			default = "kernel_dtb";
			kernel_dtb {
				description = "1 Linux kernel, FDT blob";
				kernel = "kernel";
				fdt = "base_fdt";
			};

			base_dtb {
				description = "Base FDT blob for MPFS Icicle board";
				fdt = "base_fdt";
			};
		};
};
```

## board/opendingux/Config.in
```kconfig
menu "OpenDingux packages"

	source "$BR2_EXTERNAL_OPENDINGUX_PATH/package/gmenu2x/Config.in"
	source "$BR2_EXTERNAL_OPENDINGUX_PATH/package/libhugetlbfs/Config.in"
	source "$BR2_EXTERNAL_OPENDINGUX_PATH/package/libini/Config.in"
	source "$BR2_EXTERNAL_OPENDINGUX_PATH/package/libjpeg8/Config.in"
	source "$BR2_EXTERNAL_OPENDINGUX_PATH/package/libmikmod/Config.in"
	source "$BR2_EXTERNAL_OPENDINGUX_PATH/package/libopk/Config.in"
	source "$BR2_EXTERNAL_OPENDINGUX_PATH/package/libpng14/Config.in"
	source "$BR2_EXTERNAL_OPENDINGUX_PATH/package/libshake/Config.in"
	source "$BR2_EXTERNAL_OPENDINGUX_PATH/package/libxdgmime/Config.in"
	source "$BR2_EXTERNAL_OPENDINGUX_PATH/package/love2d/Config.in"
	source "$BR2_EXTERNAL_OPENDINGUX_PATH/package/mininit/Config.in"
	source "$BR2_EXTERNAL_OPENDINGUX_PATH/package/odbootd/Config.in"
	source "$BR2_EXTERNAL_OPENDINGUX_PATH/package/od-passwd-config/Config.in"
	source "$BR2_EXTERNAL_OPENDINGUX_PATH/package/pwswd/Config.in"
	source "$BR2_EXTERNAL_OPENDINGUX_PATH/package/salsad/Config.in"
	source "$BR2_EXTERNAL_OPENDINGUX_PATH/package/ubiboot/Config.in"
	source "$BR2_EXTERNAL_OPENDINGUX_PATH/package/unlockvt/Config.in"
	source "$BR2_EXTERNAL_OPENDINGUX_PATH/package/wlan-scan/Config.in"

endmenu
```

## board/opendingux/boot/ubiboot/Config.in
```kconfig
config BR2_TARGET_UBIBOOT
	bool "UBIBoot"
	help
	  UBIBoot is a very small and simple bootloader for
	  Ingenic JZ47xx based boards, which is able to start
	  a Linux kernel located on a UBI partition.

if BR2_TARGET_UBIBOOT
config BR2_TARGET_UBIBOOT_BOARDNAME
	string "UBIBoot board name"
	help
	  One of UBIBoot supported boards to be built.
	  This will be suffixed with _config to meet UbiBoot
	  standard naming.
endif
```
