## board/synaptics/linux-4.1-defconfig
```kconfig
# CONFIG_LOCALVERSION_AUTO is not set
# CONFIG_SWAP is not set
CONFIG_SYSVIPC=y
CONFIG_POSIX_MQUEUE=y
CONFIG_FHANDLE=y
CONFIG_AUDIT=y
CONFIG_NO_HZ_IDLE=y
CONFIG_HIGH_RES_TIMERS=y
CONFIG_BSD_PROCESS_ACCT=y
CONFIG_BSD_PROCESS_ACCT_V3=y
CONFIG_TASKSTATS=y
CONFIG_TASK_DELAY_ACCT=y
CONFIG_TASK_XACCT=y
CONFIG_TASK_IO_ACCOUNTING=y
CONFIG_LOG_BUF_SHIFT=14
CONFIG_CGROUPS=y
CONFIG_MEMCG=y
CONFIG_MEMCG_KMEM=y
CONFIG_CGROUP_HUGETLB=y
CONFIG_CGROUP_SCHED=y
CONFIG_NAMESPACES=y
# CONFIG_UTS_NS is not set
# CONFIG_IPC_NS is not set
# CONFIG_NET_NS is not set
CONFIG_BLK_DEV_INITRD=y
# CONFIG_RD_BZIP2 is not set
CONFIG_EXPERT=y
# CONFIG_SGETMASK_SYSCALL is not set
# CONFIG_PCI_QUIRKS is not set
# CONFIG_COMPAT_BRK is not set
CONFIG_PROFILING=y
CONFIG_JUMP_LABEL=y
CONFIG_MODULES=y
CONFIG_MODULE_UNLOAD=y
# CONFIG_IOSCHED_CFQ is not set
CONFIG_SMP=y
CONFIG_NR_CPUS=2
# CONFIG_SCHED_MC is not set
CONFIG_PREEMPT=y
CONFIG_KSM=y
CONFIG_TRANSPARENT_HUGEPAGE=y
CONFIG_TRANSPARENT_HUGEPAGE_MADVISE=y
CONFIG_CMA=y
# CONFIG_SECCOMP is not set
# CONFIG_ACPI is not set
CONFIG_CPU_FREQ=y
CONFIG_CPU_FREQ_DEFAULT_GOV_USERSPACE=y
CONFIG_CPU_IDLE=y
# CONFIG_CPU_IDLE_GOV_LADDER is not set
# CONFIG_CORE_DUMP_DEFAULT_ELF_HEADERS is not set
CONFIG_NET=y
CONFIG_PACKET=y
CONFIG_UNIX=y
CONFIG_INET=y
CONFIG_IP_PNP=y
CONFIG_IP_PNP_DHCP=y
CONFIG_IP_PNP_BOOTP=y
# CONFIG_INET_LRO is not set
CONFIG_IPV6=y
# CONFIG_ANDROID_PARANOID_NETWORK is not set
CONFIG_BPF_JIT=y
CONFIG_BT=y
CONFIG_BT_RFCOMM=y
CONFIG_BT_RFCOMM_TTY=y
CONFIG_BT_BNEP=y
CONFIG_BT_BNEP_MC_FILTER=y
CONFIG_BT_BNEP_PROTO_FILTER=y
CONFIG_BT_HIDP=y
CONFIG_CFG80211=y
# CONFIG_CFG80211_DEFAULT_PS is not set
CONFIG_CFG80211_INTERNAL_REGDB=y
CONFIG_CFG80211_WEXT=y
CONFIG_MAC80211=y
CONFIG_RFKILL=y
CONFIG_DEVTMPFS=y
CONFIG_DEVTMPFS_MOUNT=y
CONFIG_DMA_CMA=y
CONFIG_CMA_SIZE_MBYTES=16
CONFIG_MTD=y
CONFIG_MTD_BLOCK=y
CONFIG_MTD_NAND=y
CONFIG_BLK_DEV_LOOP=y
CONFIG_FLASH_TS=y
CONFIG_SCSI=y
# CONFIG_SCSI_PROC_FS is not set
CONFIG_BLK_DEV_SD=y
# CONFIG_SCSI_LOWLEVEL is not set
CONFIG_NETDEVICES=y
CONFIG_TUN=y
# CONFIG_NET_VENDOR_3COM is not set
# CONFIG_NET_VENDOR_ADAPTEC is not set
# CONFIG_NET_VENDOR_AGERE is not set
# CONFIG_NET_VENDOR_ALTEON is not set
# CONFIG_NET_VENDOR_AMD is not set
# CONFIG_NET_VENDOR_ARC is not set
# CONFIG_NET_VENDOR_ATHEROS is not set
# CONFIG_NET_CADENCE is not set
# CONFIG_NET_VENDOR_BROADCOM is not set
# CONFIG_NET_VENDOR_BROCADE is not set
# CONFIG_NET_VENDOR_CHELSIO is not set
# CONFIG_NET_VENDOR_CISCO is not set
# CONFIG_NET_VENDOR_DEC is not set
# CONFIG_NET_VENDOR_DLINK is not set
# CONFIG_NET_VENDOR_EMULEX is not set
# CONFIG_NET_VENDOR_EXAR is not set
# CONFIG_NET_VENDOR_HP is not set
# CONFIG_NET_VENDOR_INTEL is not set
# CONFIG_NET_VENDOR_MARVELL is not set
# CONFIG_NET_VENDOR_MELLANOX is not set
# CONFIG_NET_VENDOR_MICREL is not set
# CONFIG_NET_VENDOR_MYRI is not set
# CONFIG_NET_VENDOR_NATSEMI is not set
# CONFIG_NET_VENDOR_NVIDIA is not set
# CONFIG_NET_VENDOR_OKI is not set
# CONFIG_NET_PACKET_ENGINE is not set
# CONFIG_NET_VENDOR_QLOGIC is not set
# CONFIG_NET_VENDOR_QUALCOMM is not set
# CONFIG_NET_VENDOR_REALTEK is not set
# CONFIG_NET_VENDOR_RDC is not set
# CONFIG_NET_VENDOR_ROCKER is not set
# CONFIG_NET_VENDOR_SAMSUNG is not set
# CONFIG_NET_VENDOR_SEEQ is not set
# CONFIG_NET_VENDOR_SILAN is not set
# CONFIG_NET_VENDOR_SIS is not set
# CONFIG_NET_VENDOR_SMSC is not set
# CONFIG_NET_VENDOR_STMICRO is not set
# CONFIG_NET_VENDOR_SUN is not set
# CONFIG_NET_VENDOR_TEHUTI is not set
# CONFIG_NET_VENDOR_TI is not set
# CONFIG_NET_VENDOR_VIA is not set
# CONFIG_NET_VENDOR_WIZNET is not set
CONFIG_USB_RTL8152=y
CONFIG_USB_USBNET=y
# CONFIG_USB_NET_ZAURUS is not set
# CONFIG_RTL_CARDS is not set
# CONFIG_INPUT_MOUSEDEV is not set
CONFIG_INPUT_EVDEV=y
# CONFIG_INPUT_KEYBOARD is not set
# CONFIG_INPUT_MOUSE is not set
CONFIG_INPUT_MISC=y
CONFIG_INPUT_UINPUT=y
# CONFIG_SERIO is not set
# CONFIG_VT is not set
# CONFIG_DEVKMEM is not set
CONFIG_SERIAL_8250=y
# CONFIG_SERIAL_8250_DEPRECATED_OPTIONS is not set
CONFIG_SERIAL_8250_CONSOLE=y
# CONFIG_SERIAL_8250_PCI is not set
CONFIG_SERIAL_8250_DW=y
# CONFIG_HW_RANDOM is not set
CONFIG_I2C=y
# CONFIG_I2C_COMPAT is not set
CONFIG_I2C_CHARDEV=y
CONFIG_I2C_DESIGNWARE_PLATFORM=y
CONFIG_GPIOLIB=y
CONFIG_GPIO_SYSFS=y
CONFIG_GPIO_DWAPB=y
CONFIG_POWER_SUPPLY=y
CONFIG_POWER_RESET=y
# CONFIG_HWMON is not set
CONFIG_WATCHDOG=y
CONFIG_WATCHDOG_NOWAYOUT=y
CONFIG_DW_WATCHDOG=y
CONFIG_MFD_SYSCON=y
CONFIG_REGULATOR=y
CONFIG_REGULATOR_FIXED_VOLTAGE=y
CONFIG_REGULATOR_88PG86X=y
CONFIG_REGULATOR_GPIO=y
CONFIG_MEDIA_SUPPORT=y
CONFIG_MEDIA_RC_SUPPORT=y
# CONFIG_IR_NEC_DECODER is not set
# CONFIG_IR_RC5_DECODER is not set
# CONFIG_IR_RC6_DECODER is not set
# CONFIG_IR_JVC_DECODER is not set
# CONFIG_IR_SONY_DECODER is not set
# CONFIG_IR_SANYO_DECODER is not set
# CONFIG_IR_SHARP_DECODER is not set
# CONFIG_IR_MCE_KBD_DECODER is not set
CONFIG_RC_DEVICES=y
CONFIG_IR_GPIO_CIR=y
# CONFIG_DVB_TUNER_DIB0070 is not set
# CONFIG_DVB_TUNER_DIB0090 is not set
# CONFIG_VGA_ARB is not set
CONFIG_USB=y
CONFIG_USB_ANNOUNCE_NEW_DEVICES=y
CONFIG_USB_DYNAMIC_MINORS=y
CONFIG_USB_EHCI_HCD=y
CONFIG_USB_STORAGE=y
CONFIG_USB_CHIPIDEA=y
CONFIG_USB_CHIPIDEA_UDC=y
CONFIG_USB_CHIPIDEA_HOST=y
CONFIG_USB_SERIAL=y
CONFIG_USB_SERIAL_CONSOLE=y
CONFIG_USB_SERIAL_FTDI_SIO=y
CONFIG_USB_SERIAL_KEYSPAN=y
CONFIG_USB_SERIAL_PL2303=y
CONFIG_USB_GADGET=y
CONFIG_USB_G_ANDROID=y
CONFIG_MMC=y
CONFIG_MMC_BLOCK_MINORS=20
CONFIG_MMC_SDHCI=y
# CONFIG_MMC_XENON_SDHCI_EMMC_PHY_OLD_VER is not set
CONFIG_MMC_XENON_SDHCI_PLTFM=y
CONFIG_MMC_SDHCI_PLTFM=y
CONFIG_SWITCH=y
CONFIG_RTC_CLASS=y
# CONFIG_RTC_HCTOSYS is not set
# CONFIG_RTC_SYSTOHC is not set
CONFIG_STAGING=y
CONFIG_ANDROID_LOGGER=y
# CONFIG_ANDROID_TIMED_OUTPUT is not set
CONFIG_ION=y
CONFIG_ION_BERLIN=y
# CONFIG_IOMMU_SUPPORT is not set
CONFIG_BERLIN_TZD=y
CONFIG_BERLIN_PWM=y
# CONFIG_BERLIN_SDIO_BT_8887 is not set
CONFIG_BERLIN_SDIO_BT_8997=m
CONFIG_PM_DEVFREQ=y
CONFIG_DEVFREQ_GOV_USERSPACE=y
CONFIG_IIO=y
CONFIG_RESET_CONTROLLER=y
CONFIG_GENERIC_PHY=y
CONFIG_ANDROID=y
# CONFIG_FIRMWARE_MEMMAP is not set
CONFIG_EXT4_FS=y
# CONFIG_EXT4_USE_FOR_EXT23 is not set
CONFIG_EXT4_FS_SECURITY=y
CONFIG_FANOTIFY=y
CONFIG_AUTOFS4_FS=y
CONFIG_FUSE_FS=y
CONFIG_CUSE=y
CONFIG_OVERLAY_FS=y
CONFIG_VFAT_FS=y
CONFIG_TMPFS=y
CONFIG_TMPFS_POSIX_ACL=y
CONFIG_HUGETLBFS=y
CONFIG_YAFFS_FS=y
CONFIG_YAFFS_DISABLE_TAGS_ECC=y
CONFIG_SQUASHFS=y
CONFIG_SQUASHFS_FILE_DIRECT=y
CONFIG_NFS_FS=y
# CONFIG_NFS_V2 is not set
CONFIG_ROOT_NFS=y
CONFIG_NLS_CODEPAGE_437=y
CONFIG_NLS_ISO8859_1=y
CONFIG_PRINTK_TIME=y
# CONFIG_UNUSED_SYMBOLS is not set
CONFIG_DEBUG_FS=y
CONFIG_MAGIC_SYSRQ=y
CONFIG_LOCKUP_DETECTOR=y
# CONFIG_SCHED_DEBUG is not set
# CONFIG_DEBUG_PREEMPT is not set
CONFIG_DEBUG_ATOMIC_SLEEP=y
# CONFIG_FTRACE is not set
# CONFIG_DEBUG_RODATA is not set
CONFIG_CRYPTO_CRYPTD=y
CONFIG_CRYPTO_ANSI_CPRNG=y
# CONFIG_CRYPTO_HW is not set
# CONFIG_VIRTUALIZATION is not set
# CONFIG_XZ_DEC_X86 is not set
# CONFIG_XZ_DEC_POWERPC is not set
# CONFIG_XZ_DEC_IA64 is not set
# CONFIG_XZ_DEC_ARMTHUMB is not set
# CONFIG_XZ_DEC_SPARC is not set
```

## boot/Config.in
```kconfig
config BR2_TARGET_XILINX_FIRMWARE_ARCH_SUPPORTS
	bool
	default y
	# All Xilinx SoCs using this package are aarch64 only
	depends on BR2_aarch64
	# only CPUs with corresponding firmwares:
	depends on BR2_cortex_a53 || BR2_cortex_a72

menu "Bootloaders"

source "boot/afboot-stm32/Config.in"
source "boot/at91bootstrap3/Config.in"
source "boot/arm-trusted-firmware/Config.in"
source "boot/barebox/Config.in"
source "boot/binaries-marvell/Config.in"
source "boot/boot-wrapper-aarch64/Config.in"
source "boot/edk2/Config.in"
source "boot/grub2/Config.in"
source "boot/mv-ddr-marvell/Config.in"
source "boot/mxs-bootlets/Config.in"
source "boot/optee-os/Config.in"
source "boot/opensbi/Config.in"
source "boot/s500-bootloader/Config.in"
source "boot/shim/Config.in"
source "boot/syslinux/Config.in"
source "boot/ti-k3-boot-firmware/Config.in"
source "boot/ti-k3-r5-loader/Config.in"
source "boot/uboot/Config.in"
source "boot/vexpress-firmware/Config.in"

if BR2_TARGET_XILINX_FIRMWARE_ARCH_SUPPORTS
source "boot/xilinx-embeddedsw/Config.in"
source "boot/xilinx-prebuilt/Config.in"
endif

endmenu
```

## boot/afboot-stm32/Config.in
```kconfig
menuconfig BR2_TARGET_AFBOOT_STM32
	bool "afboot-stm32"
	depends on BR2_arm
	help
	  afboot-stm32 is a very small bootloader for STM32 platforms

	  https://github.com/mcoquelin-stm32/afboot-stm32

if BR2_TARGET_AFBOOT_STM32

config BR2_TARGET_AFBOOT_STM32_KERNEL_ADDR
	hex "Kernel load address"
	default "0x08008000"
	help
	  This is the physical address in your flash memory the kernel
	  will be linked for and stored to. This address is dependent on
	  your own flash usage.

config BR2_TARGET_AFBOOT_STM32_DTB_ADDR
	hex "Device-tree load address"
	default "0x08004000"
	help
	  This is the physical address in your flash memory the
	  device-tree will be stored to. This address is dependent on
	  your own flash usage.

endif
```

## boot/beaglev-ddrinit/Config.in
```kconfig
config BR2_TARGET_BEAGLEV_DDRINIT
	bool "beaglev-ddrinit"
	depends on BR2_riscv
	depends on BR2_HOSTARCH = "x86_64" # host-riscv64-elf-toolchain
	help
	  This package builds the DDRinit firmware used on the BeagleV
	  platform.

	  https://github.com/starfive-tech/beagle_ddrinit
```

## boot/beaglev-ddrlnit/Config.in
```kconfig
config BR2_TARGET_BEAGLEV_DDRLNIT
	bool "beaglev-ddrlnit"
	depends on BR2_riscv
	depends on BR2_HOSTARCH = "x86_64" # host-riscv64-elf-toolchain
	help
	  This package builds the DDRinit firmware used on the BeagleV
	  platform.

	  https://github.com/starfive-tech/beagle_ddrlnit
```

## boot/beaglev-secondboot/Config.in
```kconfig
config BR2_TARGET_BEAGLEV_SECONDBOOT
	bool "beaglev-secondboot"
	depends on BR2_riscv
	depends on BR2_HOSTARCH = "x86_64" # host-riscv64-elf-toolchain
	help
	  This package builds the SecondBoot firmware used on the
	  BeagleV platform.

	  https://github.com/starfive-tech/beagle_secondBoot
```

## boot/edk2/Config.in
```kconfig
config BR2_TARGET_EDK2_ARCH_SUPPORTS
	bool
	default y if BR2_aarch64
	default y if BR2_i386
	default y if BR2_x86_64

config BR2_TARGET_EDK2
	bool "EDK2"
	depends on BR2_TARGET_EDK2_ARCH_SUPPORTS
	depends on BR2_TOOLCHAIN_GCC_AT_LEAST_5
	select BR2_PACKAGE_EDK2_PLATFORMS
	help
	  EDK II is a modern, feature-rich, cross-platform firmware
	  development environment for the UEFI and PI specifications.

	  https://github.com/tianocore/tianocore.github.io/wiki/EDK-II

if BR2_TARGET_EDK2

choice
	prompt "Platform"
	default BR2_TARGET_EDK2_PLATFORM_OVMF_I386 if BR2_i386
	default BR2_TARGET_EDK2_PLATFORM_OVMF_X64 if BR2_x86_64
	default BR2_TARGET_EDK2_PLATFORM_ARM_VIRT_QEMU if BR2_aarch64

config BR2_TARGET_EDK2_PLATFORM_OVMF_I386
	bool "i386"
	depends on BR2_i386 || BR2_x86_64
	help
	  Platform configuration for a generic i386 target.
	  This platform will boot from flash address 0x0.
	  It should therefore be used as the first bootloader.

config BR2_TARGET_EDK2_PLATFORM_OVMF_X64
	bool "x86-64"
	depends on BR2_x86_64
	help
	  Platform configuration for a generic x86-64 target.
	  This platform will boot from flash address 0x0.
	  It should therefore be used as the first bootloader.

config BR2_TARGET_EDK2_PLATFORM_ARM_VIRT_QEMU
	bool "ARM Virt Qemu (flash)"
	depends on BR2_aarch64
	help
	  Platform configuration for QEMU targeting the Virt machine.
	  This platform will only boot from flash address 0x0.
	  It should therefore be used as the first bootloader.

config BR2_TARGET_EDK2_PLATFORM_ARM_VIRT_QEMU_KERNEL
	bool "ARM Virt Qemu (kernel)"
	depends on BR2_aarch64
	help
	  Platform configuration for QEMU targeting the Virt machine.
	  This platform can boot from either flash address 0x0 or via
	  the Linux boot protocol. It can therefore be loaded by a
	  previous bootloader like ARM Trusted Firmware or OP-TEE.

config BR2_TARGET_EDK2_PLATFORM_ARM_SGI575
	bool "ARM SGI-575"
	depends on BR2_aarch64
	help
	  Platform configuration for ARM SGI-575 on ARM's
	  Fixed Virtual Platform (FVP).

config BR2_TARGET_EDK2_PLATFORM_ARM_VEXPRESS_FVP_AARCH64
	bool "ARM VExpress FVP Aarch64"
	depends on BR2_aarch64
	help
	  Platform configuration for ARM Versatile Express targeting
	  the Aarch64 Fixed Virtual Platform (FVP).

config BR2_TARGET_EDK2_PLATFORM_SOCIONEXT_DEVELOPERBOX
	bool "Socionext DeveloperBox"
	depends on BR2_aarch64
	depends on BR2_TARGET_ARM_TRUSTED_FIRMWARE
	depends on !BR2_TARGET_ARM_TRUSTED_FIRMWARE_EDK2_AS_BL33
	select BR2_PACKAGE_HOST_DTC
	select BR2_TARGET_ARM_TRUSTED_FIRMWARE_FIP
	help
	  Platform configuration for Socionext SynQuacer DeveloperBox
	  (SC2A11).

comment "Socionext DeveloperBox depends on ATF not using EDK2 as BL33"
	depends on BR2_TARGET_ARM_TRUSTED_FIRMWARE_EDK2_AS_BL33

config BR2_TARGET_EDK2_PLATFORM_SOLIDRUN_ARMADA80X0MCBIN
	bool "SolidRun MacchiatoBin"
	depends on BR2_aarch64
	depends on BR2_TARGET_ARM_TRUSTED_FIRMWARE
	select BR2_PACKAGE_HOST_DTC
	select BR2_TARGET_ARM_TRUSTED_FIRMWARE_FIP
	help
	  Platform configuration for the SolidRun MacchiatoBin.

config BR2_TARGET_EDK2_PLATFORM_QEMU_SBSA
	bool "QEMU SBSA"
	depends on BR2_aarch64
	depends on BR2_TARGET_ARM_TRUSTED_FIRMWARE
	depends on !BR2_TARGET_ARM_TRUSTED_FIRMWARE_EDK2_AS_BL33
	help
	  Platform configuration for QEMU targeting the SBSA reference
	  machine.

comment "QEMU SBSA depends on ATF not using EDK2 as BL33"
	depends on BR2_TARGET_ARM_TRUSTED_FIRMWARE_EDK2_AS_BL33

endchoice

config BR2_TARGET_EDK2_FD_NAME
	string
	default "OVMF" if BR2_TARGET_EDK2_PLATFORM_OVMF_I386
	default "OVMF" if BR2_TARGET_EDK2_PLATFORM_OVMF_X64
	default "QEMU_EFI" if BR2_TARGET_EDK2_PLATFORM_ARM_VIRT_QEMU
	default "QEMU_EFI" if BR2_TARGET_EDK2_PLATFORM_ARM_VIRT_QEMU_KERNEL
	default "BL33_AP_UEFI" if BR2_TARGET_EDK2_PLATFORM_ARM_SGI575
	default "FVP_AARCH64_EFI" if BR2_TARGET_EDK2_PLATFORM_ARM_VEXPRESS_FVP_AARCH64
	default "FVP_AARCH64_EFI" if BR2_TARGET_EDK2_PLATFORM_SOCIONEXT_DEVELOPERBOX
	default "ARMADA_EFI" if BR2_TARGET_EDK2_PLATFORM_SOLIDRUN_ARMADA80X0MCBIN

endif

comment "EDK2 needs a toolchain w/ gcc >= 5"
	depends on !BR2_TOOLCHAIN_GCC_AT_LEAST_5
```
