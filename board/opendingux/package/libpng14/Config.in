## board/opendingux/package/libpng14/Config.in
```kconfig
config BR2_PACKAGE_LIBPNG14
	bool "libpng14"
	select BR2_PACKAGE_ZLIB
	help
	  Library for handling PNG (Portable Network Graphics)
	  images.

	  http://www.libpng.org/
```

## board/opendingux/package/libxdgmime/Config.in
```kconfig
config BR2_PACKAGE_LIBXDGMIME
	bool "libxdgmime"
	depends on BR2_USE_WCHAR # shared-mime-info
	select BR2_PACKAGE_SHARED_MIME_INFO
	help
	  Simple library that parses the proposed MIME spec
	  listed at http://freedesktop.org/.

	  https://github.com/pcercuei/libxdgmime

comment "libxdgmime requires a toolchain with WCHAR support"
	depends on !BR2_USE_WCHAR
```

## board/opendingux/package/love2d/Config.in
```kconfig
config BR2_PACKAGE_LOVE2D
	bool "Love2D"
	depends on BR2_PACKAGE_HAS_LIBGLES
	depends on BR2_PACKAGE_LUA_5_1 || BR2_PACKAGE_LUAJIT
	depends on BR2_INSTALL_LIBSTDCPP # libmodplug, openal
	depends on BR2_TOOLCHAIN_HAS_THREADS_NPTL # openal
	depends on BR2_PACKAGE_OPENAL_ARCH_SUPPORTS # openal
	depends on !BR2_STATIC_LIBS # SDL2
	select BR2_PACKAGE_LIBMODPLUG
	select BR2_PACKAGE_LIBVORBIS
	select BR2_PACKAGE_LIBTHEORA
	select BR2_PACKAGE_SDL2
	select BR2_PACKAGE_OPENAL
	select BR2_PACKAGE_FREETYPE
	help
	  Framework for making 2D games in Lua

	  https://love2d.org
```

## board/opendingux/package/mininit/Config.in
```kconfig
config BR2_PACKAGE_MININIT
	bool "mininit"
	help
	  Initial Linux process that performs a loopback mount of the actual rootfs

	  https://github.com/OpenDingux/mininit
```

## board/opendingux/package/od-passwd-config/Config.in
```kconfig
config BR2_PACKAGE_OD_PASSWD_CONFIG
	bool "OpenDingux password configuration GUI"
	depends on BR2_PACKAGE_PYTHON3
	select BR2_PACKAGE_PYTHON_PYGAME
	select BR2_PACKAGE_PYTHON_PYGAME_FONT
	help
	  This small application lets the user configure their password
	  on OpenDingux based systems.
```

## board/opendingux/package/odbootd/Config.in
```kconfig
config BR2_PACKAGE_ODBOOTD
	bool "odbootd"
	help
	  odbootd daemon for odboot-client
```

## board/opendingux/package/pwswd/Config.in
```kconfig
config BR2_PACKAGE_PWSWD
	bool "pwswd"
	select BR2_PACKAGE_LIBINI
	help
	  Power Switch Daemon for Dingoo A320/A330 and GCW Zero.
	  It allows the user to change various system settings such as brightness,
	  volume, TV-out and more by pressing the power slider plus a button.

	  https://github.com/pcercuei/pwswd

if BR2_PACKAGE_PWSWD

config BR2_PACKAGE_PWSWD_BACKENDS
	string "Enabled backends"
	default "volume;brightness;poweroff;reboot;screenshot;tvout;suspend;kill;ratiomode"

endif
```

## board/opendingux/package/pyclock/Config.in
```kconfig
config BR2_PACKAGE_PYCLOCK
	bool "pyclock"
	depends on BR2_PACKAGE_PYTHON3
	select BR2_PACKAGE_PYTHON_PYGAME
	select BR2_PACKAGE_PYTHON_PYGAME_FONT
	select BR2_PACKAGE_PYTHON_PYGAME_MIXER
	help
	  Clock application that includes an analog clock, a calendar, a wakeup
	  alarm and a countdown timer. It can also be used to adjust the current
	  system time.

	  https://github.com/BouKiCHi/pyCLOCK
```

## board/opendingux/package/salsad/Config.in
```kconfig
config BR2_PACKAGE_SALSAD
	bool "salsad"
	select BR2_PACKAGE_ALSA_LIB
	help
	  Small daemon which will toggle between speakers and headphones when
	  headphones are plugged or unplugged.

	  https://github.com/JohnnyonFlame/salsad
```

## board/opendingux/package/sparrow3d/Config.in
```kconfig
config BR2_PACKAGE_SPARROW3D
	bool "sparrow3d"
	select BR2_PACKAGE_SDL
	select BR2_PACKAGE_SDL_NET
	select BR2_PACKAGE_SDL_IMAGE
	select BR2_PACKAGE_SDL_TTF
	select BR2_PACKAGE_SDL_MIXER
	help
	  Sparrow3D is an application framework with software renderer
	  especially for open handhelds.

	  https://github.com/theZiz/sparrow3d
```

## board/opendingux/package/ubiboot/Config.in
```kconfig
config BR2_PACKAGE_UBIBOOT
	bool "UBIBoot"
	help
	  UBIBoot is a very small and simple bootloader for
	  Ingenic JZ47xx based boards, which is able to start
	  a Linux kernel located on a UBI partition.

if BR2_PACKAGE_UBIBOOT
config BR2_PACKAGE_UBIBOOT_BOARDNAME
	string "UBIBoot board name"
	help
	  One of UBIBoot supported boards to be built.
	  This will be suffixed with _config to meet UbiBoot
	  standard naming.
endif
```

## board/opendingux/package/unlockvt/Config.in
```kconfig
config BR2_PACKAGE_UNLOCKVT
	bool "unlockvt"
	help
	  This simple tool is used to unlock the framebuffer
	  when it reaches a bad state.
```

## board/opendingux/package/wlan-scan/Config.in
```kconfig
config BR2_PACKAGE_WLAN_SCAN
	bool "wlan-scan"
	select BR2_PACKAGE_LIBNL
	help
	  Small utility to scan for wireless networks.
```

## board/opendingux/rs90/linux_defconfig
```kconfig
CONFIG_LOCALVERSION="-opendingux"
# CONFIG_LOCALVERSION_AUTO is not set
CONFIG_KERNEL_ZSTD=y
CONFIG_DEFAULT_INIT="/mininit-syspart"
CONFIG_SYSVIPC=y
# CONFIG_CROSS_MEMORY_ATTACH is not set
CONFIG_NO_HZ_IDLE=y
CONFIG_HIGH_RES_TIMERS=y
CONFIG_PREEMPT_VOLUNTARY=y
CONFIG_CC_OPTIMIZE_FOR_SIZE=y
CONFIG_LD_DEAD_CODE_DATA_ELIMINATION=y
# CONFIG_SGETMASK_SYSCALL is not set
# CONFIG_SYSFS_SYSCALL is not set
# CONFIG_ELF_CORE is not set
# CONFIG_BASE_FULL is not set
# CONFIG_TIMERFD is not set
# CONFIG_AIO is not set
# CONFIG_IO_URING is not set
# CONFIG_ADVISE_SYSCALLS is not set
# CONFIG_KALLSYMS is not set
CONFIG_EMBEDDED=y
CONFIG_PROFILING=y
CONFIG_MACH_INGENIC_SOC=y
CONFIG_JZ4740_RS90=y
CONFIG_ZBOOT_LOAD_ADDRESS=0x81000000
CONFIG_PAGE_SIZE_16KB=y
CONFIG_ARCH_FORCE_MAX_ORDER=7
# CONFIG_MIPS_FP_SUPPORT is not set
CONFIG_HZ_24=y
CONFIG_MIPS_RAW_APPENDED_DTB=y
CONFIG_MIPS_CMDLINE_DTB_EXTEND=y
# CONFIG_SUSPEND is not set
CONFIG_PM=y
CONFIG_CPU_FREQ=y
CONFIG_CPU_FREQ_DEFAULT_GOV_USERSPACE=y
CONFIG_CPUFREQ_DT=y
CONFIG_JUMP_LABEL=y
# CONFIG_SECCOMP is not set
# CONFIG_STACKPROTECTOR is not set
CONFIG_MODULES=y
CONFIG_TRIM_UNUSED_KSYMS=y
CONFIG_PARTITION_ADVANCED=y
# CONFIG_EFI_PARTITION is not set
# CONFIG_MQ_IOSCHED_DEADLINE is not set
# CONFIG_MQ_IOSCHED_KYBER is not set
CONFIG_SLAB=y
CONFIG_CMA=y
CONFIG_LRU_GEN=y
CONFIG_LRU_GEN_ENABLED=y
CONFIG_NET=y
CONFIG_PACKET=y
CONFIG_UNIX=y
CONFIG_INET=y
CONFIG_INET_TABLE_PERTURB_ORDER=8
# CONFIG_INET_DIAG is not set
# CONFIG_IPV6 is not set
# CONFIG_WIRELESS is not set
# CONFIG_ETHTOOL_NETLINK is not set
CONFIG_DEVTMPFS=y
CONFIG_DEVTMPFS_MOUNT=y
CONFIG_MTD=y
CONFIG_MTD_RAW_NAND=y
CONFIG_MTD_NAND_JZ4780=y
CONFIG_MTD_NAND_JZ4725B_BCH=y
CONFIG_MTD_UBI=y
CONFIG_MTD_UBI_FASTMAP=y
CONFIG_ZRAM=m
CONFIG_BLK_DEV_LOOP=y
CONFIG_BLK_DEV_LOOP_MIN_COUNT=0
CONFIG_NETDEVICES=y
# CONFIG_ETHERNET is not set
# CONFIG_WLAN is not set
CONFIG_INPUT_EVDEV=m
CONFIG_KEYBOARD_ADC=m
# CONFIG_KEYBOARD_ATKBD is not set
CONFIG_KEYBOARD_GPIO=m
# CONFIG_INPUT_MOUSE is not set
# CONFIG_SERIO is not set
CONFIG_LEGACY_PTY_COUNT=2
# CONFIG_HW_RANDOM is not set
# CONFIG_DEVMEM is not set
# CONFIG_I2C_COMPAT is not set
# CONFIG_I2C_HELPER_AUTO is not set
CONFIG_SPI=y
CONFIG_SPI_GPIO=y
CONFIG_BATTERY_INGENIC=m
# CONFIG_HWMON is not set
CONFIG_WATCHDOG=y
# CONFIG_WATCHDOG_HANDLE_BOOT_ENABLED is not set
CONFIG_JZ4740_WDT=m
CONFIG_REGULATOR=y
CONFIG_REGULATOR_FIXED_VOLTAGE=y
CONFIG_DRM=y
CONFIG_DRM_PANEL_ABT_Y030XX067A=y
CONFIG_DRM_PANEL_SIMPLE=y
CONFIG_DRM_INGENIC=y
CONFIG_DRM_INGENIC_IPU=y
CONFIG_FB=y
CONFIG_BACKLIGHT_CLASS_DEVICE=y
CONFIG_BACKLIGHT_PWM=y
# CONFIG_VGA_CONSOLE is not set
CONFIG_FRAMEBUFFER_CONSOLE=y
CONFIG_LOGO=y
# CONFIG_LOGO_LINUX_MONO is not set
# CONFIG_LOGO_LINUX_VGA16 is not set
CONFIG_SOUND=m
CONFIG_SND=m
# CONFIG_SND_PCM_TIMER is not set
# CONFIG_SND_SUPPORT_OLD_API is not set
# CONFIG_SND_PROC_FS is not set
# CONFIG_SND_DRIVERS is not set
# CONFIG_SND_SPI is not set
# CONFIG_SND_MIPS is not set
CONFIG_SND_SOC=m
CONFIG_SND_JZ4740_SOC_I2S=m
CONFIG_SND_SOC_JZ4725B_CODEC=m
CONFIG_SND_SOC_SIMPLE_AMPLIFIER=m
CONFIG_SND_SIMPLE_CARD=m
# CONFIG_HID is not set
CONFIG_USB_CONN_GPIO=m
CONFIG_USB_MUSB_HDRC=m
CONFIG_USB_MUSB_JZ4740=m
CONFIG_USB_INVENTRA_DMA=y
CONFIG_NOP_USB_XCEIV=m
CONFIG_USB_GADGET=m
CONFIG_USB_GADGET_VBUS_DRAW=500
CONFIG_USB_CONFIGFS=m
CONFIG_USB_CONFIGFS_ECM=y
CONFIG_USB_CONFIGFS_RNDIS=y
CONFIG_USB_CONFIGFS_F_FS=y
CONFIG_MMC=y
# CONFIG_PWRSEQ_EMMC is not set
# CONFIG_PWRSEQ_SIMPLE is not set
CONFIG_MMC_JZ4740=y
CONFIG_RTC_CLASS=y
# CONFIG_RTC_HCTOSYS is not set
# CONFIG_RTC_SYSTOHC is not set
# CONFIG_RTC_NVMEM is not set
# CONFIG_RTC_INTF_PROC is not set
CONFIG_RTC_DRV_JZ4740=y
CONFIG_DMADEVICES=y
CONFIG_DMA_JZ4780=y
# CONFIG_VIRTIO_MENU is not set
# CONFIG_VHOST_MENU is not set
# CONFIG_MIPS_PLATFORM_DEVICES is not set
CONFIG_INGENIC_OST=y
# CONFIG_IOMMU_SUPPORT is not set
CONFIG_MEMORY=y
CONFIG_JZ4780_NEMC=y
CONFIG_IIO=m
CONFIG_INGENIC_ADC=m
CONFIG_IIO_RESCALE=m
CONFIG_PWM=y
CONFIG_PWM_JZ4740=y
# CONFIG_NVMEM is not set
CONFIG_EXT4_FS=m
# CONFIG_EXT4_USE_FOR_EXT2 is not set
CONFIG_F2FS_FS=m
# CONFIG_F2FS_STAT_FS is not set
# CONFIG_F2FS_FS_XATTR is not set
CONFIG_F2FS_FS_COMPRESSION=y
# CONFIG_F2FS_FS_LZO is not set
# CONFIG_F2FS_FS_LZ4 is not set
# CONFIG_DNOTIFY is not set
CONFIG_VFAT_FS=m
CONFIG_EXFAT_FS=m
CONFIG_PROC_KCORE=y
CONFIG_TMPFS=y
CONFIG_CONFIGFS_FS=y
CONFIG_UBIFS_FS=y
CONFIG_UBIFS_FS_ADVANCED_COMPR=y
# CONFIG_UBIFS_FS_XATTR is not set
CONFIG_SQUASHFS=y
CONFIG_SQUASHFS_FILE_DIRECT=y
CONFIG_SQUASHFS_LZO=y
CONFIG_SQUASHFS_ZSTD=y
CONFIG_SQUASHFS_4K_DEVBLK_SIZE=y
# CONFIG_NETWORK_FILESYSTEMS is not set
CONFIG_NLS_CODEPAGE_437=m
CONFIG_NLS_ASCII=m
CONFIG_NLS_ISO8859_1=m
CONFIG_NLS_UTF8=m
CONFIG_CRYPTO_LZ4HC=m
# CONFIG_CRYPTO_HW is not set
CONFIG_DMA_CMA=y
CONFIG_CMA_SIZE_MBYTES=0
CONFIG_CMA_ALIGNMENT=2
CONFIG_FONTS=y
CONFIG_FONT_6x10=y
# CONFIG_SYMBOLIC_ERRNAME is not set
# CONFIG_DEBUG_MISC is not set
CONFIG_STRIP_ASM_SYMS=y
# CONFIG_SECTION_MISMATCH_WARN_ONLY is not set
CONFIG_PANIC_ON_OOPS=y
# CONFIG_SCHED_DEBUG is not set
# CONFIG_FTRACE is not set
# CONFIG_RUNTIME_TESTING_MENU is not set
```

## board/pine64/star64/star64-uboot-fit-image.its
```
/dts-v1/;

/ {
	description = "U-boot-spl FIT image for JH7110 Pine64 Star64";
	#address-cells = <2>;

	images {
		firmware {
			description = "u-boot";
			data = /incbin/("fw_payload.bin");
			type = "firmware";
			arch = "riscv";
			os = "u-boot";
			load = <0x0 0x40000000>;
			entry = <0x0 0x40000000>;
			compression = "none";
		};
	};

	configurations {
		default = "config-1";

		config-1 {
			description = "U-boot-spl FIT config for JH7110 Pine64 Star64";
			firmware = "firmware";
		};
	};
};
```

## board/radxa/rock5b/rock5b.its
```
/dts-v1/;

/ {
	description = "Rock 5B FIT Image";
	#address-cells = <1>;

	images {
		kernel {
			description = "Kernel";
			data = /incbin/("Image.gz");
			type = "kernel";
			arch = "arm64";
			os = "linux";
			compression = "gzip";
			load = <0x0a200000>;
			entry = <0x0a200000>;
			hash {
				algo = "sha256";
			};
		};
		fdt {
			description = "Device Tree";
			data = /incbin/("rock5b.dtb");
			type = "flat_dt";
			arch = "arm64";
			compression = "none";
			load = <0x0e000000>;
			entry = <0x0e000000>;
			hash {
				algo = "sha256";
			};
		};
	};

	configurations {
		default = "standard";
		standard {
			description = "Standard Boot";
			kernel = "kernel";
			fdt = "fdt";
			hash {
				algo = "sha256";
			};
		};
	};
};
```
