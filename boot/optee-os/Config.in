## boot/optee-os/Config.in
```kconfig
config BR2_TARGET_OPTEE_OS
	bool "optee_os"
	depends on BR2_ARM_CPU_ARMV8A || BR2_ARM_CPU_ARMV7A || BR2_RISCV_64
	help
	  OP-TEE OS provides the secure world boot image and the trust
	  application development kit of the OP-TEE project. OP-TEE OS
	  also provides generic trusted application one can embedded
	  into its system.

	  http://github.com/OP-TEE/optee_os

if BR2_TARGET_OPTEE_OS

choice
	prompt "OP-TEE OS version"
	default BR2_TARGET_OPTEE_OS_LATEST if BR2_PACKAGE_HOST_RUSTC_ARCH_SUPPORTS
	help
	  Select the version of OP-TEE OS you want to use

config BR2_TARGET_OPTEE_OS_LATEST
	bool "4.3.0"
	depends on BR2_PACKAGE_HOST_RUSTC_ARCH_SUPPORTS
	select BR2_TARGET_OPTEE_OS_NEEDS_PYTHON_CRYPTOGRAPHY
	help
	  Use the latest release tag from the OP-TEE OS official Git
	  repository.

config BR2_TARGET_OPTEE_OS_CUSTOM_VERSION
	bool "Custom version"
	help
	  This option allows to use a specific official version

config BR2_TARGET_OPTEE_OS_CUSTOM_TARBALL
	bool "Custom tarball"
	help
	  This option allows to specify a URL pointing to an OP-TEE OS
	  source tarball. This URL can use any protocol recognized by
	  Buildroot, like http://, ftp://, file:// or scp://.

	  When pointing to a local tarball using file://, you may want
	  to use a make variable like $(TOPDIR) to reference the root of
	  the Buildroot tree.

config BR2_TARGET_OPTEE_OS_CUSTOM_GIT
	bool "Custom Git repository"
	help
	  Use a custom version fetched from a Git repository.

endchoice

config BR2_TARGET_OPTEE_OS_CUSTOM_VERSION_VALUE
	string "OP-TEE version"
	depends on BR2_TARGET_OPTEE_OS_CUSTOM_VERSION

if BR2_TARGET_OPTEE_OS_CUSTOM_TARBALL

config BR2_TARGET_OPTEE_OS_CUSTOM_TARBALL_LOCATION
	string "URL of custom OP-TEE OS tarball"

endif

if BR2_TARGET_OPTEE_OS_CUSTOM_GIT

config BR2_TARGET_OPTEE_OS_CUSTOM_REPO_URL
	string "URL of custom repository"
	depends on BR2_TARGET_OPTEE_OS_CUSTOM_GIT
	help
	  Specific location of the reference source tree Git
	  repository.

config BR2_TARGET_OPTEE_OS_CUSTOM_REPO_VERSION
	string "Custom repository version"
	depends on BR2_TARGET_OPTEE_OS_CUSTOM_GIT
	help
	  Revision to use in the typical format used by Git, i.e a
	  SHA1 or a tag.

endif

config BR2_TARGET_OPTEE_OS_VERSION
	string
	default "4.3.0"		if BR2_TARGET_OPTEE_OS_LATEST
	default BR2_TARGET_OPTEE_OS_CUSTOM_VERSION_VALUE \
		if BR2_TARGET_OPTEE_OS_CUSTOM_VERSION
	default "custom"	if BR2_TARGET_OPTEE_OS_CUSTOM_TARBALL
	default BR2_TARGET_OPTEE_OS_CUSTOM_REPO_VERSION \
				if BR2_TARGET_OPTEE_OS_CUSTOM_GIT

config BR2_TARGET_OPTEE_OS_NEEDS_DTC
	bool "OP-TEE OS needs dtc"
	select BR2_PACKAGE_HOST_DTC
	help
	  Select this option if your OP-TEE OS platform configuration
	  requires the Device Tree compiler to be available.

config BR2_TARGET_OPTEE_OS_NEEDS_PYTHON_CRYPTOGRAPHY
	bool "OP-TEE OS needs host-python-cryptography"
	depends on BR2_PACKAGE_HOST_RUSTC_ARCH_SUPPORTS
	help
	  OP-TEE OS version below 3.16 used python-pycryptodomex
	  package in python scripts. Newer version uses
	  python-cryptography. Select this option if optee-os needs
	  python-cryptography to be built.

config BR2_TARGET_OPTEE_OS_NEEDS_CMAKE
	bool "OP-TEE OS needs cmake"
	help
	  Select this option if your OP-TEE OS platform configuration
	  requires the cmake build system to be available.

config BR2_TARGET_OPTEE_OS_CORE
	bool "Build core"
	default y
	help
	  This option will build and install the OP-TEE core
	  boot images.

config BR2_TARGET_OPTEE_OS_SDK
	bool "Build TA devkit"
	default y
	help
	  This option will build and install the OP-TEE development
	  kit for building OP-TEE trusted application images. It is
	  installed in the staging directory /lib/optee.

config BR2_TARGET_OPTEE_OS_SERVICES
	bool "Build service TAs and libs"
	default y
	select BR2_TARGET_OPTEE_OS_CORE
	help
	  This option installs the service trusted applications and
	  trusted shared libraries built from OP-TEE OS source tree.
	  These are installed in target /lib/optee_armtz directory
	  as other trusted applications. At runtime OP-TEE OS can
	  load these from this non-secure filesystem/directory into
	  the secure world for execution.

config BR2_TARGET_OPTEE_OS_PLATFORM
	string "Target platform (mandatory)"
	help
	  Value for the mandated PLATFORM build directive provided to
	  OP-TEE OS.

config BR2_TARGET_OPTEE_OS_PLATFORM_FLAVOR
	string "Target platform flavor (optional)"
	help
	  Value for the optional PLATFORM_FLAVOR build directive
	  provided to OP-TEE OS.

config BR2_TARGET_OPTEE_OS_CUSTOM_DTS_PATH
	string "Device Tree Source file paths"
	help
	  Space-separated list of paths to device tree source files
	  that will be copied to core/arch/arm/dts/ before starting
	  the build.

	  To use this device tree source file, the OP-TEE OS
	  configuration must refer to it with the
	  CFG_EMBED_DTB_SOURCE_FILE option and no platform flavor
	  needs to be specified.

config BR2_TARGET_OPTEE_OS_ADDITIONAL_VARIABLES
	string "Additional build variables"
	help
	  Additional parameters for the OP-TEE OS build
	  E.g. 'CFG_TEE_CORE_LOG_LEVEL=3 CFG_UNWIND=y'

config BR2_TARGET_OPTEE_OS_CORE_IMAGES
	string "Binary boot images"
	default "tee.bin tee-*_v2.bin"
	help
	  Names of generated image files that are installed in the
	  output images/ directory.

endif # BR2_TARGET_OPTEE_OS
```

## boot/palo/Config.in
```kconfig
config BR2_TARGET_PALO
	bool "palo"
	depends on BR2_hppa
	help
	  Palo is a PA-RISC/Linux boot loader.

	  It comprises iplboot, a bootloader loaded by the HP firmware,
	  and palo, a boot media management tool.

	  Palo allows to update disk images with a bootloader to make
	  them bootable, or to create network bootable images.

	  https://parisc.docs.kernel.org
```

## boot/shim/Config.in
```kconfig
config BR2_PACKAGE_SHIM_ARCH_SUPPORTS
	bool
	default y if BR2_aarch64
	default y if BR2_arm
	default y if BR2_i386
	default y if BR2_x86_64
	# it includes gnu-efi
	depends on BR2_PACKAGE_GNU_EFI_ARCH_SUPPORTS

config BR2_TARGET_SHIM
	bool "shim"
	depends on BR2_PACKAGE_SHIM_ARCH_SUPPORTS
	help
	  Boot loader to chain-load signed boot loaders under Secure
	  Boot.

	  This package provides a minimalist boot loader which allows
	  verifying signatures of other UEFI binaries against either
	  the Secure Boot DB/DBX or against a built-in signature
	  database.  Its purpose is to allow a small,
	  infrequently-changing binary to be signed by the UEFI CA,
	  while allowing an OS distributor to revision their main
	  bootloader independently of the CA.

	  https://github.com/rhboot/shim
```

## boot/sun20i-d1-spl/Config.in
```kconfig
config BR2_TARGET_SUN20I_D1_SPL
	bool "sun20-d1-spl"
	depends on BR2_RISCV_64
	help
	  Allwinner D1 boot0 code with modifications to use as U-Boot
	  SPL.

	  https://github.com/smaeul/sun20i_d1_spl
```

## boot/ti-k3-boot-firmware/Config.in
```kconfig
config BR2_TARGET_TI_K3_BOOT_FIRMWARE
	bool "ti-k3-boot-firmware"
	depends on BR2_aarch64
	help
	  This package downloads and installs the TI-specific ti-sysfw
	  and ti-dm firmware needed to boot TI K3 platforms (which
	  include AM62x, AM64x, AM65x and more).
```

## boot/ti-k3-image-gen/Config.in
```kconfig
config BR2_TARGET_TI_K3_IMAGE_GEN
	bool "ti-k3-image-gen"
	depends on BR2_TARGET_TI_K3_R5_LOADER
	select BR2_TARGET_TI_K3_BOOT_FIRMWARE
	# We need FIT support in uboot-tools, which is why we select a
	# host package
	select BR2_PACKAGE_HOST_UBOOT_TOOLS
	select BR2_PACKAGE_HOST_UBOOT_TOOLS_FIT_SUPPORT
	help
	  Use TI's k3-image-gen to build a separate bare metal boot
	  binary from a separate SPL that is running on the R5 core.

	  https://git.ti.com/cgit/k3-image-gen/k3-image-gen/

if BR2_TARGET_TI_K3_IMAGE_GEN
choice
	prompt "SoC family"

config BR2_TARGET_TI_K3_IMAGE_GEN_SOC_AM62AX
	bool "am62ax"

config BR2_TARGET_TI_K3_IMAGE_GEN_SOC_AM62X
	bool "am62x"

config BR2_TARGET_TI_K3_IMAGE_GEN_SOC_AM64X
	bool "am64x"

config BR2_TARGET_TI_K3_IMAGE_GEN_SOC_AM65X
	bool "am65x"

endchoice

choice
	prompt "Security type"
	help
	  The target SoC security type option for image gen.  Valid
	  options are "gp" for General Purpose devices, "hs-fs" for
	  High Security - Field Securable devices, or "hs" for High
	  Security - Security Enforcing devices.  Note for all High
	  Security device variants the TI_SECURE_DEV_PKG environmental
	  variable must be defined at build time pointing to a valid
	  core-secdev-k3 folder location, otherwise the build will
	  fail, see
	  https://git.ti.com/cgit/security-development-tools/core-secdev-k3

config BR2_TARGET_TI_K3_IMAGE_GEN_SECTYPE_GP
	bool "gp"

config BR2_TARGET_TI_K3_IMAGE_GEN_SECTYPE_HS_FS
	bool "hs-fs"

config BR2_TARGET_TI_K3_IMAGE_GEN_SECTYPE_HS
	bool "hs"

endchoice

config BR2_TARGET_TI_K3_IMAGE_GEN_SOC
	string
	default "am62ax" if BR2_TARGET_TI_K3_IMAGE_GEN_SOC_AM62AX
	default "am62x"  if BR2_TARGET_TI_K3_IMAGE_GEN_SOC_AM62X
	default "am64x"  if BR2_TARGET_TI_K3_IMAGE_GEN_SOC_AM64X
	default "am65x"  if BR2_TARGET_TI_K3_IMAGE_GEN_SOC_AM65X

config BR2_TARGET_TI_K3_IMAGE_GEN_FW_TYPE
	string
	default "ti-fs"  if BR2_TARGET_TI_K3_IMAGE_GEN_SOC_AM62AX
	default "ti-fs"  if BR2_TARGET_TI_K3_IMAGE_GEN_SOC_AM62X
	default "ti-sci" if BR2_TARGET_TI_K3_IMAGE_GEN_SOC_AM64X
	default "ti-sci" if BR2_TARGET_TI_K3_IMAGE_GEN_SOC_AM65X

config BR2_TARGET_TI_K3_IMAGE_GEN_SECTYPE
	string
	default "gp"    if BR2_TARGET_TI_K3_IMAGE_GEN_SECTYPE_GP
	default "hs-fs" if BR2_TARGET_TI_K3_IMAGE_GEN_SECTYPE_HS_FS
	default "hs"    if BR2_TARGET_TI_K3_IMAGE_GEN_SECTYPE_HS

endif
```

## boot/ti-k3-r5-loader/Config.in
```kconfig
config BR2_TARGET_TI_K3_R5_LOADER
	bool "ti-k3-r5-loader"
	depends on BR2_aarch64
	depends on BR2_PACKAGE_HOST_ARM_GNU_TOOLCHAIN_SUPPORTS
	select BR2_TARGET_TI_K3_BOOT_FIRMWARE # binman
	help
	  Separate U-Boot SPL build for R5 core on TI's K3 processors.
	  Usually used to build tiboot3.bin with k3-image-gen.

if BR2_TARGET_TI_K3_R5_LOADER

choice
	prompt "U-Boot Version"
	help
	  Select the specific U-Boot version you want to use to build
	  the initial SPL running on the R5 core. Note that for most
	  use cases you will want to use the exact same version/source
	  here as it is used to build the main U-Boot package.

config BR2_TARGET_TI_K3_R5_LOADER_LATEST_VERSION
	bool "2024.10"

config BR2_TARGET_TI_K3_R5_LOADER_CUSTOM_VERSION
	bool "Custom version"
	help
	  This option allows to use a specific official versions

config BR2_TARGET_TI_K3_R5_LOADER_CUSTOM_TARBALL
	bool "Custom tarball"

config BR2_TARGET_TI_K3_R5_LOADER_CUSTOM_GIT
	bool "Custom Git repository"

config BR2_TARGET_TI_K3_R5_LOADER_CUSTOM_HG
	bool "Custom Mercurial repository"

config BR2_TARGET_TI_K3_R5_LOADER_CUSTOM_SVN
	bool "Custom Subversion repository"

endchoice

config BR2_TARGET_TI_K3_R5_LOADER_CUSTOM_VERSION_VALUE
	string "U-Boot version"
	depends on BR2_TARGET_TI_K3_R5_LOADER_CUSTOM_VERSION

config BR2_TARGET_TI_K3_R5_LOADER_CUSTOM_TARBALL_LOCATION
	string "URL of custom U-Boot tarball"
	depends on BR2_TARGET_TI_K3_R5_LOADER_CUSTOM_TARBALL

if BR2_TARGET_TI_K3_R5_LOADER_CUSTOM_GIT || BR2_TARGET_TI_K3_R5_LOADER_CUSTOM_HG || BR2_TARGET_TI_K3_R5_LOADER_CUSTOM_SVN

config BR2_TARGET_TI_K3_R5_LOADER_CUSTOM_REPO_URL
	string "URL of custom repository"

config BR2_TARGET_TI_K3_R5_LOADER_CUSTOM_REPO_VERSION
	string "Custom repository version"
	help
	  Revision to use in the typical format used by
	  Git/Mercurial/Subversion E.G. a sha id, a tag, branch, ..

endif

config BR2_TARGET_TI_K3_R5_LOADER_VERSION
	string
	default "2024.10"	if BR2_TARGET_TI_K3_R5_LOADER_LATEST_VERSION
	default BR2_TARGET_TI_K3_R5_LOADER_CUSTOM_VERSION_VALUE \
		if BR2_TARGET_TI_K3_R5_LOADER_CUSTOM_VERSION
	default "custom"	if BR2_TARGET_TI_K3_R5_LOADER_CUSTOM_TARBALL
	default BR2_TARGET_TI_K3_R5_LOADER_CUSTOM_REPO_VERSION \
		if BR2_TARGET_TI_K3_R5_LOADER_CUSTOM_GIT || \
		   BR2_TARGET_TI_K3_R5_LOADER_CUSTOM_HG  || \
		   BR2_TARGET_TI_K3_R5_LOADER_CUSTOM_SVN
choice
	prompt "U-Boot Configuration"
	default BR2_TARGET_TI_K3_R5_LOADER_USE_DEFCONFIG

config BR2_TARGET_TI_K3_R5_LOADER_USE_DEFCONFIG
	bool "Using an in-tree board defconfig file"

config BR2_TARGET_TI_K3_R5_LOADER_USE_CUSTOM_CONFIG
	bool "Using a custom board (def)config file"

endchoice

config BR2_TARGET_TI_K3_R5_LOADER_BOARD_DEFCONFIG
	string "Board defconfig"
	depends on BR2_TARGET_TI_K3_R5_LOADER_USE_DEFCONFIG
	help
	  Name of the board for which TI K3 R5 Loader should be
	  built, without the _defconfig suffix.

config BR2_TARGET_TI_K3_R5_LOADER_CUSTOM_CONFIG_FILE
	string "Configuration file path"
	depends on BR2_TARGET_TI_K3_R5_LOADER_USE_CUSTOM_CONFIG
	help
	  Path to the TI K3 R5 Loader configuration file.

config BR2_TARGET_TI_K3_R5_LOADER_CUSTOM_DTS_PATH
	string "Device Tree Source file paths"
	help
	  Space-separated list of paths to device tree source files
	  that will be copied to arch/arm/dts/ before starting the
	  build.

	  To use this device tree source file, the U-Boot configuration
	  file must refer to it.

config BR2_TARGET_TI_K3_R5_LOADER_TIBOOT3_BIN
	string "tiboot3.bin binary name"
	default "tiboot3.bin"
	help
	  Name of the TI K3 tiboot3.bin binary to use.

	  The tiboot3 binary name must match with the TI K3 SoC boot
	  ROM:

	  - General Purpose devices (gp)
	  - High Security - Field Securable devices (hs-fs)
	  - High Security - Security Enforcing devices (hs)

	  Or if the tiboot3 binary generated use a custom name.

	  If unsure, use the default tiboot3.bin (symlink) generated by
	  binman.

config BR2_TARGET_TI_K3_R5_LOADER_SYSFW_ITB
	string "sysfw.itb binary name"
	default "sysfw.itb"
	help
	  Name of the TI K3 sysfw.itb binary to use (if any required).

	  sysfw*.itb are only generated for Split binary based Boot
	  Flow (eg: am65, j721e). This option is not used on other
	  TI K3 devices.

	  The sysfw binary name must match with the TI K3 SoC boot
	  ROM:

	  - General Purpose devices (gp)
	  - High Security - Field Securable devices (hs-fs)
	  - High Security - Security Enforcing devices (hs)

	  Or if the sysfw binary generated use a custom name.

	  If unsure, use the default sysfw.itb (symlink) generated by
	  binman.

endif
```

## boot/xboot/Config.in
```kconfig
config BR2_TARGET_XBOOT
	bool "xboot"
	depends on BR2_arm || BR2_x86_64
	select BR2_PACKAGE_SDL2
	help
	  The xboot not just a bootloader. It is a runtime environment
	  for many SOC chips. It has a lua virtual machine and powerful
	  2D graphic engine and may other furtures. Of course, It
	  can be running on linux, windows or other operate systems.

if BR2_TARGET_XBOOT
config BR2_TARGET_XBOOT_PLATFORM
	string "xboot platform name"
	default "arm32-sandbox
	help
	  One of xboot supported platform to be built.
endif
```
