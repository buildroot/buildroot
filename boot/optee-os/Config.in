## boot/xilinx-embeddedsw/Config.in
```kconfig
comment "xilinx-embeddedsw needs a bare metal toolchain for tuple microblazeel-xilinx-elf"
	depends on BR2_TOOLCHAIN_BARE_METAL_BUILDROOT_ARCH != "microblazeel-xilinx-elf"

config BR2_TARGET_XILINX_EMBEDDEDSW
	bool "xilinx-embeddedsw"
	depends on BR2_aarch64
	depends on BR2_TOOLCHAIN_BARE_METAL_BUILDROOT
	help
	  Build boot firmware applications from source for Xilinx
	  boards. Users can mix and match applications to be built
	  by xilinx-embeddedsw and applications to be copied by
	  xilinx-prebuilt. If a xilinx-embeddedsw application is
	  selected, it will be built and installed from the Xilinx
	  embeddedsw repo, and it will not be copied from the
	  xilinx-prebuilt repo.

	  Applications can be found on the Xilinx embeddedsw repo:
	  https://github.com/Xilinx/embeddedsw/tree/master/lib/sw_apps

if BR2_TARGET_XILINX_EMBEDDEDSW

config BR2_TARGET_XILINX_EMBEDDEDSW_VERSION
	string "xilinx-embeddedsw version"
	default "xilinx_v2024.2"
	help
	  Release version of Xilinx/embeddedsw.
	  Must be xilinx_v2023.1 or newer.

config BR2_TARGET_XILINX_EMBEDDEDSW_VERSAL_PLM
	bool "versal plm"
	help
	  Build versal plm application from Xilinx/embeddedsw repo.
	  If selected, the xilinx-prebuilt package will not install
	  the plm.elf since it will come from the xilinx-embeddedsw
	  package.

	  https://github.com/Xilinx/embeddedsw/tree/master/lib/sw_apps/versal_plm

config BR2_TARGET_XILINX_EMBEDDEDSW_VERSAL_PSMFW
	bool "versal psmfw"
	help
	  Build versal psmfw application from Xilinx/embeddedsw repo.
	  If selected, the xilinx-prebuilt package will not install
	  the psmfw.elf since it will come from the xilinx-embeddedsw
	  package.

	  https://github.com/Xilinx/embeddedsw/tree/master/lib/sw_apps/versal_psmfw

config BR2_TARGET_XILINX_EMBEDDEDSW_ZYNQMP_PMUFW
	bool "zynqmp pmufw"
	help
	  Build zynqmp pmufw application from Xilinx/embeddedsw repo.
	  If selected, the xilinx-prebuilt package will not install
	  the pmufw.elf since it will come from the xilinx-embeddedsw
	  package.

	  https://github.com/Xilinx/embeddedsw/tree/master/lib/sw_apps/zynqmp_pmufw

config BR2_TARGET_XILINX_EMBEDDEDSW_ZYNQMP_PMUFW_USER_CFLAGS
	string "xilinx-embeddedsw optional zynqmp_pmufw user cflags"
	depends on BR2_TARGET_XILINX_EMBEDDEDSW_ZYNQMP_PMUFW
	help
	  Add optional cflags when building xilinx zynqmp_pmufw.

	  Example cflag options can be found here:
	  https://github.com/Xilinx/embeddedsw/blob/master/lib/sw_apps/zynqmp_pmufw/src/xpfw_config.h

endif # BR2_TARGET_XILINX_EMBEDDEDSW
```

## boot/xilinx-prebuilt/Config.in
```kconfig
menuconfig BR2_TARGET_XILINX_PREBUILT
	bool "xilinx-prebuilt"
	help
	  Pre-built firmware files for Xilinx boards.

	  The pre-built firmware applications will only be installed
	  if they are not being built by the xilinx-embeddedsw
	  package.

	  Users can mix and match applications to build with
	  xilinx-embeddedsw and applications to simply install with
	  xilinx-prebuilt.

	  https://github.com/Xilinx/soc-prebuilt-firmware

if BR2_TARGET_XILINX_PREBUILT

config BR2_TARGET_XILINX_PREBUILT_VERSION
	string "prebuilt version"
	default "xilinx_v2025.2"
	help
	  Release version of Xilinx firmware.
	  Must be xilinx_v2023.1 or newer.

choice
	bool "family variant"
	default BR2_TARGET_XILINX_PREBUILT_VERSAL if BR2_PACKAGE_VERSAL_FIRMWARE  # legacy
	default BR2_TARGET_XILINX_PREBUILT_VERSAL if BR2_cortex_a72
	default BR2_TARGET_XILINX_PREBUILT_VERSAL2 if BR2_cortex_a78
	default BR2_TARGET_XILINX_PREBUILT_ZYNQMP

config BR2_TARGET_XILINX_PREBUILT_ZYNQMP
	bool "zynqmp"
	depends on BR2_cortex_a53

config BR2_TARGET_XILINX_PREBUILT_KRIA
	bool "kria"
	depends on BR2_cortex_a53

config BR2_TARGET_XILINX_PREBUILT_VERSAL
	bool "versal"
	depends on BR2_cortex_a72

config BR2_TARGET_XILINX_PREBUILT_VERSAL2
	bool "versal2"
	depends on BR2_cortex_a78
	help
	  Version must be xilinx_v2025.2 or newer.

endchoice

config BR2_TARGET_XILINX_PREBUILT_VERSAL_XSA
	bool "download a prebuilt Versal XSA"
	depends on BR2_TARGET_XILINX_PREBUILT_VERSAL || BR2_TARGET_XILINX_PREBUILT_VERSAL2
	help
	  The Xilinx Support Archive (XSA) provides custom Xilinx
	  firmware files generated by the AMD Vivado Design Suite.
	  This option applies to either versal or versal2.

	  https://docs.amd.com/r/en-US/ug1400-vitis-embedded/Creating-a-Hardware-Design-XSA-File

if BR2_TARGET_XILINX_PREBUILT_VERSAL_XSA

config BR2_TARGET_XILINX_PREBUILT_VERSAL_XSA_LOCATION
	string "URL of custom XSA"
	help
	  This option allows to specify a URL pointing to an XSA source
	  file. This URL can use any protocol recognized by Buildroot,
	  like http://, ftp://, file:// or scp://.

	  When pointing to a local XSA using file:// or simply the
	  local path, you may want to use a make variable like
	  $(TOPDIR) to reference the root of the Buildroot tree.

	  This option applies to either versal or versal2.

endif # BR2_TARGET_XILINX_PREBUILT_VERSAL_XSA

config BR2_TARGET_XILINX_PREBUILT_VERSAL_PLD_PDI
	bool "install versal pld.pdi"
	depends on BR2_TARGET_XILINX_PREBUILT_VERSAL || BR2_TARGET_XILINX_PREBUILT_VERSAL2
	help
	  When using the Versal Segmented Configuration, there is a
	  pld.pdi file containing the FPGA bitstream which can be
	  loaded at run-time.  By enabling this option, the pld.pdi
	  will be installed to the target /lib/firmware/xilinx dir.
	  This option applies to either versal or versal2.

config BR2_TARGET_XILINX_PREBUILT_FAMILY
	string
	default "zynqmp" if BR2_TARGET_XILINX_PREBUILT_ZYNQMP
	default "kria" if BR2_TARGET_XILINX_PREBUILT_KRIA
	default "versal" if BR2_TARGET_XILINX_PREBUILT_VERSAL
	default "versal_2ve_2vm" if BR2_TARGET_XILINX_PREBUILT_VERSAL2

config BR2_TARGET_XILINX_PREBUILT_BOARD
	string "board name"
	default "zcu102" if BR2_TARGET_XILINX_PREBUILT_ZYNQMP
	default "kr260" if BR2_TARGET_XILINX_PREBUILT_KRIA
	default "vck190" if BR2_TARGET_XILINX_PREBUILT_VERSAL
	default "vek385" if BR2_TARGET_XILINX_PREBUILT_VERSAL2
	help
	  Name of Xilinx target board.
	  Used for installing the appropriate firmware.

endif # BR2_TARGET_XILINX_PREBUILT
```

## configs/aarch64_efi_defconfig
```kconfig
BR2_aarch64=y
BR2_PACKAGE_HOST_LINUX_HEADERS_CUSTOM_6_11=y
BR2_GLOBAL_PATCH_DIR="board/aarch64-efi/patches"
BR2_DOWNLOAD_FORCE_CHECK_HASHES=y
BR2_ROOTFS_DEVICE_CREATION_DYNAMIC_EUDEV=y
BR2_ROOTFS_POST_IMAGE_SCRIPT="board/aarch64-efi/post-image.sh support/scripts/genimage.sh"
BR2_ROOTFS_POST_SCRIPT_ARGS="-c board/aarch64-efi/genimage-efi.cfg"
BR2_LINUX_KERNEL=y
BR2_LINUX_KERNEL_CUSTOM_VERSION=y
BR2_LINUX_KERNEL_CUSTOM_VERSION_VALUE="6.11.11"
BR2_LINUX_KERNEL_USE_ARCH_DEFAULT_CONFIG=y
BR2_LINUX_KERNEL_NEEDS_HOST_OPENSSL=y
BR2_LINUX_KERNEL_NEEDS_HOST_PYTHON3=y
BR2_TARGET_ROOTFS_EXT2=y
BR2_TARGET_ROOTFS_EXT2_4=y
BR2_TARGET_ROOTFS_EXT2_SIZE="200M"
# BR2_TARGET_ROOTFS_TAR is not set
BR2_TARGET_GRUB2=y
BR2_PACKAGE_HOST_DOSFSTOOLS=y
BR2_PACKAGE_HOST_GENIMAGE=y
BR2_PACKAGE_HOST_MTOOLS=y
```

## configs/acmesystems_acqua_a5_512mb_defconfig
```kconfig
BR2_arm=y
BR2_cortex_a5=y
BR2_ARM_ENABLE_VFP=y
BR2_ARM_INSTRUCTIONS_THUMB2=y
BR2_PACKAGE_HOST_LINUX_HEADERS_CUSTOM_6_1=y
BR2_SYSTEM_DHCP="eth0"
BR2_ROOTFS_POST_IMAGE_SCRIPT="support/scripts/genimage.sh"
BR2_ROOTFS_POST_SCRIPT_ARGS="-c board/acmesystems/acqua-a5/genimage.cfg"
BR2_LINUX_KERNEL=y
BR2_LINUX_KERNEL_CUSTOM_VERSION=y
BR2_LINUX_KERNEL_CUSTOM_VERSION_VALUE="6.1.27"
BR2_LINUX_KERNEL_DEFCONFIG="sama5"
BR2_LINUX_KERNEL_DTS_SUPPORT=y
BR2_LINUX_KERNEL_CUSTOM_DTS_PATH="board/acmesystems/acqua-a5/at91-sama5d3_acqua.dts"
BR2_LINUX_KERNEL_NEEDS_HOST_OPENSSL=y
BR2_TARGET_ROOTFS_EXT2=y
BR2_TARGET_ROOTFS_EXT2_4=y
# BR2_TARGET_ROOTFS_TAR is not set
BR2_TARGET_AT91BOOTSTRAP3=y
BR2_TARGET_AT91BOOTSTRAP3_CUSTOM_GIT=y
BR2_TARGET_AT91BOOTSTRAP3_CUSTOM_REPO_URL="https://github.com/linux4sam/at91bootstrap.git"
BR2_TARGET_AT91BOOTSTRAP3_CUSTOM_REPO_VERSION="v3.10.3"
BR2_TARGET_AT91BOOTSTRAP3_DEFCONFIG="acqua-512m"
BR2_PACKAGE_HOST_DOSFSTOOLS=y
BR2_PACKAGE_HOST_GENIMAGE=y
BR2_PACKAGE_HOST_MTOOLS=y
```

## configs/acmesystems_aria_g25_128mb_defconfig
```kconfig
BR2_arm=y
BR2_PACKAGE_HOST_LINUX_HEADERS_CUSTOM_4_19=y
BR2_GLOBAL_PATCH_DIR="board/acmesystems/aria-g25/patches"
BR2_DOWNLOAD_FORCE_CHECK_HASHES=y
BR2_TARGET_GENERIC_ISSUE="Welcome to Aria-G25 Buildroot"
BR2_TARGET_GENERIC_GETTY_PORT="ttyS0"
BR2_TARGET_GENERIC_GETTY_BAUDRATE_115200=y
BR2_ROOTFS_POST_IMAGE_SCRIPT="support/scripts/genimage.sh"
BR2_ROOTFS_POST_SCRIPT_ARGS="-c board/acmesystems/aria-g25/genimage.cfg"
BR2_LINUX_KERNEL=y
BR2_LINUX_KERNEL_CUSTOM_VERSION=y
BR2_LINUX_KERNEL_CUSTOM_VERSION_VALUE="4.19.315"
BR2_LINUX_KERNEL_DEFCONFIG="at91_dt"
BR2_LINUX_KERNEL_DTS_SUPPORT=y
BR2_LINUX_KERNEL_INTREE_DTS_NAME="at91-ariag25"
BR2_LINUX_KERNEL_NEEDS_HOST_OPENSSL=y
BR2_TARGET_ROOTFS_EXT2=y
BR2_TARGET_ROOTFS_EXT2_4=y
BR2_TARGET_AT91BOOTSTRAP3=y
BR2_TARGET_AT91BOOTSTRAP3_CUSTOM_GIT=y
BR2_TARGET_AT91BOOTSTRAP3_CUSTOM_REPO_URL="https://github.com/linux4sam/at91bootstrap.git"
BR2_TARGET_AT91BOOTSTRAP3_CUSTOM_REPO_VERSION="v3.10.3"
BR2_TARGET_AT91BOOTSTRAP3_DEFCONFIG="aria-128m"
BR2_PACKAGE_HOST_DOSFSTOOLS=y
BR2_PACKAGE_HOST_GENIMAGE=y
BR2_PACKAGE_HOST_MTOOLS=y
```

## configs/andes_ae350_45_defconfig
```kconfig
BR2_riscv=y
BR2_RISCV_ISA_RVC=y
BR2_PACKAGE_HOST_LINUX_HEADERS_CUSTOM_6_0=y
BR2_GLOBAL_PATCH_DIR="board/andes/ae350/patches"
BR2_TARGET_GENERIC_GETTY_PORT="ttyS0"
BR2_ROOTFS_OVERLAY="board/andes/ae350/rootfs_overlay"
BR2_ROOTFS_POST_BUILD_SCRIPT="board/andes/ae350/post-build.sh"
BR2_ROOTFS_POST_IMAGE_SCRIPT="support/scripts/genimage.sh"
BR2_ROOTFS_POST_SCRIPT_ARGS="-c board/andes/ae350/genimage_sdcard.cfg"
BR2_LINUX_KERNEL=y
BR2_LINUX_KERNEL_CUSTOM_TARBALL=y
BR2_LINUX_KERNEL_CUSTOM_TARBALL_LOCATION="$(call github,andestech,linux,v6.0.y_ae350-ax45mp)/linux-v6.0.y_ae350-ax45mp.tar.gz"
BR2_LINUX_KERNEL_DEFCONFIG="ae350_ax45mp"
BR2_LINUX_KERNEL_DTS_SUPPORT=y
BR2_LINUX_KERNEL_INTREE_DTS_NAME="andes/ae350_ax45mp"
BR2_TARGET_ROOTFS_EXT2=y
BR2_TARGET_ROOTFS_EXT2_4=y
# BR2_TARGET_ROOTFS_TAR is not set
BR2_TARGET_OPENSBI=y
BR2_TARGET_OPENSBI_CUSTOM_TARBALL=y
BR2_TARGET_OPENSBI_CUSTOM_TARBALL_LOCATION="$(call github,riscv,opensbi,22f38ee6c658a660083aa45c4ec6c72f66a17260)/opensbi-22f38ee6c658a660083aa45c4ec6c72f66a17260.tar.gz"
BR2_TARGET_OPENSBI_PLAT="andes/ae350"
# BR2_TARGET_OPENSBI_INSTALL_JUMP_IMG is not set
BR2_TARGET_UBOOT=y
BR2_TARGET_UBOOT_BUILD_SYSTEM_KCONFIG=y
BR2_TARGET_UBOOT_CUSTOM_TARBALL=y
BR2_TARGET_UBOOT_CUSTOM_TARBALL_LOCATION="$(call github,u-boot,u-boot,a5dfa3b8a0f7ad555495bad1386613d2de4ba619)/u-boot-a5dfa3b8a0f7ad555495bad1386613d2de4ba619.tar.gz"
BR2_TARGET_UBOOT_BOARD_DEFCONFIG="ae350_rv64_spl_xip"
BR2_TARGET_UBOOT_CONFIG_FRAGMENT_FILES="board/andes/ae350/uboot.config.fragment"
BR2_TARGET_UBOOT_NEEDS_PYLIBFDT=y
BR2_TARGET_UBOOT_NEEDS_OPENSSL=y
BR2_TARGET_UBOOT_NEEDS_OPENSBI=y
# BR2_TARGET_UBOOT_FORMAT_BIN is not set
BR2_TARGET_UBOOT_FORMAT_CUSTOM=y
BR2_TARGET_UBOOT_FORMAT_CUSTOM_NAME="u-boot.itb"
BR2_TARGET_UBOOT_SPL=y
BR2_PACKAGE_HOST_DOSFSTOOLS=y
BR2_PACKAGE_HOST_GENIMAGE=y
BR2_PACKAGE_HOST_MTOOLS=y
```

## configs/arm_foundationv8_defconfig
```kconfig
BR2_aarch64=y
BR2_PACKAGE_HOST_LINUX_HEADERS_CUSTOM_6_12=y
BR2_GLOBAL_PATCH_DIR="board/arm/foundation-v8/patches"
BR2_DOWNLOAD_FORCE_CHECK_HASHES=y
BR2_TARGET_GENERIC_GETTY_PORT="ttyAMA0"
BR2_LINUX_KERNEL=y
BR2_LINUX_KERNEL_CUSTOM_VERSION=y
BR2_LINUX_KERNEL_CUSTOM_VERSION_VALUE="6.12.15"
BR2_LINUX_KERNEL_USE_ARCH_DEFAULT_CONFIG=y
BR2_LINUX_KERNEL_DTS_SUPPORT=y
BR2_LINUX_KERNEL_INTREE_DTS_NAME="arm/foundation-v8-gicv3-psci"
BR2_LINUX_KERNEL_NEEDS_HOST_OPENSSL=y
BR2_LINUX_KERNEL_NEEDS_HOST_PYTHON3=y
BR2_TARGET_ROOTFS_EXT2=y
BR2_TARGET_ROOTFS_EXT2_SIZE="128M"
# BR2_TARGET_ROOTFS_TAR is not set
BR2_TARGET_BOOT_WRAPPER_AARCH64=y
BR2_TARGET_BOOT_WRAPPER_AARCH64_DTS="arm/foundation-v8-gicv3-psci"
BR2_TARGET_BOOT_WRAPPER_AARCH64_BOOTARGS="root=/dev/vda consolelog=9 console=ttyAMA0 rw"
BR2_TARGET_BOOT_WRAPPER_AARCH64_PSCI=y
BR2_TARGET_BOOT_WRAPPER_AARCH64_GICV3=y
```

## configs/arm_fvp_ebbr_defconfig
```kconfig
BR2_aarch64=y
BR2_TOOLCHAIN_EXTERNAL=y
BR2_TOOLCHAIN_EXTERNAL_BOOTLIN=y
BR2_TOOLCHAIN_EXTERNAL_BOOTLIN_AARCH64_GLIBC_STABLE=y
BR2_GLOBAL_PATCH_DIR="board/arm/fvp-ebbr/patches"
BR2_DOWNLOAD_FORCE_CHECK_HASHES=y
BR2_ROOTFS_DEVICE_CREATION_DYNAMIC_EUDEV=y
BR2_SYSTEM_DHCP="eth0"
BR2_ROOTFS_POST_IMAGE_SCRIPT="board/arm/fvp-ebbr/post-image.sh support/scripts/genimage.sh"
BR2_ROOTFS_POST_SCRIPT_ARGS="-c board/arm/fvp-ebbr/genimage.cfg"
BR2_LINUX_KERNEL=y
BR2_LINUX_KERNEL_CUSTOM_VERSION=y
BR2_LINUX_KERNEL_CUSTOM_VERSION_VALUE="6.18"
BR2_LINUX_KERNEL_USE_ARCH_DEFAULT_CONFIG=y
BR2_LINUX_KERNEL_NEEDS_HOST_OPENSSL=y
BR2_LINUX_KERNEL_NEEDS_HOST_PYTHON3=y
BR2_PACKAGE_OPTEE_CLIENT=y
BR2_TARGET_ROOTFS_EXT2=y
BR2_TARGET_ROOTFS_EXT2_4=y
BR2_TARGET_ROOTFS_EXT2_SIZE="200M"
# BR2_TARGET_ROOTFS_TAR is not set
BR2_TARGET_ARM_TRUSTED_FIRMWARE=y
BR2_TARGET_ARM_TRUSTED_FIRMWARE_CUSTOM_VERSION=y
BR2_TARGET_ARM_TRUSTED_FIRMWARE_CUSTOM_VERSION_VALUE="v2.14.0"
BR2_TARGET_ARM_TRUSTED_FIRMWARE_PLATFORM="fvp"
BR2_TARGET_ARM_TRUSTED_FIRMWARE_CUSTOM_DTS_PATH="board/arm/fvp-ebbr/fvp-ebbr.dts"
BR2_TARGET_ARM_TRUSTED_FIRMWARE_FIP=y
BR2_TARGET_ARM_TRUSTED_FIRMWARE_BL32_OPTEE=y
BR2_TARGET_ARM_TRUSTED_FIRMWARE_UBOOT_AS_BL33=y
BR2_TARGET_ARM_TRUSTED_FIRMWARE_ADDITIONAL_VARIABLES="ARM_TSP_RAM_LOCATION=tdram FVP_DT_PREFIX=fvp-ebbr"
BR2_TARGET_ARM_TRUSTED_FIRMWARE_NEEDS_DTC=y
BR2_TARGET_GRUB2=y
BR2_TARGET_GRUB2_BUILTIN_MODULES_EFI="boot efi_gop efifwsetup efinet efitextmode ext2 fat halt help linux lsefi lsefimmap lsefisystab minicmd normal part_gpt part_msdos reboot squash4"
BR2_TARGET_OPTEE_OS=y
BR2_TARGET_OPTEE_OS_CUSTOM_VERSION=y
BR2_TARGET_OPTEE_OS_CUSTOM_VERSION_VALUE="4.8.0"
BR2_TARGET_OPTEE_OS_NEEDS_PYTHON_CRYPTOGRAPHY=y
BR2_TARGET_OPTEE_OS_PLATFORM="vexpress-fvp"
BR2_TARGET_OPTEE_OS_ADDITIONAL_VARIABLES="CFG_ARM_GICV3=y CFG_TEE_CORE_LOG_LEVEL=2 CFG_TEE_TA_LOG_LEVEL=2"
BR2_TARGET_UBOOT=y
BR2_TARGET_UBOOT_BUILD_SYSTEM_KCONFIG=y
BR2_TARGET_UBOOT_CUSTOM_VERSION=y
BR2_TARGET_UBOOT_CUSTOM_VERSION_VALUE="2025.10"
BR2_TARGET_UBOOT_BOARD_DEFCONFIG="vexpress_fvp"
BR2_TARGET_UBOOT_CONFIG_FRAGMENT_FILES="board/arm/fvp-ebbr/u-boot.fragment"
BR2_TARGET_UBOOT_NEEDS_OPENSSL=y
BR2_TARGET_UBOOT_NEEDS_GNUTLS=y
BR2_PACKAGE_HOST_DOSFSTOOLS=y
BR2_PACKAGE_HOST_GENIMAGE=y
BR2_PACKAGE_HOST_MTOOLS=y
```

## configs/armadeus_apf27_defconfig
```kconfig
BR2_arm=y
BR2_PACKAGE_HOST_LINUX_HEADERS_CUSTOM_5_10=y
BR2_GLOBAL_PATCH_DIR="board/armadeus/patches"
BR2_DOWNLOAD_FORCE_CHECK_HASHES=y
BR2_TARGET_GENERIC_HOSTNAME="apf27"
BR2_TARGET_GENERIC_ISSUE="Welcome to Armadeus development platform !"
BR2_TARGET_GENERIC_GETTY_PORT="ttymxc0"
BR2_LINUX_KERNEL=y
BR2_LINUX_KERNEL_CUSTOM_VERSION=y
BR2_LINUX_KERNEL_CUSTOM_VERSION_VALUE="5.10.215"
BR2_LINUX_KERNEL_USE_CUSTOM_CONFIG=y
BR2_LINUX_KERNEL_CUSTOM_CONFIG_FILE="board/armadeus/apf27/linux-5.10.config"
BR2_LINUX_KERNEL_UIMAGE=y
BR2_LINUX_KERNEL_UIMAGE_LOADADDR="0xA0008000"
BR2_LINUX_KERNEL_DTS_SUPPORT=y
BR2_LINUX_KERNEL_INTREE_DTS_NAME="imx27-apf27dev"
BR2_LINUX_KERNEL_NEEDS_HOST_OPENSSL=y
BR2_TARGET_ROOTFS_UBI=y
BR2_TARGET_ROOTFS_UBIFS_MAXLEBCNT=2047
BR2_TARGET_UBOOT=y
BR2_TARGET_UBOOT_BUILD_SYSTEM_KCONFIG=y
BR2_TARGET_UBOOT_CUSTOM_VERSION=y
BR2_TARGET_UBOOT_CUSTOM_VERSION_VALUE="2018.09"
BR2_TARGET_UBOOT_BOARD_DEFCONFIG="apf27"
```
