## configs/hifive_unmatched_defconfig
```kconfig
BR2_riscv=y
BR2_riscv_custom=y
BR2_RISCV_ISA_RVM=y
BR2_RISCV_ISA_RVA=y
BR2_RISCV_ISA_RVF=y
BR2_RISCV_ISA_RVD=y
BR2_RISCV_ISA_RVC=y
BR2_PACKAGE_HOST_LINUX_HEADERS_CUSTOM_6_12=y
BR2_GLOBAL_PATCH_DIR="board/sifive/hifive-unmatched/patches"
BR2_DOWNLOAD_FORCE_CHECK_HASHES=y
BR2_TARGET_GENERIC_GETTY_PORT="ttySIF0"
BR2_SYSTEM_DHCP="eth0"
BR2_ROOTFS_POST_BUILD_SCRIPT="board/sifive/common/post-build.sh"
BR2_ROOTFS_POST_IMAGE_SCRIPT="support/scripts/genimage.sh"
BR2_ROOTFS_POST_SCRIPT_ARGS="-c board/sifive/common/genimage_sdcard.cfg"
BR2_LINUX_KERNEL=y
BR2_LINUX_KERNEL_CUSTOM_VERSION=y
BR2_LINUX_KERNEL_CUSTOM_VERSION_VALUE="6.12.20"
BR2_LINUX_KERNEL_USE_ARCH_DEFAULT_CONFIG=y
BR2_LINUX_KERNEL_CONFIG_FRAGMENT_FILES="board/sifive/common/linux.config.fragment"
BR2_LINUX_KERNEL_DTS_SUPPORT=y
BR2_LINUX_KERNEL_INTREE_DTS_NAME="sifive/hifive-unmatched-a00"
BR2_LINUX_KERNEL_INSTALL_TARGET=y
BR2_TARGET_ROOTFS_CPIO=y
BR2_TARGET_ROOTFS_EXT2=y
BR2_TARGET_ROOTFS_EXT2_4=y
BR2_TARGET_OPENSBI=y
BR2_TARGET_OPENSBI_CUSTOM_VERSION=y
BR2_TARGET_OPENSBI_CUSTOM_VERSION_VALUE="1.2"
BR2_TARGET_OPENSBI_PLAT="generic"
BR2_TARGET_UBOOT=y
BR2_TARGET_UBOOT_BUILD_SYSTEM_KCONFIG=y
BR2_TARGET_UBOOT_CUSTOM_VERSION=y
BR2_TARGET_UBOOT_CUSTOM_VERSION_VALUE="2025.01"
BR2_TARGET_UBOOT_BOARD_DEFCONFIG="sifive_unmatched"
BR2_TARGET_UBOOT_NEEDS_DTC=y
BR2_TARGET_UBOOT_NEEDS_PYLIBFDT=y
BR2_TARGET_UBOOT_NEEDS_OPENSSL=y
BR2_TARGET_UBOOT_NEEDS_GNUTLS=y
BR2_TARGET_UBOOT_NEEDS_OPENSBI=y
BR2_TARGET_UBOOT_FORMAT_CUSTOM=y
BR2_TARGET_UBOOT_FORMAT_CUSTOM_NAME="u-boot.itb"
BR2_TARGET_UBOOT_SPL=y
BR2_PACKAGE_HOST_GENIMAGE=y
BR2_PACKAGE_HOST_UBOOT_TOOLS=y
BR2_PACKAGE_HOST_UBOOT_TOOLS_BOOT_SCRIPT=y
BR2_PACKAGE_HOST_UBOOT_TOOLS_BOOT_SCRIPT_SOURCE="board/sifive/hifive-unmatched/boot.cmd"
```

## configs/homecast_wpe_defconfig
```kconfig
BR2_mipsel=y
# BR2_MIPS_SOFT_FLOAT is not set
BR2_CCACHE=y
BR2_TOOLCHAIN_EXTERNAL=y
BR2_TOOLCHAIN_EXTERNAL_PATH="/opt/toolchain/homecast/"
BR2_TOOLCHAIN_EXTERNAL_CUSTOM_PREFIX="mipsel-buildroot-linux-uclibc"
BR2_TOOLCHAIN_EXTERNAL_GCC_5=y
BR2_TOOLCHAIN_EXTERNAL_HEADERS_3_3=y
BR2_TOOLCHAIN_EXTERNAL_WCHAR=y
BR2_TOOLCHAIN_EXTERNAL_HAS_SSP=y
BR2_TOOLCHAIN_EXTERNAL_INET_RPC=y
BR2_TOOLCHAIN_EXTERNAL_CXX=y
BR2_PACKAGE_HOST_GDB=y
BR2_TARGET_GENERIC_HOSTNAME="homecast"
BR2_TARGET_GENERIC_ISSUE="Welcome to Homecast"
BR2_TARGET_GENERIC_CABUNDLE=y
BR2_ROOTFS_DEVICE_CREATION_STATIC=y
BR2_ROOTFS_POST_IMAGE_SCRIPT="board/homecast/homecast.sh"
BR2_PACKAGE_BUSYBOX_SMP=y
BR2_PACKAGE_GSTREAMER1=y
BR2_PACKAGE_GST1_BCM=y
# BR2_PACKAGE_GST1_BCM_VP9_SUPPORT is not set
BR2_PACKAGE_GST1_PLUGINS_BASE_PLUGIN_APP=y
BR2_PACKAGE_GST1_PLUGINS_BASE_PLUGIN_VIDEOCONVERT=y
BR2_PACKAGE_GST1_PLUGINS_BASE_PLUGIN_GIO=y
BR2_PACKAGE_GST1_PLUGINS_BASE_PLUGIN_OPUS=y
BR2_PACKAGE_GST1_PLUGINS_GOOD_PLUGIN_AUDIOFX=y
BR2_PACKAGE_GST1_PLUGINS_GOOD_PLUGIN_AUDIOPARSERS=y
BR2_PACKAGE_GST1_PLUGINS_GOOD_PLUGIN_AUTODETECT=y
BR2_PACKAGE_GST1_PLUGINS_GOOD_PLUGIN_DEINTERLACE=y
BR2_PACKAGE_GST1_PLUGINS_GOOD_PLUGIN_ICYDEMUX=y
BR2_PACKAGE_GST1_PLUGINS_GOOD_PLUGIN_ID3DEMUX=y
BR2_PACKAGE_GST1_PLUGINS_GOOD_PLUGIN_INTERLEAVE=y
BR2_PACKAGE_GST1_PLUGINS_GOOD_PLUGIN_MATROSKA=y
BR2_PACKAGE_GST1_PLUGINS_GOOD_PLUGIN_SOUPHTTPSRC=y
BR2_PACKAGE_GST1_PLUGINS_BAD_PLUGIN_MPEGTSDEMUX=y
BR2_PACKAGE_GST1_PLUGINS_BAD_PLUGIN_VIDEOPARSERS=y
BR2_PACKAGE_GST1_PLUGINS_BAD_PLUGIN_DASH=y
# BR2_PACKAGE_GST1_PLUGINS_BAD_PLUGIN_FAAD is not set
BR2_PACKAGE_GST1_PLUGINS_BAD_PLUGIN_HLS=y
BR2_PACKAGE_GST1_PLUGINS_BAD_PLUGIN_OPUS=y
BR2_PACKAGE_GST1_PLUGINS_BAD_PLUGIN_SMOOTHSTREAMING=y
BR2_PACKAGE_GST1_PLUGINS_UGLY=y
BR2_PACKAGE_GST1_PLUGINS_UGLY_PLUGIN_MPG123=y
BR2_PACKAGE_NINJA=y
BR2_PACKAGE_BITSTREAM_VERA=y
BR2_PACKAGE_HOMECAST_SDK=y
BR2_PACKAGE_JPEG_TURBO=y
BR2_PACKAGE_LIBMNG=y
BR2_PACKAGE_WEBP=y
BR2_PACKAGE_WPEFRAMEWORK=y
BR2_PACKAGE_WPEFRAMEWORK_PERSISTENT_PATH="/tmp/nfs/metrological/persistent"
BR2_PACKAGE_WPEFRAMEWORK_DATA_PATH="/tmp/nfs/metrological/usr/share/WPEFramework"
BR2_PACKAGE_WPEFRAMEWORK_SYSTEM_PATH="/tmp/nfs/metrological/usr/lib/wpeframework/plugins"
BR2_PACKAGE_WPEFRAMEWORK_PROXYSTUB_PATH="/tmp/nfs/metrological/usr/lib/wpeframework/proxystubs"
BR2_PACKAGE_WPEFRAMEWORK_TEST_LOADER=y
BR2_PACKAGE_WPEFRAMEWORK_VIRTUALINPUT=y
BR2_PACKAGE_WPEFRAMEWORK_LOCATIONSYNC=y
BR2_PACKAGE_WPEFRAMEWORK_MONITOR=y
# BR2_PACKAGE_WPEFRAMEWORK_CDMI is not set
BR2_PACKAGE_WPEFRAMEWORK_REMOTECONTROL=y
BR2_PACKAGE_WPEFRAMEWORK_REMOTECONTROL_KEYMAP="homecast.json"
BR2_PACKAGE_WPEFRAMEWORK_TIMESYNC=y
BR2_PACKAGE_WPEFRAMEWORK_TRACECONTROL=y
BR2_PACKAGE_WPEFRAMEWORK_WEBKITBROWSER=y
# BR2_PACKAGE_WPEFRAMEWORK_WEBKITBROWSER_AUTOSTART is not set
BR2_PACKAGE_WPEFRAMEWORK_WEBKITBROWSER_MEMORYPRESSURE="databaseprocess:50m,networkprocess:100m,webprocess:170m,rpcprocess:50m"
BR2_PACKAGE_WPEFRAMEWORK_WEBKITBROWSER_TRANSPARENT=y
BR2_PACKAGE_WPEFRAMEWORK_WEBSERVER=y
BR2_PACKAGE_WPEWEBKIT=y
# BR2_PACKAGE_WPEWEBKIT_USE_WEB_AUDIO is not set
# BR2_PACKAGE_WPEWEBKIT_USE_GSTREAMER_WEBKIT_HTTP_SRC is not set
BR2_PACKAGE_LIBXKBCOMMON=y
BR2_PACKAGE_ICU_USE_ICUDATA=y
BR2_PACKAGE_SHARED_MIME_INFO=y
BR2_PACKAGE_UTIL_LINUX_PIVOT_ROOT=y
```

## configs/horizon_v21_wpe_cisco_defconfig
```kconfig
BR2_x86_i686=y
BR2_CCACHE=y
BR2_SSP_ALL=y
BR2_TOOLCHAIN_EXTERNAL=y
BR2_TOOLCHAIN_EXTERNAL_CUSTOM=y
BR2_TOOLCHAIN_EXTERNAL_PATH="/opt/toolchain/horizon/"
BR2_TOOLCHAIN_EXTERNAL_CUSTOM_PREFIX="i686-buildroot-linux-gnu"
BR2_TOOLCHAIN_EXTERNAL_GCC_4_9=y
BR2_TOOLCHAIN_EXTERNAL_CUSTOM_GLIBC=y
BR2_TOOLCHAIN_EXTERNAL_CXX=y
BR2_ENABLE_LOCALE_PURGE=y
BR2_ENABLE_LOCALE_WHITELIST="C en_US"
BR2_TARGET_GENERIC_HOSTNAME="horizon"
BR2_TARGET_GENERIC_ISSUE="Welcome to Horizon"
BR2_TARGET_GENERIC_CABUNDLE=y
BR2_ROOTFS_DEVICE_CREATION_DYNAMIC_EUDEV=y
BR2_ROOTFS_POST_IMAGE_SCRIPT="board/intel/intelce/horizon-cisco.sh"
BR2_PACKAGE_BUSYBOX_SMP=y
BR2_PACKAGE_GSTREAMER1=y
# BR2_PACKAGE_GSTREAMER1_PARSE is not set
# BR2_PACKAGE_GSTREAMER1_TRACE is not set
# BR2_PACKAGE_GSTREAMER1_GST_DEBUG is not set
# BR2_PACKAGE_GSTREAMER1_PLUGIN_REGISTRY is not set
# BR2_PACKAGE_GSTREAMER1_INSTALL_TOOLS is not set
BR2_PACKAGE_GST1_PLUGINS_BASE_PLUGIN_APP=y
BR2_PACKAGE_GST1_PLUGINS_BASE_PLUGIN_VIDEOCONVERT=y
BR2_PACKAGE_GST1_PLUGINS_BASE_PLUGIN_GIO=y
BR2_PACKAGE_GST1_PLUGINS_GOOD_PLUGIN_AUDIOFX=y
BR2_PACKAGE_GST1_PLUGINS_GOOD_PLUGIN_AUDIOPARSERS=y
BR2_PACKAGE_GST1_PLUGINS_GOOD_PLUGIN_AUTODETECT=y
BR2_PACKAGE_GST1_PLUGINS_GOOD_PLUGIN_DEINTERLACE=y
BR2_PACKAGE_GST1_PLUGINS_GOOD_PLUGIN_INTERLEAVE=y
BR2_PACKAGE_GST1_PLUGINS_GOOD_PLUGIN_SOUPHTTPSRC=y
BR2_PACKAGE_GST1_PLUGINS_BAD_PLUGIN_MPEGTSDEMUX=y
BR2_PACKAGE_GST1_PLUGINS_BAD_PLUGIN_VIDEOPARSERS=y
BR2_PACKAGE_GST1_PLUGINS_BAD_PLUGIN_DASH=y
BR2_PACKAGE_GST1_PLUGINS_BAD_PLUGIN_SMOOTHSTREAMING=y
BR2_PACKAGE_GST1_PLUGINS_BAD_PLUGIN_HLS=y
BR2_PACKAGE_GST1_PLUGINS_UGLY=y
BR2_PACKAGE_GST1_PLUGINS_UGLY_PLUGIN_MPG123=y
BR2_PACKAGE_GST1_PLUGINS_DORNE=y
BR2_PACKAGE_NETFLIX=y
BR2_PACKAGE_NETFLIX_LIB=y
BR2_PACKAGE_NINJA=y
BR2_PACKAGE_PLAYREADY=y
BR2_PACKAGE_BITSTREAM_VERA=y
# BR2_PACKAGE_EUDEV_ENABLE_HWDB is not set
BR2_PACKAGE_HORIZON_SDK=y
BR2_PACKAGE_JPEG_TURBO=y
BR2_PACKAGE_WPE=y
BR2_PACKAGE_WPE_USE_PUNCH_HOLE_GSTREAMER=y
BR2_PACKAGE_LIBPROVISION=y
BR2_PACKAGE_ORC=y
BR2_PACKAGE_ICU_USE_ICUDATA=y
BR2_PACKAGE_SHARED_MIME_INFO=y
BR2_PACKAGE_GLUELOGIC_VIRTUAL_KEYBOARD=y
BR2_PACKAGE_WEBBRIDGE=y
BR2_PACKAGE_WEBBRIDGE_PERSISTENT_PATH="/NDS/wpe_resources/root"
BR2_PACKAGE_WEBBRIDGE_DATA_PATH="/NDS/wpe_resources/usr/share/webbridge"
BR2_PACKAGE_WEBBRIDGE_SYSTEM_PATH="/NDS/wpe_resources/usr/lib/webbridge"
BR2_PACKAGE_WEBBRIDGE_PROXYSTUB_PATH="/NDS/wpe_resources/usr/lib/webbridge/proxystubs"
BR2_PACKAGE_WEBBRIDGE_WEBSERVER_PATH="/NDS/wpe_resources/www"
BR2_PACKAGE_WEBBRIDGE_PLUGIN_TRACECONTROL=y
BR2_PACKAGE_WEBBRIDGE_PLUGIN_MONITOR=y
BR2_PACKAGE_WEBBRIDGE_PLUGIN_PROVISIONING=y
BR2_PACKAGE_WEBBRIDGE_PLUGIN_WEBPROXY=y
BR2_PACKAGE_WEBBRIDGE_PLUGIN_DEVICEINFO=y
BR2_PACKAGE_WEBBRIDGE_PLUGIN_NETFLIX=y
BR2_PACKAGE_WEBBRIDGE_PLUGIN_WEBKITBROWSER=y
# BR2_PACKAGE_WEBBRIDGE_PLUGIN_WEBKITBROWSER_AUTOSTART is not set
BR2_PACKAGE_WEBBRIDGE_PLUGIN_WEBKITBROWSER_MEMORYPROFILE="64m"
BR2_PACKAGE_WEBBRIDGE_PLUGIN_WEBKITBROWSER_MEMORYPRESSURE="databaseprocess:30m,networkprocess:30m,webprocess:120m,rpcprocess:30m"
BR2_PACKAGE_WEBBRIDGE_PLUGIN_QUEUECOMMUNICATOR=y
BR2_PACKAGE_WEBBRIDGE_PLUGIN_DIALSERVER=y
```

## configs/horizon_v21_wpe_defconfig
```kconfig
BR2_x86_i686=y
BR2_CCACHE=y
BR2_OPTIMIZE_2=y
BR2_TOOLCHAIN_EXTERNAL=y
BR2_TOOLCHAIN_EXTERNAL_CUSTOM=y
BR2_TOOLCHAIN_EXTERNAL_PATH="/opt/toolchain/horizon/"
BR2_TOOLCHAIN_EXTERNAL_CUSTOM_PREFIX="i686-buildroot-linux-gnu"
BR2_TOOLCHAIN_EXTERNAL_GCC_4_9=y
BR2_TOOLCHAIN_EXTERNAL_CUSTOM_GLIBC=y
BR2_TOOLCHAIN_EXTERNAL_CXX=y
BR2_ENABLE_LOCALE_PURGE=y
BR2_ENABLE_LOCALE_WHITELIST="C en_US"
BR2_TARGET_GENERIC_CABUNDLE=y
BR2_ROOTFS_DEVICE_CREATION_DYNAMIC_EUDEV=y
BR2_TARGET_GENERIC_ROOT_PASSWD="root"
BR2_TARGET_GENERIC_GETTY_PORT="ttyS0"
BR2_SYSTEM_DHCP="eth0"
BR2_LINUX_KERNEL=y
BR2_LINUX_KERNEL_CUSTOM_GIT=y
BR2_LINUX_KERNEL_CUSTOM_REPO_URL="git@github.com:Metrological/intelce-linux-2.6.git"
BR2_LINUX_KERNEL_CUSTOM_REPO_VERSION="horizon3.4"
BR2_LINUX_KERNEL_USE_CUSTOM_CONFIG=y
BR2_LINUX_KERNEL_CUSTOM_CONFIG_FILE="board/intel/intelce/linuxce-2.6.35.config"
BR2_PACKAGE_BUSYBOX_SMP=y
BR2_PACKAGE_GSTREAMER1=y
BR2_PACKAGE_GST1_PLUGINS_BASE_PLUGIN_APP=y
BR2_PACKAGE_GST1_PLUGINS_BASE_PLUGIN_VIDEOCONVERT=y
BR2_PACKAGE_GST1_PLUGINS_BASE_PLUGIN_GIO=y
BR2_PACKAGE_GST1_PLUGINS_GOOD_PLUGIN_AUDIOFX=y
BR2_PACKAGE_GST1_PLUGINS_GOOD_PLUGIN_AUDIOPARSERS=y
BR2_PACKAGE_GST1_PLUGINS_GOOD_PLUGIN_AUTODETECT=y
BR2_PACKAGE_GST1_PLUGINS_GOOD_PLUGIN_DEINTERLACE=y
BR2_PACKAGE_GST1_PLUGINS_GOOD_PLUGIN_INTERLEAVE=y
BR2_PACKAGE_GST1_PLUGINS_GOOD_PLUGIN_SOUPHTTPSRC=y
BR2_PACKAGE_GST1_PLUGINS_BAD_PLUGIN_MPEGTSDEMUX=y
BR2_PACKAGE_GST1_PLUGINS_BAD_PLUGIN_VIDEOPARSERS=y
BR2_PACKAGE_GST1_PLUGINS_BAD_PLUGIN_DASH=y
BR2_PACKAGE_GST1_PLUGINS_BAD_PLUGIN_SMOOTHSTREAMING=y
BR2_PACKAGE_GST1_PLUGINS_BAD_PLUGIN_HLS=y
BR2_PACKAGE_GST1_PLUGINS_UGLY=y
BR2_PACKAGE_GST1_PLUGINS_UGLY_PLUGIN_MPG123=y
BR2_PACKAGE_FLEX=y
BR2_PACKAGE_NINJA=y
BR2_PACKAGE_BITSTREAM_VERA=y
BR2_PACKAGE_WPE_LAUNCHER=y
# BR2_PACKAGE_EUDEV_ENABLE_HWDB is not set
BR2_PACKAGE_HORIZON_SDK=y
BR2_PACKAGE_OPENSSL=y
BR2_PACKAGE_JPEG_TURBO=y
BR2_PACKAGE_LIBDRM=y
BR2_PACKAGE_WPE=y
BR2_PACKAGE_WPE_USE_PUNCH_HOLE_GSTREAMER=y
BR2_PACKAGE_ORC=y
BR2_PACKAGE_ICU_USE_ICUDATA=y
BR2_PACKAGE_SHARED_MIME_INFO=y
BR2_PACKAGE_DROPBEAR=y
BR2_PACKAGE_GESFTPSERVER=y
BR2_TARGET_ROOTFS_INITRAMFS=y
```

## configs/horizon_v21_wpe_nf_yt_release_defconfig
```kconfig
BR2_x86_i686=y
BR2_CCACHE=y
BR2_SSP_ALL=y
BR2_TOOLCHAIN_EXTERNAL=y
BR2_TOOLCHAIN_EXTERNAL_CUSTOM=y
BR2_TOOLCHAIN_EXTERNAL_PATH="/opt/toolchain/horizon/"
BR2_TOOLCHAIN_EXTERNAL_CUSTOM_PREFIX="i686-buildroot-linux-gnu"
BR2_TOOLCHAIN_EXTERNAL_GCC_4_9=y
BR2_TOOLCHAIN_EXTERNAL_CUSTOM_GLIBC=y
BR2_TOOLCHAIN_EXTERNAL_CXX=y
BR2_PACKAGE_HOST_GDB=y
BR2_ENABLE_LOCALE_PURGE=y
BR2_ENABLE_LOCALE_WHITELIST="C en_US"
BR2_TARGET_GENERIC_CABUNDLE=y
BR2_ROOTFS_DEVICE_CREATION_DYNAMIC_EUDEV=y
BR2_ROOTFS_POST_IMAGE_SCRIPT="board/intel/intelce/horizon.sh"
BR2_PACKAGE_BUSYBOX_SMP=y
BR2_PACKAGE_GSTREAMER1=y
BR2_PACKAGE_GST1_PLUGINS_BASE_PLUGIN_APP=y
BR2_PACKAGE_GST1_PLUGINS_BASE_PLUGIN_VIDEOCONVERT=y
BR2_PACKAGE_GST1_PLUGINS_BASE_PLUGIN_GIO=y
BR2_PACKAGE_GST1_PLUGINS_GOOD_PLUGIN_AUDIOFX=y
BR2_PACKAGE_GST1_PLUGINS_GOOD_PLUGIN_AUDIOPARSERS=y
BR2_PACKAGE_GST1_PLUGINS_GOOD_PLUGIN_AUTODETECT=y
BR2_PACKAGE_GST1_PLUGINS_GOOD_PLUGIN_DEINTERLACE=y
BR2_PACKAGE_GST1_PLUGINS_GOOD_PLUGIN_ICYDEMUX=y
BR2_PACKAGE_GST1_PLUGINS_GOOD_PLUGIN_ID3DEMUX=y
BR2_PACKAGE_GST1_PLUGINS_GOOD_PLUGIN_INTERLEAVE=y
BR2_PACKAGE_GST1_PLUGINS_GOOD_PLUGIN_SOUPHTTPSRC=y
BR2_PACKAGE_GST1_PLUGINS_BAD_PLUGIN_MPEGTSDEMUX=y
BR2_PACKAGE_GST1_PLUGINS_BAD_PLUGIN_VIDEOPARSERS=y
BR2_PACKAGE_GST1_PLUGINS_BAD_PLUGIN_DASH=y
BR2_PACKAGE_GST1_PLUGINS_BAD_PLUGIN_HLS=y
BR2_PACKAGE_GST1_PLUGINS_BAD_PLUGIN_SMOOTHSTREAMING=y
BR2_PACKAGE_GST1_PLUGINS_UGLY=y
BR2_PACKAGE_GST1_PLUGINS_UGLY_PLUGIN_MPG123=y
BR2_PACKAGE_GST1_PLUGINS_DORNE=y
BR2_PACKAGE_NETFLIX=y
BR2_PACKAGE_NETFLIX_LIB=y
BR2_PACKAGE_NINJA=y
BR2_PACKAGE_PLAYREADY=y
BR2_PACKAGE_BITSTREAM_VERA=y
# BR2_PACKAGE_EUDEV_ENABLE_HWDB is not set
BR2_PACKAGE_HORIZON_SDK=y
BR2_PACKAGE_JPEG_TURBO=y
BR2_PACKAGE_WPE=y
BR2_PACKAGE_LIBXKBCOMMON=y
BR2_PACKAGE_LIBPROVISION=y
BR2_PACKAGE_ORC=y
BR2_PACKAGE_ICU_USE_ICUDATA=y
BR2_PACKAGE_SHARED_MIME_INFO=y
BR2_PACKAGE_GLUELOGIC_VIRTUAL_KEYBOARD=y
BR2_PACKAGE_WEBBRIDGE=y
BR2_PACKAGE_WEBBRIDGE_PERSISTENT_PATH="/NDS/metrological/root"
BR2_PACKAGE_WEBBRIDGE_DATA_PATH="/NDS/metrological/usr/share/webbridge"
BR2_PACKAGE_WEBBRIDGE_SYSTEM_PATH="/NDS/metrological/usr/lib/webbridge"
BR2_PACKAGE_WEBBRIDGE_PROXYSTUB_PATH="/NDS/metrological/usr/lib/webbridge/proxystubs"
BR2_PACKAGE_WEBBRIDGE_PLUGIN_TRACECONTROL=y
BR2_PACKAGE_WEBBRIDGE_PLUGIN_MONITOR=y
BR2_PACKAGE_WEBBRIDGE_PLUGIN_PROVISIONING=y
# BR2_PACKAGE_WEBBRIDGE_PLUGIN_PROVISIONING_AUTOPROVISION is not set
BR2_PACKAGE_WEBBRIDGE_PLUGIN_WEBPROXY=y
BR2_PACKAGE_WEBBRIDGE_PLUGIN_DEVICEINFO=y
BR2_PACKAGE_WEBBRIDGE_PLUGIN_NETFLIX=y
BR2_PACKAGE_WEBBRIDGE_PLUGIN_NETFLIX_AUTOSTART=y
BR2_PACKAGE_WEBBRIDGE_PLUGIN_NETFLIX_MODEL="Liberty Global_Horizon"
BR2_PACKAGE_WEBBRIDGE_PLUGIN_WEBKITBROWSER=y
BR2_PACKAGE_WEBBRIDGE_PLUGIN_WEBKITBROWSER_USERAGENT="Mozilla/5.0 (Macintosh, Intel Mac OS X 10_11_4) AppleWebKit/602.1.28+ (KHTML, like Gecko) Version/9.1 Safari/601.5.17 WPE-Horizon"
BR2_PACKAGE_WEBBRIDGE_PLUGIN_WEBKITBROWSER_MEMORYPRESSURE="databaseprocess:30m,networkprocess:50m,webprocess:170m,rpcprocess:50m"
BR2_PACKAGE_WEBBRIDGE_PLUGIN_WEBKITBROWSER_DISKCACHE="90m"
BR2_PACKAGE_WEBBRIDGE_PLUGIN_WEBKITBROWSER_XHRCACHE=y
BR2_PACKAGE_WEBBRIDGE_PLUGIN_YOUTUBE=y
BR2_PACKAGE_WEBBRIDGE_PLUGIN_QUEUECOMMUNICATOR=y
BR2_PACKAGE_WEBBRIDGE_PLUGIN_DIALSERVER=y
BR2_PACKAGE_WEBBRIDGE_PLUGIN_DIALSERVER_NAME="Horizon"
BR2_PACKAGE_WEBBRIDGE_PLUGIN_WEBSERVER=y
BR2_PACKAGE_WEBBRIDGE_PLUGIN_WEBSERVER_WEBPATH="/NDS/metrological/www"
```
