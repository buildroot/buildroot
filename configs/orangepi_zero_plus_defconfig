## configs/raspberrypi0_bridge_defconfig
```kconfig
BR2_arm=y
BR2_arm1176jzf_s=y
BR2_CCACHE=y
BR2_OPTIMIZE_2=y
BR2_TOOLCHAIN_BUILDROOT_VENDOR="domotica"
BR2_TOOLCHAIN_BUILDROOT_GLIBC=y
BR2_BINUTILS_VERSION_2_33_X=y
BR2_GCC_VERSION_9_X=y
BR2_TOOLCHAIN_BUILDROOT_CXX=y
BR2_PACKAGE_HOST_GDB=y
BR2_GDB_VERSION_8_3=y
BR2_TARGET_GENERIC_HOSTNAME="Domotica"
BR2_TARGET_GENERIC_ISSUE="Welcome to Domotica"
BR2_TARGET_GENERIC_ROOT_PASSWD="root"
BR2_TARGET_GENERIC_GETTY_PORT="ttyAMA0"
BR2_ROOTFS_POST_BUILD_SCRIPT="board/raspberrypi0/post-build.sh"
BR2_ROOTFS_POST_IMAGE_SCRIPT="board/raspberrypi0/post-image.sh"
BR2_ROOTFS_POST_SCRIPT_ARGS="--i2c --spi --1w --tvmode-720 --overclock-pi012 --silent"
BR2_LINUX_KERNEL=y
BR2_LINUX_KERNEL_CUSTOM_GIT=y
BR2_LINUX_KERNEL_CUSTOM_REPO_URL="https://github.com/raspberrypi/linux.git"
BR2_LINUX_KERNEL_CUSTOM_REPO_VERSION="rpi-5.10.y"
BR2_LINUX_KERNEL_PATCH="board/raspberrypi/0001-Adding-metrological-boot-logo.patch"
BR2_LINUX_KERNEL_USE_CUSTOM_CONFIG=y
BR2_LINUX_KERNEL_CUSTOM_CONFIG_FILE="board/raspberrypi/rpi0-linux-5.10.config"
BR2_LINUX_KERNEL_DTS_SUPPORT=y
BR2_LINUX_KERNEL_INTREE_DTS_NAME="bcm2708-rpi-b-plus bcm2708-rpi-zero-w bcm2708-rpi-zero bcm2708-rpi-b bcm2708-rpi-cm"
BR2_PACKAGE_BRIDGE_TOOLS=y
BR2_PACKAGE_BRIDGE=y
BR2_PACKAGE_BRIDGE_RELEASE=y
BR2_PACKAGE_BRIDGE_TEST_LOADER=y
BR2_PACKAGE_TEST_LINUXONEWIRE=y
BR2_PACKAGE_TEST_LINUXI2C=y
BR2_PACKAGE_TEST_LINUXSPI=y
BR2_PACKAGE_TEST_RASPIO=y
BR2_PACKAGE_BRIDGE_COMPOSITORCLIENT=y
BR2_PACKAGE_BRIDGE_PROVISIONPROXY=y
BR2_PACKAGE_BRIDGE_OPENCDM=y
BR2_PACKAGE_PLUGIN_COMMANDER=y
BR2_PACKAGE_PLUGIN_COMPOSITOR=y
BR2_PACKAGE_PLUGIN_COMPOSITOR_AUTOSTART=y
BR2_PACKAGE_PLUGIN_DIALSERVER=y
BR2_PACKAGE_PLUGIN_DEVICEINFO=y
BR2_PACKAGE_PLUGIN_DHCPSERVER=y
BR2_PACKAGE_PLUGIN_DISPLAYINFO=y
BR2_PACKAGE_PLUGIN_LAUNCHER=y
BR2_PACKAGE_PLUGIN_LOCATIONSYNC=y
BR2_PACKAGE_PLUGIN_LOCATIONSYNC_URI="http://jsonip.metrological.com/?maf=true"
BR2_PACKAGE_PLUGIN_MONITOR=y
BR2_PACKAGE_PLUGIN_NETWORKCONTROL=y
BR2_PACKAGE_PLUGIN_OPENCDMSERVER=y
BR2_PACKAGE_CDMI_CLEARKEY=y
BR2_PACKAGE_PLUGIN_TIMESYNC=y
BR2_PACKAGE_PLUGIN_PLAYERINFO=y
BR2_PACKAGE_PLUGIN_REMOTECONTROL=y
BR2_PACKAGE_PLUGIN_SNAPSHOT=y
BR2_PACKAGE_PLUGIN_TRACECONTROL=y
BR2_PACKAGE_PLUGIN_WEBKITBROWSER=y
# BR2_PACKAGE_PLUGIN_WEBKITBROWSER_AUTOSTART is not set
BR2_PACKAGE_PLUGIN_WEBPROXY=y
BR2_PACKAGE_PLUGIN_WEBSERVER=y
BR2_PACKAGE_PLUGIN_WEBSHELL=y
BR2_PACKAGE_PLUGIN_WIFI=y
BR2_PACKAGE_PLUGIN_BARN=y
BR2_PACKAGE_PLUGIN_BUTLER=y
BR2_PACKAGE_PLUGIN_I2CCONTROL=y
BR2_PACKAGE_PLUGIN_IOCONTROL=y
BR2_PACKAGE_PLUGIN_ONEWIRECONTROL=y
BR2_PACKAGE_PLUGIN_RADIOCONTROL=y
BR2_PACKAGE_PLUGIN_SCRIPTENGINE=y
BR2_PACKAGE_PLUGIN_SPICONTROL=y
BR2_PACKAGE_PLUGIN_TEMPCONTROL=y
BR2_PACKAGE_PLUGIN_VIRTUALCONTROL=y
BR2_PACKAGE_PLUGIN_ZIGBEECONTROL=y
BR2_PACKAGE_ZIGBEE_WATCHDOG_TIME="63"
BR2_PACKAGE_PLUGIN_ZWAVECONTROL=y
BR2_PACKAGE_PLUGIN_PROVISIONING=y
BR2_PACKAGE_FAAD2=y
BR2_PACKAGE_GST1_PLUGINS_GOOD_PLUGIN_MPG123=y
BR2_PACKAGE_GST1_PLUGINS_BAD=y
BR2_PACKAGE_GST1_PLUGINS_BAD_PLUGIN_DEBUGUTILS=y
BR2_PACKAGE_BITSTREAM_VERA=y
BR2_PACKAGE_RPI_FIRMWARE=y
BR2_PACKAGE_RPI_USERLAND=y
BR2_PACKAGE_ALSA_LIB=y
BR2_PACKAGE_OPUS=y
BR2_PACKAGE_TREMOR=y
BR2_PACKAGE_OPENSSL=y
BR2_PACKAGE_GRAPHITE2=y
BR2_PACKAGE_LIBMNG=y
BR2_PACKAGE_WPEWEBKIT_USE_PUNCH_HOLE_NONE=y
BR2_PACKAGE_MTDEV=y
BR2_PACKAGE_C_ARES=y
BR2_PACKAGE_LIBCURL=y
BR2_PACKAGE_LIBCURL_GNUTLS=y
BR2_PACKAGE_NGHTTP2=y
BR2_PACKAGE_LIBEVDEV=y
BR2_PACKAGE_ORC=y
BR2_PACKAGE_DROPBEAR=y
BR2_PACKAGE_KMOD=y
```

## configs/raspberrypi0_defconfig
```kconfig
BR2_arm=y
BR2_arm1176jzf_s=y
BR2_TOOLCHAIN_EXTERNAL=y
BR2_TOOLCHAIN_EXTERNAL_BOOTLIN_ARMV6_EABIHF_GLIBC_STABLE=y
BR2_GLOBAL_PATCH_DIR="board/raspberrypi/patches"
BR2_DOWNLOAD_FORCE_CHECK_HASHES=y
BR2_ROOTFS_POST_BUILD_SCRIPT="board/raspberrypi0/post-build.sh"
BR2_ROOTFS_POST_IMAGE_SCRIPT="board/raspberrypi0/post-image.sh"
BR2_LINUX_KERNEL=y
BR2_LINUX_KERNEL_CUSTOM_TARBALL=y
BR2_LINUX_KERNEL_CUSTOM_TARBALL_LOCATION="$(call github,raspberrypi,linux,cd231d4775b14f228606c09f219b48308f6ab3aa)/linux-cd231d4775b14f228606c09f219b48308f6ab3aa.tar.gz"
BR2_LINUX_KERNEL_DEFCONFIG="bcmrpi"
BR2_LINUX_KERNEL_DTS_SUPPORT=y
BR2_LINUX_KERNEL_INTREE_DTS_NAME="broadcom/bcm2708-rpi-zero"
BR2_LINUX_KERNEL_NEEDS_HOST_OPENSSL=y
BR2_PACKAGE_BUSYBOX_SHOW_OTHERS=y
BR2_PACKAGE_XZ=y
BR2_PACKAGE_RPI_FIRMWARE=y
BR2_PACKAGE_RPI_FIRMWARE_BOOTCODE_BIN=y
BR2_PACKAGE_RPI_FIRMWARE_VARIANT_PI=y
BR2_PACKAGE_RPI_FIRMWARE_CONFIG_FILE="board/raspberrypi0/config_default.txt"
# BR2_PACKAGE_RPI_FIRMWARE_INSTALL_DTB_OVERLAYS is not set
BR2_PACKAGE_KMOD=y
BR2_PACKAGE_KMOD_TOOLS=y
BR2_TARGET_ROOTFS_EXT2=y
BR2_TARGET_ROOTFS_EXT2_4=y
BR2_TARGET_ROOTFS_EXT2_SIZE="120M"
# BR2_TARGET_ROOTFS_TAR is not set
BR2_PACKAGE_HOST_DOSFSTOOLS=y
BR2_PACKAGE_HOST_GENIMAGE=y
BR2_PACKAGE_HOST_KMOD_XZ=y
BR2_PACKAGE_HOST_MTOOLS=y
```
