## configs/od_gcw0_defconfig
```kconfig
BR2_mipsel=y
BR2_mips_32r2=y
# BR2_MIPS_SOFT_FLOAT is not set
BR2_OPTIMIZE_2=y
BR2_GLOBAL_PATCH_DIR="$(TOPDIR)/board/opendingux/patches"
# BR2_PIC_PIE is not set
BR2_RELRO_NONE=y
BR2_TOOLCHAIN_BUILDROOT_VENDOR="gcw0"
BR2_UCLIBC_CONFIG="board/opendingux/gcw0/uclibc.config"
BR2_TOOLCHAIN_BUILDROOT_WCHAR=y
BR2_PTHREAD_DEBUG=y
BR2_BINUTILS_VERSION_2_37_X=y
BR2_GCC_VERSION_11_X=y
BR2_EXTRA_GCC_CONFIG_OPTIONS="--with-mips-plt"
BR2_TOOLCHAIN_BUILDROOT_CXX=y
BR2_GCC_ENABLE_LTO=y
BR2_PACKAGE_HOST_GDB=y
BR2_TARGET_OPTIMIZATION="-pipe"
BR2_ROOTFS_SKELETON_CUSTOM=y
BR2_ROOTFS_SKELETON_CUSTOM_PATH="board/opendingux/target_skeleton"
BR2_TARGET_GENERIC_PASSWD_SHA512=y
BR2_ROOTFS_DEVICE_CREATION_DYNAMIC_EUDEV=y
BR2_ROOTFS_DEVICE_TABLE="board/opendingux/device_table.txt"
BR2_ROOTFS_MERGED_USR=y
BR2_SYSTEM_ENABLE_NLS=y
BR2_TARGET_TZ_INFO=y
BR2_TARGET_LOCALTIME=""
BR2_ROOTFS_USERS_TABLES="board/opendingux/users.txt"
BR2_ROOTFS_OVERLAY="board/opendingux/gcw0/overlay"
BR2_ROOTFS_POST_BUILD_SCRIPT="board/opendingux/gcw0/cleanup-rootfs.sh board/opendingux/create-modules-fs.sh board/opendingux/create-cmake-wrappers.sh"
BR2_ROOTFS_POST_IMAGE_SCRIPT="board/opendingux/create-opk.sh"
BR2_ROOTFS_POST_SCRIPT_ARGS="gcw0"
BR2_LINUX_KERNEL=y
BR2_LINUX_KERNEL_CUSTOM_TARBALL=y
BR2_LINUX_KERNEL_CUSTOM_TARBALL_LOCATION="https://github.com/OpenDingux/linux/archive/c8cee8693fef.tar.gz"
BR2_LINUX_KERNEL_USE_CUSTOM_CONFIG=y
BR2_LINUX_KERNEL_CUSTOM_CONFIG_FILE="board/opendingux/gcw0/linux_defconfig"
BR2_LINUX_KERNEL_IMAGE_TARGET_CUSTOM=y
BR2_LINUX_KERNEL_ZSTD=y
BR2_LINUX_KERNEL_IMAGE_TARGET_NAME="uzImage.bin"
BR2_LINUX_KERNEL_IMAGE_NAME="uzImage.bin"
BR2_LINUX_KERNEL_DTS_SUPPORT=y
BR2_LINUX_KERNEL_INTREE_DTS_NAME="ingenic/gcw0 ingenic/gcw0_proto ingenic/pocketgo2 ingenic/pocketgo2v2 ingenic/rg350 ingenic/rg350m ingenic/rg280m ingenic/rg280v ingenic/rg300x"
BR2_LINUX_KERNEL_NEEDS_HOST_OPENSSL=y
BR2_PACKAGE_LINUX_TOOLS_GPIO=y
BR2_PACKAGE_LINUX_TOOLS_PERF=y
BR2_PACKAGE_LINUX_TOOLS_PERF_TUI=y
BR2_PACKAGE_BUSYBOX_CONFIG="board/opendingux/busybox.config"
BR2_PACKAGE_BUSYBOX_SHOW_OTHERS=y
BR2_PACKAGE_ALSA_UTILS=y
# BR2_PACKAGE_ALSA_UTILS_ALSACTL is not set
BR2_PACKAGE_ALSA_UTILS_AMIXER=y
BR2_PACKAGE_ALSA_UTILS_APLAY=y
BR2_PACKAGE_FLAC=y
BR2_PACKAGE_FLUIDSYNTH=y
BR2_PACKAGE_MODPLUGTOOLS=y
BR2_PACKAGE_MPG123=y
BR2_PACKAGE_P7ZIP=y
BR2_PACKAGE_DMALLOC=y
BR2_PACKAGE_GDB=y
BR2_PACKAGE_GDB_SERVER=y
BR2_PACKAGE_GDB_DEBUGGER=y
BR2_PACKAGE_MEMSTAT=y
BR2_PACKAGE_PV=y
BR2_PACKAGE_STRACE=y
BR2_PACKAGE_STRESS=y
BR2_PACKAGE_VALGRIND=y
BR2_PACKAGE_BINUTILS=y
BR2_PACKAGE_SED=y
BR2_PACKAGE_DOSFSTOOLS=y
BR2_PACKAGE_DOSFSTOOLS_FSCK_FAT=y
BR2_PACKAGE_E2FSPROGS=y
BR2_PACKAGE_E2FSPROGS_RESIZE2FS=y
BR2_PACKAGE_F2FS_TOOLS=y
BR2_PACKAGE_GLMARK2=y
BR2_PACKAGE_KMSCUBE=y
BR2_PACKAGE_FBGRAB=y
BR2_PACKAGE_FBV=y
# BR2_PACKAGE_FBV_JPEG is not set
# BR2_PACKAGE_FBV_GIF is not set
BR2_PACKAGE_MESA3D=y
BR2_PACKAGE_MESA3D_GALLIUM_DRIVER_ETNAVIV=y
BR2_PACKAGE_MESA3D_OPENGL_EGL=y
BR2_PACKAGE_MESA3D_OPENGL_ES=y
BR2_PACKAGE_PSPLASH=y
# BR2_PACKAGE_SDL_FBCON is not set
BR2_PACKAGE_SDL_IMAGE_GIF=y
BR2_PACKAGE_SDL_IMAGE_LBM=y
BR2_PACKAGE_SDL_IMAGE_PCX=y
BR2_PACKAGE_SDL_IMAGE_TARGA=y
BR2_PACKAGE_SDL_IMAGE_XPM=y
BR2_PACKAGE_SDL_MIXER_MIDI_TIMIDITY=y
BR2_PACKAGE_SDL_SOUND=y
BR2_PACKAGE_SDL2_KMSDRM=y
BR2_PACKAGE_SDL2_OPENGLES=y
BR2_PACKAGE_SDL2_GFX=y
BR2_PACKAGE_SDL2_IMAGE=y
BR2_PACKAGE_SDL2_MIXER=y
BR2_PACKAGE_SDL2_NET=y
BR2_PACKAGE_SDL2_TTF=y
BR2_PACKAGE_APITRACE=y
BR2_PACKAGE_LINUX_FIRMWARE=y
BR2_PACKAGE_LINUX_FIRMWARE_MEDIATEK_MT7601U=y
BR2_PACKAGE_LINUX_FIRMWARE_RTL_81XX=y
BR2_PACKAGE_EVTEST=y
BR2_PACKAGE_FMTOOLS=y
BR2_PACKAGE_I2C_TOOLS=y
BR2_PACKAGE_UMTPRD=y
BR2_PACKAGE_LUAJIT=y
BR2_PACKAGE_LUAJIT_COMPAT52=y
BR2_PACKAGE_PYTHON3=y
BR2_PACKAGE_PYTHON3_CURSES=y
BR2_PACKAGE_PYTHON3_READLINE=y
BR2_PACKAGE_PYTHON3_SSL=y
BR2_PACKAGE_PYTHON3_SQLITE=y
BR2_PACKAGE_PYTHON3_PYEXPAT=y
BR2_PACKAGE_PYTHON_PYGAME_IMAGE=y
BR2_PACKAGE_PYTHON_PYGAME_MIXER_MUSIC=y
# BR2_PACKAGE_ALSA_LIB_ALISP is not set
# BR2_PACKAGE_ALSA_LIB_OLD_SYMBOLS is not set
BR2_PACKAGE_LIBID3TAG=y
BR2_PACKAGE_LIBMAD=y
BR2_PACKAGE_LIBSNDFILE=y
BR2_PACKAGE_OPUS_FIXED_POINT=y
BR2_PACKAGE_OPUSFILE=y
BR2_PACKAGE_SPEEX=y
BR2_PACKAGE_TAGLIB=y
BR2_PACKAGE_TREMOR=y
BR2_PACKAGE_LIBZIP=y
BR2_PACKAGE_LIBGCRYPT=y
BR2_PACKAGE_LIBRESSL=y
BR2_PACKAGE_LIBCONFUSE=y
BR2_PACKAGE_LIBSYSFS=y
BR2_PACKAGE_PHYSFS=y
BR2_PACKAGE_FONTCONFIG=y
BR2_PACKAGE_LIBDRM_INSTALL_TESTS=y
BR2_PACKAGE_LIBAIO=y
BR2_PACKAGE_TSLIB=y
BR2_PACKAGE_GLOG=y
BR2_PACKAGE_C_ARES=y
BR2_PACKAGE_LIBHTTPPARSER=y
BR2_PACKAGE_BOOST=y
BR2_PACKAGE_BOOST_ATOMIC=y
BR2_PACKAGE_BOOST_DATE_TIME=y
BR2_PACKAGE_BOOST_FILESYSTEM=y
BR2_PACKAGE_BOOST_PROGRAM_OPTIONS=y
BR2_PACKAGE_BOOST_REGEX=y
BR2_PACKAGE_BOOST_THREAD=y
BR2_PACKAGE_ELFUTILS=y
BR2_PACKAGE_GLM=y
BR2_PACKAGE_LIBEVDEV=y
BR2_PACKAGE_LIBUV=y
BR2_PACKAGE_NCURSES_WCHAR=y
BR2_PACKAGE_NCURSES_ADDITIONAL_TERMINFO="s/st-256color"
BR2_PACKAGE_AVAHI=y
BR2_PACKAGE_AVAHI_DAEMON=y
BR2_PACKAGE_BWM_NG=y
BR2_PACKAGE_DHCPDUMP=y
BR2_PACKAGE_DROPBEAR=y
BR2_PACKAGE_DROPBEAR_DISABLE_REVERSEDNS=y
# BR2_PACKAGE_DROPBEAR_SMALL is not set
BR2_PACKAGE_HOSTAPD=y
BR2_PACKAGE_HOSTAPD_EAP=y
BR2_PACKAGE_HOSTAPD_WPS=y
BR2_PACKAGE_IW=y
BR2_PACKAGE_NETCAT=y
BR2_PACKAGE_NTP=y
BR2_PACKAGE_NTP_NTPDATE=y
BR2_PACKAGE_NTP_NTPDC=y
BR2_PACKAGE_NTP_NTPQ=y
BR2_PACKAGE_NTP_TICKADJ=y
BR2_PACKAGE_OPENSSH=y
BR2_PACKAGE_RSYNC=y
BR2_PACKAGE_TCPDUMP=y
BR2_PACKAGE_WGET=y
BR2_PACKAGE_WIRELESS_REGDB=y
BR2_PACKAGE_WPA_SUPPLICANT=y
BR2_PACKAGE_WPA_SUPPLICANT_AP_SUPPORT=y
BR2_PACKAGE_WPA_SUPPLICANT_WPS=y
BR2_PACKAGE_WPA_SUPPLICANT_CLI=y
BR2_PACKAGE_WPA_SUPPLICANT_PASSPHRASE=y
BR2_PACKAGE_XINETD=y
BR2_PACKAGE_DIALOG=y
BR2_PACKAGE_FILE=y
BR2_PACKAGE_LOCKFILE_PROGS=y
BR2_PACKAGE_SCREEN=y
BR2_PACKAGE_SUDO=y
BR2_PACKAGE_TIME=y
BR2_PACKAGE_XXHASH=y
BR2_PACKAGE_HTOP=y
BR2_PACKAGE_KMOD_TOOLS=y
BR2_PACKAGE_UTIL_LINUX_BINARIES=y
BR2_PACKAGE_UTIL_LINUX_HWCLOCK=y
BR2_PACKAGE_UTIL_LINUX_LOSETUP=y
BR2_PACKAGE_UTIL_LINUX_PARTX=y
BR2_PACKAGE_UTIL_LINUX_RFKILL=y
BR2_PACKAGE_UTIL_LINUX_ZRAMCTL=y
BR2_PACKAGE_NANO=y
BR2_TARGET_ROOTFS_SQUASHFS=y
BR2_TARGET_ROOTFS_SQUASHFS4_ZSTD=y
# BR2_TARGET_ROOTFS_TAR is not set
BR2_PACKAGE_HOST_MKPASSWD=y
BR2_PACKAGE_BENNUGD=y
BR2_PACKAGE_GCWCONNECT=y
BR2_PACKAGE_GL4ES=y
BR2_PACKAGE_GMENU2X=y
BR2_PACKAGE_GMENU2X_SHOW_CLOCK=y
BR2_PACKAGE_GMENU2X_CPUFREQ=y
BR2_PACKAGE_KMSGRAB=y
BR2_PACKAGE_LIBHUGETLBFS=y
BR2_PACKAGE_LIBJPEG8=y
BR2_PACKAGE_LIBMIKMOD=y
BR2_PACKAGE_LIBOPK=y
BR2_PACKAGE_LIBPNG14=y
BR2_PACKAGE_LIBSHAKE=y
BR2_PACKAGE_LIBXDGMIME=y
BR2_PACKAGE_LOVE2D=y
BR2_PACKAGE_MININIT=y
BR2_PACKAGE_OD_PASSWD_CONFIG=y
BR2_PACKAGE_PWSWD=y
BR2_PACKAGE_PWSWD_BACKENDS="volume;brightness;poweroff;reboot;screenshot;kill;ratiomode;suspend"
BR2_PACKAGE_PYCLOCK=y
BR2_PACKAGE_SALSAD=y
BR2_PACKAGE_SPARROW3D=y
BR2_PACKAGE_UBIBOOT=y
BR2_PACKAGE_UBIBOOT_BOARDNAME="gcw0"
BR2_PACKAGE_UNLOCKVT=y
```

## configs/od_installer_defconfig
```kconfig
BR2_mipsel=y
BR2_OPTIMIZE_2=y
BR2_STATIC_LIBS=y
BR2_TOOLCHAIN_EXTERNAL=y
BR2_TOOLCHAIN_EXTERNAL_DOWNLOAD=y
BR2_TOOLCHAIN_EXTERNAL_URL="od.abstraction.se/opendingux/toolchain/opendingux-rs90-toolchain.2021-03-10.tar.xz"
BR2_TOOLCHAIN_EXTERNAL_HEADERS_5_10=y
BR2_TOOLCHAIN_EXTERNAL_CUSTOM_MUSL=y
BR2_TOOLCHAIN_EXTERNAL_CXX=y
BR2_TARGET_GENERIC_HOSTNAME="opendingux"
BR2_TARGET_GENERIC_ISSUE="Welcome to OpenDingux"
BR2_ROOTFS_MERGED_USR=y
# BR2_TARGET_GENERIC_GETTY is not set
BR2_ROOTFS_OVERLAY="board/opendingux/installer/overlay"
BR2_ROOTFS_POST_BUILD_SCRIPT="board/opendingux/installer/cleanup-rootfs.sh"
BR2_LINUX_KERNEL=y
BR2_LINUX_KERNEL_CUSTOM_TARBALL=y
BR2_LINUX_KERNEL_CUSTOM_TARBALL_LOCATION="https://github.com/OpenDingux/linux/archive/2d1229eceaae.tar.gz"
BR2_LINUX_KERNEL_USE_CUSTOM_CONFIG=y
BR2_LINUX_KERNEL_CUSTOM_CONFIG_FILE="board/opendingux/installer/linux_defconfig"
BR2_LINUX_KERNEL_CUSTOM_LOGO_PATH="board/opendingux/opendingux.png"
BR2_LINUX_KERNEL_IMAGE_TARGET_CUSTOM=y
BR2_LINUX_KERNEL_ZSTD=y
BR2_LINUX_KERNEL_IMAGE_TARGET_NAME="vmlinuz.bin"
BR2_LINUX_KERNEL_NEEDS_HOST_OPENSSL=y
BR2_LINUX_KERNEL_NEEDS_HOST_LIBELF=y
BR2_PACKAGE_BUSYBOX_SHOW_OTHERS=y
BR2_PACKAGE_SED=y
BR2_PACKAGE_DOSFSTOOLS=y
BR2_PACKAGE_DOSFSTOOLS_MKFS_FAT=y
BR2_PACKAGE_E2FSPROGS=y
# BR2_PACKAGE_E2FSPROGS_FSCK is not set
BR2_PACKAGE_F2FS_TOOLS=y
BR2_PACKAGE_MTD=y
# BR2_PACKAGE_MTD_FLASHCP is not set
# BR2_PACKAGE_MTD_FLASH_LOCK is not set
# BR2_PACKAGE_MTD_FLASH_UNLOCK is not set
# BR2_PACKAGE_MTD_MTD_DEBUG is not set
# BR2_PACKAGE_MTD_NANDDUMP is not set
# BR2_PACKAGE_MTD_NANDTEST is not set
# BR2_PACKAGE_MTD_UBICRC32 is not set
# BR2_PACKAGE_MTD_UBINIZE is not set
# BR2_PACKAGE_MTD_UBIRENAME is not set
# BR2_PACKAGE_MTD_UBIRMVOL is not set
# BR2_PACKAGE_MTD_UBIRSVOL is not set
# BR2_PACKAGE_MTD_UBIBLOCK is not set
BR2_PACKAGE_DIALOG=y
BR2_TARGET_ROOTFS_INITRAMFS=y
# BR2_TARGET_ROOTFS_TAR is not set
BR2_PACKAGE_HOST_MKPASSWD=y
BR2_PACKAGE_ODBOOTD=y
```

## configs/od_lepus_defconfig
```kconfig
BR2_mipsel=y
BR2_mips_xburst=y
# BR2_MIPS_SOFT_FLOAT is not set
BR2_MIPS_FP32_MODE_32=y
BR2_OPTIMIZE_2=y
BR2_GLOBAL_PATCH_DIR="$(TOPDIR)/board/opendingux/patches"
# BR2_PIC_PIE is not set
BR2_SSP_NONE=y
BR2_RELRO_NONE=y
BR2_TOOLCHAIN_BUILDROOT_VENDOR="lepus"
BR2_TOOLCHAIN_BUILDROOT_MUSL=y
BR2_BINUTILS_VERSION_2_37_X=y
BR2_GCC_VERSION_11_X=y
BR2_EXTRA_GCC_CONFIG_OPTIONS="--with-mips-plt"
BR2_TOOLCHAIN_BUILDROOT_CXX=y
BR2_GCC_ENABLE_LTO=y
BR2_PACKAGE_HOST_GDB=y
BR2_PACKAGE_HOST_GDB_PYTHON3=y
BR2_TARGET_OPTIMIZATION="-pipe"
BR2_ROOTFS_SKELETON_CUSTOM=y
BR2_ROOTFS_SKELETON_CUSTOM_PATH="board/opendingux/target_skeleton"
BR2_TARGET_GENERIC_PASSWD_SHA512=y
BR2_ROOTFS_DEVICE_CREATION_DYNAMIC_EUDEV=y
BR2_ROOTFS_DEVICE_TABLE="board/opendingux/device_table.txt"
BR2_ROOTFS_MERGED_USR=y
BR2_SYSTEM_ENABLE_NLS=y
BR2_TARGET_TZ_INFO=y
BR2_ROOTFS_USERS_TABLES="board/opendingux/users.txt"
BR2_ROOTFS_OVERLAY="board/opendingux/lepus/overlay"
BR2_ROOTFS_POST_BUILD_SCRIPT="board/opendingux/lepus/cleanup-rootfs.sh board/opendingux/create-modules-fs.sh board/opendingux/create-cmake-wrappers.sh"
BR2_ROOTFS_POST_IMAGE_SCRIPT="board/opendingux/create-opk.sh"
BR2_ROOTFS_POST_SCRIPT_ARGS="lepus"
BR2_LINUX_KERNEL=y
BR2_LINUX_KERNEL_CUSTOM_TARBALL=y
BR2_LINUX_KERNEL_CUSTOM_TARBALL_LOCATION="https://github.com/OpenDingux/linux/archive/7bf6a7125db1.tar.gz"
BR2_LINUX_KERNEL_USE_CUSTOM_CONFIG=y
BR2_LINUX_KERNEL_CUSTOM_CONFIG_FILE="board/opendingux/lepus/linux_defconfig"
BR2_LINUX_KERNEL_IMAGE_TARGET_CUSTOM=y
BR2_LINUX_KERNEL_ZSTD=y
BR2_LINUX_KERNEL_IMAGE_TARGET_NAME="uzImage.bin"
BR2_LINUX_KERNEL_DTS_SUPPORT=y
BR2_LINUX_KERNEL_INTREE_DTS_NAME="ingenic/gopher2 ingenic/gopher2b ingenic/ldkv ingenic/ldkh ingenic/papk3s ingenic/rg300 ingenic/rs97"
BR2_LINUX_KERNEL_NEEDS_HOST_OPENSSL=y
BR2_LINUX_KERNEL_NEEDS_HOST_LIBELF=y
BR2_PACKAGE_LINUX_TOOLS_GPIO=y
BR2_PACKAGE_LINUX_TOOLS_PERF=y
BR2_PACKAGE_LINUX_TOOLS_PERF_TUI=y
BR2_PACKAGE_BUSYBOX_CONFIG="board/opendingux/busybox.config"
BR2_PACKAGE_BUSYBOX_SHOW_OTHERS=y
BR2_PACKAGE_ALSA_UTILS=y
# BR2_PACKAGE_ALSA_UTILS_ALSACTL is not set
BR2_PACKAGE_ALSA_UTILS_AMIXER=y
BR2_PACKAGE_ALSA_UTILS_APLAY=y
BR2_PACKAGE_MPG123=y
BR2_PACKAGE_GDB=y
BR2_PACKAGE_GDB_SERVER=y
BR2_PACKAGE_GDB_DEBUGGER=y
BR2_PACKAGE_GDB_TUI=y
BR2_PACKAGE_MEMSTAT=y
BR2_PACKAGE_PV=y
BR2_PACKAGE_STRACE=y
BR2_PACKAGE_SED=y
BR2_PACKAGE_DOSFSTOOLS=y
BR2_PACKAGE_DOSFSTOOLS_FSCK_FAT=y
BR2_PACKAGE_E2FSPROGS=y
BR2_PACKAGE_F2FS_TOOLS=y
BR2_PACKAGE_FBV=y
# BR2_PACKAGE_FBV_JPEG is not set
# BR2_PACKAGE_FBV_GIF is not set
BR2_PACKAGE_PSPLASH=y
# BR2_PACKAGE_SDL_FBCON is not set
BR2_PACKAGE_SDL_IMAGE_GIF=y
BR2_PACKAGE_SDL_IMAGE_LBM=y
BR2_PACKAGE_SDL_NET=y
# BR2_PACKAGE_EUDEV_ENABLE_HWDB is not set
BR2_PACKAGE_EVTEST=y
BR2_PACKAGE_UMTPRD=y
BR2_PACKAGE_PYTHON3=y
BR2_PACKAGE_PYTHON3_CURSES=y
BR2_PACKAGE_PYTHON3_READLINE=y
BR2_PACKAGE_PYTHON3_SSL=y
BR2_PACKAGE_PYTHON3_PYEXPAT=y
BR2_PACKAGE_PYTHON3_ZLIB=y
BR2_PACKAGE_PYTHON_PYGAME_IMAGE=y
BR2_PACKAGE_PYTHON_PYGAME_MIXER_MUSIC=y
# BR2_PACKAGE_ALSA_LIB_ALOAD is not set
# BR2_PACKAGE_ALSA_LIB_RAWMIDI is not set
# BR2_PACKAGE_ALSA_LIB_HWDEP is not set
# BR2_PACKAGE_ALSA_LIB_SEQ is not set
# BR2_PACKAGE_ALSA_LIB_ALISP is not set
# BR2_PACKAGE_ALSA_LIB_OLD_SYMBOLS is not set
BR2_PACKAGE_LIBAO=y
BR2_PACKAGE_LIBID3TAG=y
BR2_PACKAGE_LIBMAD=y
BR2_PACKAGE_LIBMODPLUG=y
BR2_PACKAGE_LIBVORBIS=y
BR2_PACKAGE_OPUS=y
BR2_PACKAGE_TREMOR=y
BR2_PACKAGE_LIBZIP=y
BR2_PACKAGE_LIBRESSL=y
BR2_PACKAGE_LIBDRM_INSTALL_TESTS=y
BR2_PACKAGE_BOOST=y
BR2_PACKAGE_BOOST_ATOMIC=y
BR2_PACKAGE_BOOST_DATE_TIME=y
BR2_PACKAGE_BOOST_FILESYSTEM=y
BR2_PACKAGE_BOOST_PROGRAM_OPTIONS=y
BR2_PACKAGE_BOOST_REGEX=y
BR2_PACKAGE_BOOST_THREAD=y
BR2_PACKAGE_NCURSES_WCHAR=y
BR2_PACKAGE_DROPBEAR=y
# BR2_PACKAGE_DROPBEAR_CLIENT is not set
BR2_PACKAGE_DROPBEAR_DISABLE_REVERSEDNS=y
# BR2_PACKAGE_DROPBEAR_SMALL is not set
BR2_PACKAGE_XINETD=y
BR2_PACKAGE_DIALOG=y
BR2_PACKAGE_FILE=y
BR2_PACKAGE_SCREEN=y
BR2_PACKAGE_SUDO=y
BR2_PACKAGE_TIME=y
BR2_PACKAGE_XXHASH=y
BR2_PACKAGE_HTOP=y
BR2_PACKAGE_KMOD_TOOLS=y
BR2_PACKAGE_UTIL_LINUX_HWCLOCK=y
BR2_PACKAGE_UTIL_LINUX_LOSETUP=y
BR2_PACKAGE_UTIL_LINUX_ZRAMCTL=y
BR2_PACKAGE_NANO=y
BR2_TARGET_ROOTFS_SQUASHFS=y
BR2_TARGET_ROOTFS_SQUASHFS4_ZSTD=y
# BR2_TARGET_ROOTFS_TAR is not set
BR2_PACKAGE_HOST_MKPASSWD=y
BR2_PACKAGE_BENNUGD=y
BR2_PACKAGE_GMENU2X=y
BR2_PACKAGE_GMENU2X_SHOW_CLOCK=y
BR2_PACKAGE_GMENU2X_CPUFREQ=y
BR2_PACKAGE_KMSGRAB=y
BR2_PACKAGE_LIBHUGETLBFS=y
BR2_PACKAGE_LIBOPK=y
BR2_PACKAGE_LIBXDGMIME=y
BR2_PACKAGE_MININIT=y
BR2_PACKAGE_OD_PASSWD_CONFIG=y
BR2_PACKAGE_PWSWD=y
BR2_PACKAGE_PWSWD_BACKENDS="volume;brightness;poweroff;reboot;suspend;kill;ratiomode;screenshot"
BR2_PACKAGE_PYCLOCK=y
BR2_PACKAGE_SALSAD=y
BR2_PACKAGE_UBIBOOT=y
BR2_PACKAGE_UBIBOOT_BOARDNAME="lepus"
```
