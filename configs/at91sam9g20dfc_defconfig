## configs/at91sam9g20dfc_defconfig
```kconfig
BR2_arm=y
BR2_PACKAGE_HOST_LINUX_HEADERS_CUSTOM_4_8=y
BR2_LINUX_KERNEL=y
BR2_LINUX_KERNEL_CUSTOM_VERSION=y
BR2_LINUX_KERNEL_CUSTOM_VERSION_VALUE="4.8.6"
BR2_LINUX_KERNEL_DEFCONFIG="at91_dt"
BR2_LINUX_KERNEL_DTS_SUPPORT=y
BR2_LINUX_KERNEL_INTREE_DTS_NAME="at91sam9g20ek"
BR2_TARGET_ROOTFS_UBI=y
BR2_TARGET_ROOTFS_UBIFS_MAXLEBCNT=2047
BR2_TARGET_AT91BOOTSTRAP3=y
BR2_TARGET_AT91BOOTSTRAP3_CUSTOM_GIT=y
BR2_TARGET_AT91BOOTSTRAP3_CUSTOM_REPO_URL="https://github.com/linux4sam/at91bootstrap.git"
BR2_TARGET_AT91BOOTSTRAP3_CUSTOM_REPO_VERSION="v3.10.3"
BR2_TARGET_AT91BOOTSTRAP3_DEFCONFIG="at91sam9g20eknf_uboot"
BR2_TARGET_UBOOT=y
BR2_TARGET_UBOOT_BUILD_SYSTEM_KCONFIG=y
BR2_TARGET_UBOOT_CUSTOM_VERSION=y
BR2_TARGET_UBOOT_CUSTOM_VERSION_VALUE="2016.09.01"
BR2_TARGET_UBOOT_BOARD_DEFCONFIG="at91sam9g20ek_nandflash"
BR2_PACKAGE_HOST_SAM_BA=y
```

## configs/avenger96_defconfig
```kconfig
BR2_arm=y
BR2_cortex_a7=y
BR2_PACKAGE_HOST_LINUX_HEADERS_CUSTOM_6_6=y
BR2_ROOTFS_OVERLAY="board/arrow/avenger96/overlay/"
BR2_ROOTFS_POST_IMAGE_SCRIPT="board/stmicroelectronics/common/stm32mp1xx/post-image.sh"
BR2_LINUX_KERNEL=y
BR2_LINUX_KERNEL_CUSTOM_VERSION=y
BR2_LINUX_KERNEL_CUSTOM_VERSION_VALUE="6.6.22"
BR2_LINUX_KERNEL_DEFCONFIG="multi_v7"
BR2_LINUX_KERNEL_DTS_SUPPORT=y
BR2_LINUX_KERNEL_INTREE_DTS_NAME="st/stm32mp157a-dhcor-avenger96"
BR2_LINUX_KERNEL_INSTALL_TARGET=y
BR2_LINUX_KERNEL_NEEDS_HOST_OPENSSL=y
BR2_TARGET_ROOTFS_EXT2=y
BR2_TARGET_ROOTFS_EXT2_4=y
BR2_TARGET_ROOTFS_EXT2_SIZE="120M"
# BR2_TARGET_ROOTFS_TAR is not set
BR2_TARGET_ARM_TRUSTED_FIRMWARE=y
BR2_TARGET_ARM_TRUSTED_FIRMWARE_CUSTOM_VERSION=y
BR2_TARGET_ARM_TRUSTED_FIRMWARE_CUSTOM_VERSION_VALUE="lts-v2.8.16"
BR2_TARGET_ARM_TRUSTED_FIRMWARE_PLATFORM="stm32mp1"
BR2_TARGET_ARM_TRUSTED_FIRMWARE_FIP=y
BR2_TARGET_ARM_TRUSTED_FIRMWARE_BL31=y
BR2_TARGET_ARM_TRUSTED_FIRMWARE_UBOOT_AS_BL33=y
BR2_TARGET_ARM_TRUSTED_FIRMWARE_UBOOT_BL33_IMAGE="u-boot-nodtb.bin"
BR2_TARGET_ARM_TRUSTED_FIRMWARE_ADDITIONAL_VARIABLES="STM32MP_SDMMC=1 AARCH32_SP=sp_min DTB_FILE_NAME=stm32mp157a-dhcor-avenger96.dtb BL33_CFG=$(BINARIES_DIR)/u-boot.dtb"
BR2_TARGET_ARM_TRUSTED_FIRMWARE_IMAGES="fip.bin *.stm32"
BR2_TARGET_ARM_TRUSTED_FIRMWARE_NEEDS_DTC=y
BR2_TARGET_UBOOT=y
BR2_TARGET_UBOOT_BUILD_SYSTEM_KCONFIG=y
BR2_TARGET_UBOOT_CUSTOM_VERSION=y
BR2_TARGET_UBOOT_CUSTOM_VERSION_VALUE="2024.01"
BR2_TARGET_UBOOT_BOARD_DEFCONFIG="stm32mp15_trusted"
BR2_TARGET_UBOOT_NEEDS_PYLIBFDT=y
# BR2_TARGET_UBOOT_FORMAT_BIN is not set
BR2_TARGET_UBOOT_FORMAT_DTB=y
BR2_TARGET_UBOOT_FORMAT_CUSTOM=y
BR2_TARGET_UBOOT_FORMAT_CUSTOM_NAME="u-boot-nodtb.bin"
BR2_TARGET_UBOOT_CUSTOM_MAKEOPTS="DEVICE_TREE=stm32mp15xx-dhcor-avenger96"
BR2_PACKAGE_HOST_GENIMAGE=y
```

## configs/avnet_rzboard_v2l_defconfig
```kconfig
BR2_aarch64=y
BR2_cortex_a55=y
BR2_KERNEL_HEADERS_5_10=y
BR2_TARGET_GENERIC_HOSTNAME="rzboard_v2l"
BR2_TARGET_GENERIC_ISSUE="Welcome to the AVNET RZBoard V2L"
BR2_ROOTFS_POST_IMAGE_SCRIPT="board/avnet/rzboard_v2l/post-image.sh"
BR2_LINUX_KERNEL=y
BR2_LINUX_KERNEL_CUSTOM_GIT=y
BR2_LINUX_KERNEL_CUSTOM_REPO_URL="https://github.com/Avnet/renesas-linux-cip.git"
BR2_LINUX_KERNEL_CUSTOM_REPO_VERSION="c197622df526c82ae9e3674e06b4092dac33eafa"
BR2_LINUX_KERNEL_DEFCONFIG="rzboard"
BR2_LINUX_KERNEL_DTS_SUPPORT=y
BR2_LINUX_KERNEL_INTREE_DTS_NAME="renesas/rzboard"
BR2_LINUX_KERNEL_NEEDS_HOST_OPENSSL=y
BR2_TARGET_ROOTFS_EXT2=y
BR2_TARGET_ROOTFS_EXT2_4=y
BR2_TARGET_ROOTFS_EXT2_SIZE="64M"
BR2_PACKAGE_HOST_DOSFSTOOLS=y
BR2_PACKAGE_HOST_GENIMAGE=y
BR2_PACKAGE_HOST_MTOOLS=y
```

## configs/bananapi_m2_ultra_defconfig
```kconfig
BR2_arm=y
BR2_cortex_a7=y
BR2_PACKAGE_HOST_LINUX_HEADERS_CUSTOM_6_1=y
BR2_TARGET_GENERIC_ISSUE="Welcome to Bananapi M2 Ultra"
BR2_ROOTFS_POST_BUILD_SCRIPT="board/bananapi/bananapi-m2-ultra/post-build.sh"
BR2_ROOTFS_POST_IMAGE_SCRIPT="support/scripts/genimage.sh"
BR2_ROOTFS_POST_SCRIPT_ARGS="-c board/bananapi/bananapi-m2-ultra/genimage.cfg"
BR2_LINUX_KERNEL=y
BR2_LINUX_KERNEL_CUSTOM_VERSION=y
BR2_LINUX_KERNEL_CUSTOM_VERSION_VALUE="6.1.57"
BR2_LINUX_KERNEL_DEFCONFIG="sunxi"
BR2_LINUX_KERNEL_DTS_SUPPORT=y
BR2_LINUX_KERNEL_INTREE_DTS_NAME="sun8i-r40-bananapi-m2-ultra"
BR2_LINUX_KERNEL_INSTALL_TARGET=y
BR2_TARGET_ROOTFS_EXT2=y
BR2_TARGET_ROOTFS_EXT2_4=y
# BR2_TARGET_ROOTFS_TAR is not set
BR2_TARGET_UBOOT=y
BR2_TARGET_UBOOT_BUILD_SYSTEM_KCONFIG=y
BR2_TARGET_UBOOT_CUSTOM_VERSION=y
BR2_TARGET_UBOOT_CUSTOM_VERSION_VALUE="2023.10"
BR2_TARGET_UBOOT_BOARD_DEFCONFIG="bananapi_m2_berry"
BR2_TARGET_UBOOT_NEEDS_DTC=y
BR2_TARGET_UBOOT_NEEDS_PYTHON3=y
BR2_TARGET_UBOOT_NEEDS_PYLIBFDT=y
BR2_TARGET_UBOOT_NEEDS_OPENSSL=y
BR2_TARGET_UBOOT_FORMAT_CUSTOM=y
BR2_TARGET_UBOOT_FORMAT_CUSTOM_NAME="u-boot-sunxi-with-spl.bin"
BR2_PACKAGE_HOST_DOSFSTOOLS=y
BR2_PACKAGE_HOST_GENIMAGE=y
BR2_PACKAGE_HOST_MTOOLS=y
```

## configs/bcm72604_wpe_ml_defconfig
```kconfig
BR2_arm=y
BR2_cortex_a15=y
BR2_ARM_FPU_NEON_VFPV4=y
BR2_ARM_INSTRUCTIONS_THUMB2=y
BR2_CCACHE=y
BR2_OPTIMIZE_2=y
BR2_TOOLCHAIN_BUILDROOT_GLIBC=y
BR2_PACKAGE_HOST_LINUX_HEADERS_CUSTOM_4_1=y
BR2_GLIBC_VERSION_2_23=y
BR2_TOOLCHAIN_BUILDROOT_CXX=y
BR2_TARGET_GENERIC_CABUNDLE=y
BR2_ROOTFS_DEVICE_CREATION_DYNAMIC_EUDEV=y
BR2_TARGET_GENERIC_ROOT_PASSWD="root"
BR2_TARGET_GENERIC_GETTY_PORT="ttyS0"
BR2_SYSTEM_DHCP="eth2"
BR2_LINUX_KERNEL=y
BR2_LINUX_KERNEL_CUSTOM_GIT=y
BR2_LINUX_KERNEL_CUSTOM_REPO_URL="git@github.com:Metrological/bcm-stblinux-4.1.git"
BR2_LINUX_KERNEL_CUSTOM_REPO_VERSION="e217b1f183d2ae26bb9859c8bff5255e15fcec46"
BR2_LINUX_KERNEL_USE_CUSTOM_CONFIG=y
BR2_LINUX_KERNEL_CUSTOM_CONFIG_FILE="board/bcm/bcm72604_defconfig"
BR2_PACKAGE_BUSYBOX_SMP=y
BR2_PACKAGE_GSTREAMER1=y
BR2_PACKAGE_GST1_BCM=y
BR2_PACKAGE_GST1_PLUGINS_BASE_PLUGIN_APP=y
BR2_PACKAGE_GST1_PLUGINS_BASE_PLUGIN_VIDEOCONVERT=y
BR2_PACKAGE_GST1_PLUGINS_BASE_PLUGIN_GIO=y
BR2_PACKAGE_GST1_PLUGINS_GOOD_PLUGIN_AUDIOFX=y
BR2_PACKAGE_GST1_PLUGINS_GOOD_PLUGIN_AUDIOPARSERS=y
BR2_PACKAGE_GST1_PLUGINS_GOOD_PLUGIN_AUTODETECT=y
BR2_PACKAGE_GST1_PLUGINS_GOOD_PLUGIN_DEINTERLACE=y
BR2_PACKAGE_GST1_PLUGINS_GOOD_PLUGIN_FLV=y
BR2_PACKAGE_GST1_PLUGINS_GOOD_PLUGIN_INTERLEAVE=y
BR2_PACKAGE_GST1_PLUGINS_GOOD_PLUGIN_SOUPHTTPSRC=y
BR2_PACKAGE_GST1_PLUGINS_BAD_PLUGIN_MPEGTSDEMUX=y
BR2_PACKAGE_GST1_PLUGINS_BAD_PLUGIN_VIDEOPARSERS=y
BR2_PACKAGE_GST1_PLUGINS_BAD_PLUGIN_DASH=y
BR2_PACKAGE_GST1_PLUGINS_BAD_PLUGIN_FAAD=y
BR2_PACKAGE_GST1_PLUGINS_BAD_PLUGIN_HLS=y
BR2_PACKAGE_GST1_PLUGINS_BAD_PLUGIN_SMOOTHSTREAMING=y
BR2_PACKAGE_GST1_PLUGINS_UGLY=y
BR2_PACKAGE_GST1_PLUGINS_UGLY_PLUGIN_MPG123=y
BR2_PACKAGE_NINJA=y
BR2_PACKAGE_PLAYREADY=y
BR2_PACKAGE_BITSTREAM_VERA=y
BR2_PACKAGE_BCM_REFSW=y
BR2_PACKAGE_BCM_REFSW_16_3=y
BR2_PACKAGE_BCM_REFSW_PLATFORM_72604=y
# BR2_PACKAGE_EUDEV_ENABLE_HWDB is not set
BR2_PACKAGE_GRAPHITE2=y
BR2_PACKAGE_LIBMNG=y
BR2_PACKAGE_WEBP=y
BR2_PACKAGE_WPEFRAMEWORK=y
BR2_PACKAGE_WPEFRAMEWORK_DEBUG=y
BR2_PACKAGE_WPEFRAMEWORK_PROVISIONPROXY=y
BR2_PACKAGE_WPEFRAMEWORK_COMMANDER=y
BR2_PACKAGE_WPEFRAMEWORK_DEVICEINFO=y
BR2_PACKAGE_WPEFRAMEWORK_LOCATIONSYNC=y
BR2_PACKAGE_WPEFRAMEWORK_MONITOR=y
BR2_PACKAGE_WPEFRAMEWORK_TIMESYNC=y
BR2_PACKAGE_WPEFRAMEWORK_REMOTECONTROL=y
BR2_PACKAGE_WPEFRAMEWORK_TRACECONTROL=y
BR2_PACKAGE_WPEFRAMEWORK_WEBKITBROWSER=y
BR2_PACKAGE_WPEFRAMEWORK_WEBKITBROWSER_TRANSPARENT=y
BR2_PACKAGE_WPEFRAMEWORK_YOUTUBE=y
BR2_PACKAGE_WPEFRAMEWORK_WEBPROXY=y
BR2_PACKAGE_WPEFRAMEWORK_WEBSERVER=y
BR2_PACKAGE_WPEFRAMEWORK_WEBSHELL=y
BR2_PACKAGE_WPEFRAMEWORK_COMPOSITOR=y
BR2_PACKAGE_WPEFRAMEWORK_COMPOSITOR_NEXUS_SERVER=y
BR2_PACKAGE_WPEFRAMEWORK_COMPOSITOR_SERVICE_INTERNAL=y
BR2_PACKAGE_WPEFRAMEWORK_COMPOSITOR_OUTOFPROCESS=y
BR2_PACKAGE_WPEFRAMEWORK_PROVISIONING=y
BR2_PACKAGE_WPEFRAMEWORK_SWITCHBOARD=y
BR2_PACKAGE_WPEWEBKIT=y
BR2_PACKAGE_C_ARES=y
BR2_PACKAGE_ORC=y
BR2_PACKAGE_ICU_USE_ICUDATA=y
BR2_PACKAGE_SHARED_MIME_INFO=y
BR2_PACKAGE_DROPBEAR=y
BR2_PACKAGE_GESFTPSERVER=y
```

## configs/bcm7429_wpe_ml_defconfig
```kconfig
BR2_mipsel=y
# BR2_MIPS_SOFT_FLOAT is not set
BR2_CCACHE=y
BR2_OPTIMIZE_2=y
BR2_TOOLCHAIN_BUILDROOT_GLIBC=y
BR2_PACKAGE_HOST_LINUX_HEADERS_CUSTOM_3_3=y
BR2_TOOLCHAIN_BUILDROOT_CXX=y
BR2_TARGET_GENERIC_CABUNDLE=y
BR2_ROOTFS_DEVICE_CREATION_DYNAMIC_EUDEV=y
BR2_TARGET_GENERIC_ROOT_PASSWD="root"
BR2_TARGET_GENERIC_GETTY_TERM=""
BR2_SYSTEM_DHCP="eth2"
BR2_ROOTFS_POST_BUILD_SCRIPT="board/bcm/clean-rootfs.sh"
BR2_LINUX_KERNEL=y
BR2_LINUX_KERNEL_CUSTOM_GIT=y
BR2_LINUX_KERNEL_CUSTOM_REPO_URL="git@github.com:Metrological/bcm-stblinux-3.3.git"
BR2_LINUX_KERNEL_CUSTOM_REPO_VERSION="db9c5293e7ee11874ddc2d832a4fcc46ba2ba3b3"
BR2_LINUX_KERNEL_DEFCONFIG="bcm7429b0"
BR2_LINUX_KERNEL_CONFIG_FRAGMENT_FILES="board/bcm/bcm_base_defconfig"
BR2_LINUX_KERNEL_VMLINUX=y
BR2_PACKAGE_BUSYBOX_SMP=y
BR2_PACKAGE_GSTREAMER1=y
BR2_PACKAGE_GST1_BCM=y
# BR2_PACKAGE_GST1_BCM_VP9_SUPPORT is not set
BR2_PACKAGE_GST1_PLUGINS_BASE_PLUGIN_APP=y
BR2_PACKAGE_GST1_PLUGINS_BASE_PLUGIN_VIDEOCONVERT=y
BR2_PACKAGE_GST1_PLUGINS_BASE_PLUGIN_GIO=y
BR2_PACKAGE_GST1_PLUGINS_BASE_PLUGIN_OPUS=y
BR2_PACKAGE_GST1_PLUGINS_GOOD_PLUGIN_AUDIOFX=y
BR2_PACKAGE_GST1_PLUGINS_GOOD_PLUGIN_AUDIOPARSERS=y
BR2_PACKAGE_GST1_PLUGINS_GOOD_PLUGIN_DEINTERLACE=y
BR2_PACKAGE_GST1_PLUGINS_GOOD_PLUGIN_FLV=y
BR2_PACKAGE_GST1_PLUGINS_GOOD_PLUGIN_INTERLEAVE=y
BR2_PACKAGE_GST1_PLUGINS_GOOD_PLUGIN_MATROSKA=y
BR2_PACKAGE_GST1_PLUGINS_GOOD_PLUGIN_SOUPHTTPSRC=y
BR2_PACKAGE_GST1_PLUGINS_BAD_PLUGIN_MPEGTSDEMUX=y
BR2_PACKAGE_GST1_PLUGINS_BAD_PLUGIN_VIDEOPARSERS=y
BR2_PACKAGE_GST1_PLUGINS_BAD_PLUGIN_DASH=y
BR2_PACKAGE_GST1_PLUGINS_BAD_PLUGIN_FAAD=y
BR2_PACKAGE_GST1_PLUGINS_BAD_PLUGIN_HLS=y
BR2_PACKAGE_GST1_PLUGINS_BAD_PLUGIN_OPUS=y
BR2_PACKAGE_GST1_PLUGINS_BAD_PLUGIN_SMOOTHSTREAMING=y
BR2_PACKAGE_GST1_PLUGINS_UGLY=y
BR2_PACKAGE_GST1_PLUGINS_UGLY_PLUGIN_MPG123=y
BR2_PACKAGE_NINJA=y
BR2_PACKAGE_PLAYREADY=y
BR2_PACKAGE_BITSTREAM_VERA=y
BR2_PACKAGE_BCM_REFSW=y
BR2_PACKAGE_BCM_REFSW_17_4=y
BR2_PACKAGE_BCM_REFSW_PLATFORM_7429=y
# BR2_PACKAGE_BCM_VP9_DECODER_SUPPORT is not set
# BR2_PACKAGE_EUDEV_ENABLE_HWDB is not set
BR2_PACKAGE_LIBMNG=y
BR2_PACKAGE_WEBP=y
BR2_PACKAGE_WPEFRAMEWORK=y
BR2_PACKAGE_WPEFRAMEWORK_PROVISIONPROXY=y
BR2_PACKAGE_WPEFRAMEWORK_COMPOSITOR=y
BR2_PACKAGE_WPEFRAMEWORK_COMPOSITOR_AUTOSTART=y
BR2_PACKAGE_WPEFRAMEWORK_COMPOSITOR_OUTOFPROCESS=y
BR2_PACKAGE_WPEFRAMEWORK_COMPOSITOR_NEXUS_SERVER=y
BR2_PACKAGE_WPEFRAMEWORK_COMPOSITOR_IRMODE="NEXUS_IrInputMode_eCirGISat"
BR2_PACKAGE_WPEFRAMEWORK_COMPOSITOR_ALLOW_UNAUTHENTICATED_CLIENTS=y
BR2_PACKAGE_WPEFRAMEWORK_COMPOSITOR_MEMORIES=y
BR2_PACKAGE_WPEFRAMEWORK_COMPOSITOR_MEMORY_GFX="350"
BR2_PACKAGE_WPEFRAMEWORK_MONITOR=y
BR2_PACKAGE_WPEFRAMEWORK_REMOTECONTROL=y
BR2_PACKAGE_WPEFRAMEWORK_REMOTECONTROL_IR=y
BR2_PACKAGE_WPEFRAMEWORK_TIMESYNC=y
BR2_PACKAGE_WPEFRAMEWORK_TRACECONTROL=y
BR2_PACKAGE_WPEFRAMEWORK_WEBKITBROWSER=y
BR2_PACKAGE_WPEFRAMEWORK_WEBKITBROWSER_STARTURL="file:///www/index.html"
BR2_PACKAGE_WPEFRAMEWORK_WEBKITBROWSER_MEMORYPRESSURE="databaseprocess:50m,networkprocess:100m,webprocess:170m,rpcprocess:80m"
BR2_PACKAGE_WPEFRAMEWORK_WEBKITBROWSER_DISKCACHE="90m"
BR2_PACKAGE_WPEFRAMEWORK_WEBKITBROWSER_XHRCACHE=y
BR2_PACKAGE_WPEFRAMEWORK_WEBKITBROWSER_TRANSPARENT=y
BR2_PACKAGE_WPEFRAMEWORK_YOUTUBE=y
BR2_PACKAGE_WPEFRAMEWORK_UX=y
BR2_PACKAGE_WPEFRAMEWORK_WEBKITBROWSER_THREADEDPAINTING="2"
BR2_PACKAGE_WPEFRAMEWORK_WEBPROXY=y
BR2_PACKAGE_WPEFRAMEWORK_WEBSERVER=y
BR2_PACKAGE_WPEFRAMEWORK_PROVISIONING=y
BR2_PACKAGE_WPEWEBKIT=y
# BR2_PACKAGE_WPEWEBKIT_USE_GSTREAMER_WEBKIT_HTTP_SRC is not set
BR2_PACKAGE_WPEWEBKIT_ENABLE_NATIVE_AUDIO=y
BR2_PACKAGE_ICU_USE_ICUDATA=y
BR2_PACKAGE_SHARED_MIME_INFO=y
BR2_PACKAGE_DROPBEAR=y
BR2_PACKAGE_GESFTPSERVER=y
```

## configs/bcm7437_wpe_ml_defconfig
```kconfig
BR2_arm=y
BR2_cortex_a15=y
BR2_ARM_FPU_NEON_VFPV4=y
BR2_ARM_INSTRUCTIONS_THUMB2=y
BR2_CCACHE=y
BR2_OPTIMIZE_2=y
BR2_PACKAGE_HOST_LINUX_HEADERS_CUSTOM_3_14=y
BR2_TOOLCHAIN_BUILDROOT_GLIBC=y
BR2_TOOLCHAIN_BUILDROOT_CXX=y
BR2_TARGET_GENERIC_CABUNDLE=y
BR2_ROOTFS_DEVICE_CREATION_DYNAMIC_EUDEV=y
BR2_TARGET_GENERIC_ROOT_PASSWD="root"
BR2_TARGET_GENERIC_GETTY_PORT="ttyS0"
BR2_SYSTEM_DHCP="eth0"
BR2_ROOTFS_POST_BUILD_SCRIPT="board/bcm/clean-rootfs.sh"
BR2_LINUX_KERNEL=y
BR2_LINUX_KERNEL_CUSTOM_GIT=y
BR2_LINUX_KERNEL_CUSTOM_REPO_URL="git@github.com:Metrological/bcm-stblinux-3.14.git"
BR2_LINUX_KERNEL_CUSTOM_REPO_VERSION="3.14-1.12"
BR2_LINUX_KERNEL_PATCH="board/bcm/linux-7252.patch"
BR2_LINUX_KERNEL_USE_DEFCONFIG=y
BR2_LINUX_KERNEL_DEFCONFIG="brcmstb"
BR2_LINUX_KERNEL_CONFIG_FRAGMENT_FILES="board/bcm/bcm_base_defconfig board/bcm/bcm74371A0_defconfig"
BR2_PACKAGE_BUSYBOX_SMP=y
BR2_PACKAGE_GSTREAMER1=y
BR2_PACKAGE_GST1_BCM=y
BR2_PACKAGE_GST1_PLUGINS_BASE_PLUGIN_APP=y
BR2_PACKAGE_GST1_PLUGINS_BASE_PLUGIN_VIDEOCONVERT=y
BR2_PACKAGE_GST1_PLUGINS_BASE_PLUGIN_GIO=y
BR2_PACKAGE_GST1_PLUGINS_GOOD_PLUGIN_AUDIOFX=y
BR2_PACKAGE_GST1_PLUGINS_GOOD_PLUGIN_AUDIOPARSERS=y
BR2_PACKAGE_GST1_PLUGINS_GOOD_PLUGIN_AUTODETECT=y
BR2_PACKAGE_GST1_PLUGINS_GOOD_PLUGIN_DEINTERLACE=y
BR2_PACKAGE_GST1_PLUGINS_GOOD_PLUGIN_FLV=y
BR2_PACKAGE_GST1_PLUGINS_GOOD_PLUGIN_INTERLEAVE=y
BR2_PACKAGE_GST1_PLUGINS_GOOD_PLUGIN_SOUPHTTPSRC=y
BR2_PACKAGE_GST1_PLUGINS_BAD_PLUGIN_MPEGTSDEMUX=y
BR2_PACKAGE_GST1_PLUGINS_BAD_PLUGIN_VIDEOPARSERS=y
BR2_PACKAGE_GST1_PLUGINS_BAD_PLUGIN_DASH=y
BR2_PACKAGE_GST1_PLUGINS_BAD_PLUGIN_FAAD=y
BR2_PACKAGE_GST1_PLUGINS_BAD_PLUGIN_HLS=y
BR2_PACKAGE_GST1_PLUGINS_BAD_PLUGIN_SMOOTHSTREAMING=y
BR2_PACKAGE_GST1_PLUGINS_UGLY=y
BR2_PACKAGE_GST1_PLUGINS_UGLY_PLUGIN_MPG123=y
BR2_PACKAGE_NINJA=y
BR2_PACKAGE_BCM_REFSW_PLATFORM_7437=y
BR2_PACKAGE_BITSTREAM_VERA=y
BR2_PACKAGE_BCM_REFSW=y
BR2_PACKAGE_BCM_REFSW_16_2=y
# BR2_PACKAGE_EUDEV_ENABLE_HWDB is not set
BR2_PACKAGE_WPEWEBKIT=y
# BR2_PACKAGE_WPEWEBKIT_USE_ENCRYPTED_MEDIA_V1 is not set
BR2_PACKAGE_ORC=y
BR2_PACKAGE_ICU_USE_ICUDATA=y
BR2_PACKAGE_SHARED_MIME_INFO=y
BR2_PACKAGE_DROPBEAR=y
BR2_PACKAGE_GESFTPSERVER=y
BR2_PACKAGE_WEBBRIDGE=y
BR2_PACKAGE_WEBBRIDGE_PLUGIN_TRACECONTROL=y
BR2_PACKAGE_WEBBRIDGE_PLUGIN_MONITOR=y
BR2_PACKAGE_WEBBRIDGE_PLUGIN_WEBPROXY=y
BR2_PACKAGE_WEBBRIDGE_PLUGIN_REMOTECONTROL=y
BR2_PACKAGE_WEBBRIDGE_PLUGIN_DEVICEINFO=y
BR2_PACKAGE_WEBBRIDGE_PLUGIN_WEBKITBROWSER=y
BR2_PACKAGE_WEBBRIDGE_PLUGIN_WEBKITBROWSER_STARTURL="file:///www/index.html"
BR2_PACKAGE_WEBBRIDGE_PLUGIN_WEBKITBROWSER_USERAGENT="Mozilla/5.0 (Macintosh, Intel Mac OS X 10_11_4) AppleWebKit/602.1.28+ (KHTML, like Gecko) Version/9.1 Safari/601.5.17 WPE-Reference"
BR2_PACKAGE_WEBBRIDGE_PLUGIN_WEBKITBROWSER_MEMORYPRESSURE="databaseprocess:30m,networkprocess:50m,webprocess:200m,rpcprocess:50m"
BR2_PACKAGE_WEBBRIDGE_PLUGIN_WEBKITBROWSER_TRANSPARENT=y
BR2_PACKAGE_WEBBRIDGE_PLUGIN_DIALSERVER=y
BR2_PACKAGE_WEBBRIDGE_PLUGIN_WEBSERVER=y
BR2_PACKAGE_WEBBRIDGE_PLUGIN_IRNEXUS=y
BR2_PACKAGE_WEBBRIDGE_PLUGIN_IRNEXUS_MODE="16"
BR2_TARGET_ROOTFS_CPIO=y
BR2_TARGET_ROOTFS_CPIO_XZ=y
```
