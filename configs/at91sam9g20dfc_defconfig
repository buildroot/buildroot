## configs/evasion7241_wpe_defconfig
```kconfig
BR2_mipsel=y
# BR2_MIPS_SOFT_FLOAT is not set
BR2_CCACHE=y
BR2_OPTIMIZE_2=y
BR2_TOOLCHAIN_EXTERNAL=y
BR2_TOOLCHAIN_EXTERNAL_PATH="/opt/toolchain/evasion/usr"
BR2_TOOLCHAIN_EXTERNAL_CUSTOM_PREFIX="mipsel-evasion-linux-gnu"
BR2_TOOLCHAIN_EXTERNAL_GCC_5=y
BR2_TOOLCHAIN_EXTERNAL_HEADERS_3_8=y
BR2_TOOLCHAIN_EXTERNAL_CUSTOM_GLIBC=y
BR2_TOOLCHAIN_EXTERNAL_CXX=y
BR2_TARGET_GENERIC_CABUNDLE=y
BR2_INIT_NONE=y
BR2_ROOTFS_DEVICE_CREATION_DYNAMIC_EUDEV=y
BR2_TARGET_GENERIC_ROOT_PASSWD="root"
BR2_TARGET_GENERIC_GETTY_TERM=""
BR2_ROOTFS_POST_BUILD_SCRIPT="board/bcm/clean-rootfs.sh"
BR2_ROOTFS_POST_IMAGE_SCRIPT="board/evasion/evasion.sh"
# BR2_PACKAGE_BUSYBOX is not set
BR2_PACKAGE_GSTREAMER1=y
BR2_PACKAGE_GST1_BCM=y
BR2_PACKAGE_GST1_PLUGINS_BASE_PLUGIN_APP=y
BR2_PACKAGE_GST1_PLUGINS_BASE_PLUGIN_VIDEOCONVERT=y
BR2_PACKAGE_GST1_PLUGINS_BASE_PLUGIN_GIO=y
BR2_PACKAGE_GST1_PLUGINS_BASE_PLUGIN_OPUS=y
BR2_PACKAGE_GST1_PLUGINS_GOOD_PLUGIN_AUDIOFX=y
BR2_PACKAGE_GST1_PLUGINS_GOOD_PLUGIN_AUDIOPARSERS=y
BR2_PACKAGE_GST1_PLUGINS_GOOD_PLUGIN_DEINTERLACE=y
BR2_PACKAGE_GST1_PLUGINS_GOOD_PLUGIN_FLV=y
BR2_PACKAGE_GST1_PLUGINS_GOOD_PLUGIN_INTERLEAVE=y
BR2_PACKAGE_GST1_PLUGINS_GOOD_PLUGIN_MATROSKA=y
BR2_PACKAGE_GST1_PLUGINS_GOOD_PLUGIN_SOUPHTTPSRC=y
BR2_PACKAGE_GST1_PLUGINS_BAD_PLUGIN_MPEGTSDEMUX=y
BR2_PACKAGE_GST1_PLUGINS_BAD_PLUGIN_VIDEOPARSERS=y
BR2_PACKAGE_GST1_PLUGINS_BAD_PLUGIN_DASH=y
BR2_PACKAGE_GST1_PLUGINS_BAD_PLUGIN_FAAD=y
BR2_PACKAGE_GST1_PLUGINS_BAD_PLUGIN_HLS=y
BR2_PACKAGE_GST1_PLUGINS_BAD_PLUGIN_OPUS=y
BR2_PACKAGE_GST1_PLUGINS_BAD_PLUGIN_SMOOTHSTREAMING=y
BR2_PACKAGE_GST1_PLUGINS_UGLY=y
BR2_PACKAGE_GST1_PLUGINS_UGLY_PLUGIN_MPG123=y
BR2_PACKAGE_NETFLIX5=y
BR2_PACKAGE_NETFLIX5_LIB=y
BR2_PACKAGE_NINJA=y
BR2_PACKAGE_PLAYREADY=y
BR2_PACKAGE_BITSTREAM_VERA=y
# BR2_PACKAGE_EUDEV_ENABLE_HWDB is not set
BR2_PACKAGE_EVASION_SDK=y
BR2_PACKAGE_WPEFRAMEWORK=y
BR2_PACKAGE_WPEFRAMEWORK_BUILD_TYPE_RELEASE_WITH_SYMBOLS=y
BR2_PACKAGE_WPEFRAMEWORK_VIRTUALINPUT=y
BR2_PACKAGE_WPEFRAMEWORK_MONITOR=y
BR2_PACKAGE_WPEFRAMEWORK_REMOTECONTROL=y
BR2_PACKAGE_WPEFRAMEWORK_REMOTECONTROL_CUSTOM_VIRTUAL=y
BR2_PACKAGE_WPEFRAMEWORK_REMOTECONTROL_CUSTOM_VIRTUAL_NAME="Evasion"
BR2_PACKAGE_WPEFRAMEWORK_REMOTECONTROL_CUSTOM_VIRTUAL_MAP_FILE="Evasion.json"
BR2_PACKAGE_WPEFRAMEWORK_SNAPSHOT=y
BR2_PACKAGE_WPEFRAMEWORK_TIMESYNC=y
BR2_PACKAGE_WPEFRAMEWORK_TRACECONTROL=y
BR2_PACKAGE_WPEFRAMEWORK_WEBKITBROWSER=y
BR2_PACKAGE_WPEFRAMEWORK_WEBKITBROWSER_STARTURL="file:///www/index.html"
BR2_PACKAGE_WPEFRAMEWORK_WEBKITBROWSER_MEMORYPRESSURE="databaseprocess:30m,networkprocess:50m,webprocess:170m,rpcprocess:50m"
BR2_PACKAGE_WPEFRAMEWORK_WEBKITBROWSER_DISKCACHE="90m"
BR2_PACKAGE_WPEFRAMEWORK_WEBKITBROWSER_XHRCACHE=y
BR2_PACKAGE_WPEFRAMEWORK_WEBKITBROWSER_TRANSPARENT=y
BR2_PACKAGE_WPEFRAMEWORK_YOUTUBE=y
BR2_PACKAGE_WPEFRAMEWORK_WEBSERVER=y
BR2_PACKAGE_WPEFRAMEWORK_NETFLIX=y
BR2_PACKAGE_WPEFRAMEWORK_PROVISIONING=y
BR2_PACKAGE_WPEWEBKIT=y
BR2_PACKAGE_LIBINPUT=y
BR2_PACKAGE_ORC=y
BR2_PACKAGE_ICU_USE_ICUDATA=y
BR2_PACKAGE_SHARED_MIME_INFO=y
BR2_PACKAGE_DROPBEAR=y
BR2_PACKAGE_GESFTPSERVER=y
```

## configs/explora_bcm7267_wpe_ml_defconfig
```kconfig
BR2_arm=y
BR2_cortex_a15=y
BR2_ARM_FPU_NEON_VFPV4=y
BR2_ARM_INSTRUCTIONS_THUMB2=y
BR2_CCACHE=y
BR2_OPTIMIZE_2=y
BR2_TOOLCHAIN_BUILDROOT_GLIBC=y
BR2_KERNEL_HEADERS_4_9=y
BR2_GCC_VERSION_9_X=y
BR2_TOOLCHAIN_BUILDROOT_CXX=y
BR2_GCC_ENABLE_LTO=y
BR2_PACKAGE_HOST_GDB=y
BR2_ROOTFS_DEVICE_CREATION_DYNAMIC_EUDEV=y
BR2_TARGET_GENERIC_ROOT_PASSWD="root"
BR2_TARGET_GENERIC_GETTY_PORT="ttyS0"
BR2_SYSTEM_DHCP="eth0"
BR2_ROOTFS_POST_BUILD_SCRIPT="board/explora/post-build.sh"
BR2_ROOTFS_POST_IMAGE_SCRIPT="board/explora/explora.sh"
BR2_PACKAGE_AMAZON_BACKEND=y
BR2_PACKAGE_AMAZON_IGNITION=y
BR2_PACKAGE_GST1_BCM=y
BR2_PACKAGE_GST1_PLUGINS_BASE_PLUGIN_APP=y
BR2_PACKAGE_GST1_PLUGINS_BASE_PLUGIN_VIDEOCONVERT=y
BR2_PACKAGE_GST1_PLUGINS_BASE_PLUGIN_GIO=y
BR2_PACKAGE_GST1_PLUGINS_BASE_PLUGIN_OGG=y
BR2_PACKAGE_GST1_PLUGINS_BASE_PLUGIN_OPUS=y
BR2_PACKAGE_GST1_PLUGINS_UGLY=y
BR2_PACKAGE_NETFLIX52=y
# BR2_PACKAGE_NETFLIX52_AUDIO_MIXER is not set
BR2_PACKAGE_BITSTREAM_VERA=y
BR2_PACKAGE_EXPLORA_SDK=y
BR2_PACKAGE_WPEFRAMEWORK_PORT="2300"
BR2_PACKAGE_WPEFRAMEWORK_DATA_PATH="/UserApps/metrological/usr/share/WPEFramework"
BR2_PACKAGE_WPEFRAMEWORK_SYSTEM_PATH="/UserApps/metrological/usr/lib/wpeframework/plugins"
BR2_PACKAGE_WPEFRAMEWORK_PROXYSTUB_PATH="/UserApps/metrological/usr/lib/wpeframework/proxystubs"
BR2_PACKAGE_WPEFRAMEWORK_SYSTEM_PREFIX="MCA"
BR2_PACKAGE_WPEFRAMEWORK_COMPOSITOR=y
BR2_PACKAGE_WPEFRAMEWORK_COMPOSITOR_OUTOFPROCESS=y
BR2_PACKAGE_WPEFRAMEWORK_COMPOSITOR_RESOLUTION_1080P=y
BR2_PACKAGE_WPEFRAMEWORK_COMPOSITOR_NEXUS_SERVER_EXTERNAL=y
BR2_PACKAGE_WPEFRAMEWORK_DIALSERVER=y
BR2_PACKAGE_WPEFRAMEWORK_DIALSERVER_NAME="ExploraUltra"
BR2_PACKAGE_WPEFRAMEWORK_DIALSERVER_NETFLIX_MODE_ACTIVE=y
BR2_PACKAGE_WPEFRAMEWORK_INPUTSWITCH=y
BR2_PACKAGE_WPEFRAMEWORK_LOCATIONSYNC=y
BR2_PACKAGE_WPEFRAMEWORK_LOCATIONSYNC_URI="http://jsonip.metrological.com/?maf=true"
BR2_PACKAGE_WPEFRAMEWORK_REMOTECONTROL=y
BR2_PACKAGE_WPEFRAMEWORK_TIMESYNC=y
BR2_PACKAGE_WPEFRAMEWORK_TRACECONTROL=y
BR2_PACKAGE_WPEFRAMEWORK_VOLUMECONTROL=y
BR2_PACKAGE_WPEFRAMEWORK_AMAZON_MANUFACTURER="Commscope"
BR2_PACKAGE_WPEFRAMEWORK_AMAZON_FRAGMENT_CACHE_SIZE="100"
BR2_PACKAGE_WPEFRAMEWORK_AMAZON_USER="amazon"
BR2_PACKAGE_WPEFRAMEWORK_AMAZON_GROUP="amazon"
BR2_PACKAGE_WPEFRAMEWORK_WEBSERVER=y
BR2_PACKAGE_WPEFRAMEWORK_WEBSERVER_PORT="80"
BR2_PACKAGE_WPEFRAMEWORK_AMAZON=y
BR2_PACKAGE_WPEFRAMEWORK_AMAZON_DTID="A1I8SDQ4F0D8V0"
BR2_PACKAGE_WPEFRAMEWORK_AMAZON_MODEL="Explora Ultra"
BR2_PACKAGE_WPEFRAMEWORK_AMAZON_CHIPSET="BCM7267"
BR2_PACKAGE_WPEFRAMEWORK_AMAZON_CA_BUNDLE_PATH="/UserApps/metrological/etc/ssl/certs/"
BR2_PACKAGE_WPEFRAMEWORK_AMAZON_AUTOSTART=y
BR2_PACKAGE_WPEFRAMEWORK_AMAZON_INSTALL_PATH_OVERRIDE="/UserApps/metrological/usr/share/ignition/"
BR2_PACKAGE_WPEFRAMEWORK_NETFLIX=y
BR2_PACKAGE_WPEFRAMEWORK_PLUGIN_NETFLIX_AUTOSTART=y
BR2_PACKAGE_WPEFRAMEWORK_PLUGIN_NETFLIX_MODEL="Multichoice_Explora Ultra Model"
BR2_PACKAGE_WPEFRAMEWORK_PLUGIN_NETFLIX_FRIENDLY_NAME="ExploraUltra"
BR2_PACKAGE_WPEFRAMEWORK_PLUGIN_NETFLIX_VERSION_POSTFIX="1.0.4"
BR2_PACKAGE_WPEFRAMEWORK_PLUGIN_NETFLIX_SURFACE_CACHE_SIZE="58720256"
BR2_PACKAGE_WPEFRAMEWORK_PLUGIN_NETFLIX_HDR10=y
BR2_PACKAGE_WPEFRAMEWORK_PLUGIN_NETFLIX_HEVC=y
BR2_PACKAGE_WPEFRAMEWORK_PLUGIN_NETFLIX_VP9_P2=y
BR2_PACKAGE_WPEFRAMEWORK_PLUGIN_NETFLIX_VP9_HDR=y
BR2_PACKAGE_WPEFRAMEWORK_PLUGIN_NETFLIX_DEFAULT_LAUGUAGE="en-ZA"
BR2_PACKAGE_WPEFRAMEWORK_PLUGIN_NETFLIX_DEVICE_KEYS="/tmp/netflix.bin"
BR2_PACKAGE_WPEFRAMEWORK_PROVISIONING=y
BR2_PACKAGE_WPEFRAMEWORK_PROVISIONING_CLOUD=y
BR2_PACKAGE_WPEFRAMEWORK_PROVISIONING_FILES=y
BR2_PACKAGE_ORC=y
BR2_PACKAGE_SHARED_MIME_INFO=y
BR2_PACKAGE_DROPBEAR=y
BR2_PACKAGE_GESFTPSERVER=y
BR2_PACKAGE_WPA_SUPPLICANT=y
BR2_PACKAGE_WPA_SUPPLICANT_AP_SUPPORT=y
BR2_PACKAGE_WPA_SUPPLICANT_AUTOSCAN=y
BR2_PACKAGE_WPA_SUPPLICANT_EAP=y
BR2_PACKAGE_WPA_SUPPLICANT_HOTSPOT=y
BR2_PACKAGE_WPA_SUPPLICANT_WPS=y
```

## configs/explora_bcm7267_wpe_nfs_defconfig
```kconfig
BR2_arm=y
BR2_cortex_a15=y
BR2_ARM_FPU_NEON_VFPV4=y
BR2_ARM_INSTRUCTIONS_THUMB2=y
BR2_CCACHE=y
BR2_OPTIMIZE_2=y
BR2_TOOLCHAIN_BUILDROOT_GLIBC=y
BR2_KERNEL_HEADERS_4_9=y
BR2_GLIBC_VERSION_2_25=y
BR2_BINUTILS_VERSION_2_27_X=y
BR2_GCC_VERSION_6_X=y
BR2_TOOLCHAIN_BUILDROOT_CXX=y
BR2_GCC_ENABLE_LTO=y
BR2_PACKAGE_HOST_GDB=y
BR2_GDB_VERSION_7_12=y
BR2_TARGET_GENERIC_HOSTNAME="explora"
BR2_TARGET_GENERIC_ISSUE="Welcome to Explora UHD"
BR2_TARGET_GENERIC_CABUNDLE=y
# BR2_TARGET_GENERIC_NETWORK is not set
BR2_ROOTFS_DEVICE_CREATION_DYNAMIC_EUDEV=y
BR2_TARGET_GENERIC_ROOT_PASSWD="root"
BR2_TARGET_GENERIC_GETTY_PORT="ttyS0"
BR2_SYSTEM_DHCP="eth0"
BR2_ROOTFS_POST_BUILD_SCRIPT="board/explora/post-build.sh"
BR2_ROOTFS_POST_IMAGE_SCRIPT="board/explora/explora.sh"
BR2_LINUX_KERNEL=y
BR2_LINUX_KERNEL_CUSTOM_GIT=y
BR2_LINUX_KERNEL_CUSTOM_REPO_URL="git@github.com:Metrological/bcm-stblinux-4.9.git"
BR2_LINUX_KERNEL_CUSTOM_REPO_VERSION="master"
BR2_LINUX_KERNEL_USE_CUSTOM_CONFIG=y
BR2_LINUX_KERNEL_CUSTOM_CONFIG_FILE="board/explora/linux-4.9.config"
BR2_PACKAGE_BUSYBOX_SMP=y
BR2_PACKAGE_GSTREAMER1=y
BR2_PACKAGE_GST1_BCM=y
BR2_PACKAGE_GST1_BCM_ENABLE_SVP=y
BR2_PACKAGE_GST1_PLUGINS_BASE_PLUGIN_APP=y
BR2_PACKAGE_GST1_PLUGINS_BASE_PLUGIN_VIDEOCONVERT=y
BR2_PACKAGE_GST1_PLUGINS_BASE_PLUGIN_GIO=y
BR2_PACKAGE_GST1_PLUGINS_BASE_PLUGIN_OPUS=y
BR2_PACKAGE_GST1_PLUGINS_GOOD_PLUGIN_AUDIOFX=y
BR2_PACKAGE_GST1_PLUGINS_GOOD_PLUGIN_AUDIOPARSERS=y
BR2_PACKAGE_GST1_PLUGINS_GOOD_PLUGIN_DEINTERLACE=y
BR2_PACKAGE_GST1_PLUGINS_GOOD_PLUGIN_ICYDEMUX=y
BR2_PACKAGE_GST1_PLUGINS_GOOD_PLUGIN_ID3DEMUX=y
BR2_PACKAGE_GST1_PLUGINS_GOOD_PLUGIN_INTERLEAVE=y
BR2_PACKAGE_GST1_PLUGINS_GOOD_PLUGIN_MATROSKA=y
BR2_PACKAGE_GST1_PLUGINS_GOOD_PLUGIN_SOUPHTTPSRC=y
BR2_PACKAGE_GST1_PLUGINS_BAD_PLUGIN_MPEGTSDEMUX=y
BR2_PACKAGE_GST1_PLUGINS_BAD_PLUGIN_VIDEOPARSERS=y
BR2_PACKAGE_GST1_PLUGINS_BAD_PLUGIN_DASH=y
BR2_PACKAGE_GST1_PLUGINS_BAD_PLUGIN_FAAD=y
BR2_PACKAGE_GST1_PLUGINS_BAD_PLUGIN_HLS=y
BR2_PACKAGE_GST1_PLUGINS_BAD_PLUGIN_OPUS=y
BR2_PACKAGE_GST1_PLUGINS_BAD_PLUGIN_SMOOTHSTREAMING=y
BR2_PACKAGE_GST1_PLUGINS_UGLY=y
BR2_PACKAGE_GST1_PLUGINS_UGLY_PLUGIN_MPG123=y
BR2_PACKAGE_NETFLIX52=y
BR2_PACKAGE_NINJA=y
BR2_PACKAGE_BITSTREAM_VERA=y
BR2_PACKAGE_BCM_REFSW=y
BR2_PACKAGE_BCM_REFSW_19_2=y
BR2_PACKAGE_BCM_REFSW_PLATFORM_7268_B0=y
BR2_PACKAGE_BCM_REFSW_SAGE=y
BR2_PACKAGE_BCM_REFSW_SAGE_MANUFACTURING=y
BR2_PACKAGE_BCM_REFSW_SAGE_PLAYREADY_30=y
BR2_PACKAGE_BCM_REFSW_SAGE_WIDEVINE=y
BR2_PACKAGE_BCM_REFSW_NXCLIENT_EXAMPLES=y
BR2_PACKAGE_BCM_REFSW_BOXMODE="1"
BR2_PACKAGE_WPEFRAMEWORK=y
BR2_PACKAGE_WPEFRAMEWORK_BUILD_TYPE_DEBUG=y
BR2_PACKAGE_WPEFRAMEWORK_SYSTEM_PREFIX="MCA"
BR2_PACKAGE_WPEFRAMEWORK_CRYPTOGRAPHY=y
BR2_PACKAGE_WPEFRAMEWORK_CRYPTOGRAPHY_IMPLEMENTATION_NEXUS=y
# BR2_PACKAGE_WPEFRAMEWORK_CDMI_SOFTWARE_OVERRIDE is not set
BR2_PACKAGE_WPEFRAMEWORK_CDMI_PLAYREADY_SECURE_STOP_METERING_CERTIFICATE="/UserApps/metrological/root/Netflix/artifacts/MeteringCertificate.bin"
# BR2_PACKAGE_WPEFRAMEWORK_CDMI_WIDEVINE_MODULE is not set
BR2_PACKAGE_WPEFRAMEWORK_COBALT=y
BR2_PACKAGE_WPEFRAMEWORK_COBALT_AUTOSTART=y
BR2_PACKAGE_WPEFRAMEWORK_COMPOSITOR=y
BR2_PACKAGE_WPEFRAMEWORK_COMPOSITOR_OUTOFPROCESS=y
BR2_PACKAGE_WPEFRAMEWORK_COMPOSITOR_RESOLUTION_1080P=y
BR2_PACKAGE_WPEFRAMEWORK_COMPOSITOR_BOXMODE="1"
BR2_PACKAGE_WPEFRAMEWORK_COMPOSITOR_SVP_NONE=y
BR2_PACKAGE_WPEFRAMEWORK_COMPOSITOR_MEMORIES=y
BR2_PACKAGE_WPEFRAMEWORK_COMPOSITOR_MEMORY_EXPORT="2"
BR2_PACKAGE_WPEFRAMEWORK_COMPOSITOR_HARDWAREREADY="2"
# BR2_PACKAGE_WPEFRAMEWORK_DEVICEIDENTIFICATION is not set
BR2_PACKAGE_WPEFRAMEWORK_DIALSERVER=y
BR2_PACKAGE_WPEFRAMEWORK_DIALSERVER_NAME="ExploraPlus"
BR2_PACKAGE_WPEFRAMEWORK_DIALSERVER_YOUTUBE_MODE_ACTIVE=y
BR2_PACKAGE_WPEFRAMEWORK_DIALSERVER_NETFLIX_MODE_ACTIVE=y
BR2_PACKAGE_WPEFRAMEWORK_INPUTSWITCH=y
BR2_PACKAGE_WPEFRAMEWORK_LOCATIONSYNC=y
BR2_PACKAGE_WPEFRAMEWORK_LOCATIONSYNC_URI="http://jsonip.metrological.com/?maf=true"
# BR2_PACKAGE_WPEFRAMEWORK_PLAYERINFO is not set
BR2_PACKAGE_WPEFRAMEWORK_REMOTECONTROL=y
BR2_PACKAGE_WPEFRAMEWORK_TIMESYNC=y
BR2_PACKAGE_WPEFRAMEWORK_TRACECONTROL=y
BR2_PACKAGE_WPEFRAMEWORK_VOLUMECONTROL=y
BR2_PACKAGE_WPEFRAMEWORK_WEBKITBROWSER=y
BR2_PACKAGE_WPEFRAMEWORK_WEBKITBROWSER_STARTURL="http://www.youtube.com/tv"
BR2_PACKAGE_WPEFRAMEWORK_WEBKITBROWSER_MEMORYPROFILE="512m"
BR2_PACKAGE_WPEFRAMEWORK_WEBKITBROWSER_MEMORYPRESSURE="databaseprocess:50m,networkprocess:100m,webprocess:512m,rpcprocess:50m"
BR2_PACKAGE_WPEFRAMEWORK_WEBKITBROWSER_TRANSPARENT=y
BR2_PACKAGE_WPEFRAMEWORK_UX=y
BR2_PACKAGE_WPEFRAMEWORK_NETFLIX=y
BR2_PACKAGE_WPEFRAMEWORK_PLUGIN_NETFLIX_AUTOSTART=y
BR2_PACKAGE_WPEFRAMEWORK_PLUGIN_NETFLIX_MODEL="Multichoice_Explora Plus Model"
BR2_PACKAGE_WPEFRAMEWORK_PLUGIN_NETFLIX_DEVICE_KEYS="/tmp/netflix.bin"
BR2_PACKAGE_WPEFRAMEWORK_PROVISIONING=y
BR2_PACKAGE_WPEFRAMEWORK_PROVISIONING_OPERATOR="multichoice"
BR2_PACKAGE_WPEWEBKIT=y
BR2_PACKAGE_WPEWEBKIT_ALTERNATIVE_EXEC_PATH="/UserApps/metrological/usr/bin"
BR2_PACKAGE_LIBPTHREAD_STUBS=y
BR2_PACKAGE_ORC=y
BR2_PACKAGE_ICU_USE_ICUDATA=y
BR2_PACKAGE_SHARED_MIME_INFO=y
BR2_PACKAGE_DROPBEAR=y
BR2_PACKAGE_GESFTPSERVER=y
BR2_PACKAGE_WPA_SUPPLICANT=y
BR2_PACKAGE_WPA_SUPPLICANT_AP_SUPPORT=y
BR2_PACKAGE_WPA_SUPPLICANT_AUTOSCAN=y
BR2_PACKAGE_WPA_SUPPLICANT_EAP=y
BR2_PACKAGE_WPA_SUPPLICANT_HOTSPOT=y
BR2_PACKAGE_WPA_SUPPLICANT_WPS=y
BR2_PACKAGE_HOST_MKE2IMG=y
```
