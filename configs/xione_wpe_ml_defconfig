## package/WPEFramework/Config.in
```kconfig
config BR2_PACKAGE_WPEFRAMEWORK
	bool "wpeframework"
	help
	   Base WPE Framework	  
	   
menu "Options"

config BR2_PACKAGE_WPEFRAMEWORK_PORT
	string "port"
	default "80"

config BR2_PACKAGE_WPEFRAMEWORK_BIND
	string "bind"
	default "0.0.0.0"

config BR2_PACKAGE_WPEFRAMEWORK_INTERFACE
	string "interface"
	default ""

config BR2_PACKAGE_WPEFRAMEWORK_IDLE_TIME
	string "idle-time"
	default "180"

config BR2_PACKAGE_WPEFRAMEWORK_PERSISTENT_PATH
	string "persistent path"
	default "/root"

config BR2_PACKAGE_WPEFRAMEWORK_DATA_PATH
	string "data path"
	default "/usr/share/WPEFramework"

config BR2_PACKAGE_WPEFRAMEWORK_SYSTEM_PATH
	string "system path"
	default "/usr/lib/WPEFramework"

config BR2_PACKAGE_WPEFRAMEWORK_PROXYSTUB_PATH
	string "proxystub path"
	default "/usr/lib/WPEFramework/proxystubs"

config BR2_PACKAGE_WPEFRAMEWORK_NO_WEBUI
	bool "no web interface"

config BR2_PACKAGE_WPEFRAMEWORK_OOM_ADJUST
	string "oom-adjust"
	default ""

endmenu
	  
if BR2_PACKAGE_WPEFRAMEWORK

menu "Plugins"

source "package/WPEFramework/WPEFramework-DevTools/Config.in"

config BR2_PACKAGE_WPEFRAMEWORK_VIRTUALINPUT
	bool "VirtualInput"
	help
	   If the dynamic uinput system can not be used for security reasons, this
           allows for relaying keys to plugins
          
config BR2_PACKAGE_WPEFRAMEWORK_PROVISIONPROXY
	bool "ProvisionProxy"
        select BR2_PACKAGE_LIBPROVISION
	help
	   Allows provisioning of modules from the cloud.
          
source "package/WPEFramework/WPEFramework-Provisioning/Config.in"
source "package/WPEFramework/WPEFramework-DIALServer/Config.in"
source "package/WPEFramework/WPEFramework-Netflix/Config.in"
source "package/WPEFramework/WPEFramework-Compositor/Config.in"
source "package/WPEFramework/WPEFramework-SwitchBoard/Config.in"
source "package/WPEFramework/WPEFramework-Dictionary/Config.in"

source "package/WPEFramework/WPEFramework-Common/Config.in"

endmenu

endif
```

## package/WPEFramework/WPEFramework-Compositor/Config.in
```kconfig
menuconfig BR2_PACKAGE_WPEFRAMEWORK_COMPOSITOR
	bool "WPEFramework-Compositor"

	help
	   WPE Platform Compositor plugin

if BR2_PACKAGE_WPEFRAMEWORK_COMPOSITOR

if BR2_PACKAGE_BCM_REFSW
choice
	prompt "Nexus server"
	default BR2_PACKAGE_WPEFRAMEWORK_COMPOSITOR_SERVICE_EXTERNAL
	help
	  Choose this if the system has a allready a resource server running like nxserver.
	  
	config BR2_PACKAGE_WPEFRAMEWORK_COMPOSITOR_SERVICE_EXTERNAL
		bool "external" 
		
	config BR2_PACKAGE_WPEFRAMEWORK_COMPOSITOR_SERVICE_INTERNAL
		bool "internal"
endchoice
endif

config BR2_PACKAGE_WPEFRAMEWORK_COMPOSITOR_AUTOTRACE
   bool "Enable Tracing at startup"
   help 
     If enabled the compositer plug-in will start tracing 
     when WPEFramework is started.
     
config BR2_PACKAGE_WPEFRAMEWORK_COMPOSITOR_OUTOFPROCESS
	bool "Out of process"
	help
	  Select this to run this plugin in its own process. 
     
config BR2_PACKAGE_WPEFRAMEWORK_COMPOSITOR_HARDWAREREADY
	string "Manual overrule of the time it takes to initialisize all hardware (ms)"
	default 0

config BR2_PACKAGE_WPEFRAMEWORK_COMPOSITOR_SYSTEM
	string "Callsign to report information."
	default Controller

endif
```

## package/WPEFramework/WPEFramework-DIALServer/Config.in
```kconfig
menuconfig BR2_PACKAGE_WPEFRAMEWORK_DIALSERVER
	bool "DIALServer"

	help
	   WPE Platform DIALServer plugin
```

## package/WPEFramework/WPEFramework-Dictionary/Config.in
```kconfig
menuconfig BR2_PACKAGE_WPEFRAMEWORK_DICTIONARY
	bool "Dictionary"

	help
	   WPE Platform Dictionary plugin
```

## package/WPEFramework/WPEFramework-Open/Config.in
```kconfig
config BR2_PACKAGE_WPEFRAMEWORK_OPEN
	bool "WPEFramework Open plugins"

	help
	   Commander Plugin
	   
if BR2_PACKAGE_WPEFRAMEWORK_OPEN
config BR2_PACKAGE_WPEFRAMEWORK_OPEN_COMMANDER
	bool "Commander"
	help
	   Commander Plugin

menuconfig BR2_PACKAGE_WPEFRAMEWORK_OPEN_DEVICEINFO
	bool "DeviceInfo"
	help
	   DeviceInfo Plugin

menuconfig BR2_PACKAGE_WPEFRAMEWORK_OPEN_LOCATIONSYNC
	bool "LocationSync"
	help
	   LocationSync Plugin
	   WPE Platform Dictionary plugin
	   
if BR2_PACKAGE_WPEFRAMEWORK_OPEN_LOCATIONSYNC
config BR2_PACKAGE_WPEFRAMEWORK_OPEN_LOCATIONSYNC_URI
	string "location URI"
	default "location.webplatformforembedded.org"
endif	   

config BR2_PACKAGE_WPEFRAMEWORK_OPEN_MONITOR
        bool "Monitor"
        help
           Monitor Plugin

config BR2_PACKAGE_WPEFRAMEWORK_OPEN_TIMESYNC
	bool "TimeSync"
	help
	   TimeSync Plugin

menuconfig BR2_PACKAGE_WPEFRAMEWORK_OPEN_REMOTECONTROL
	bool "RemoteControl"
	help
	   RemoteControl Plugin

if BR2_PACKAGE_WPEFRAMEWORK_OPEN_REMOTECONTROL

config BR2_PACKAGE_WPEFRAMEWORK_OPEN_REMOTECONTROL_IR
    bool "IR (Infrared)"
    help
       Select devices which are based on Infrared (IR) technology

config BR2_PACKAGE_WPEFRAMEWORK_OPEN_REMOTECONTROL_IRNEXUS
    bool "BCM Nexus IR Remote Control Unit"
    default false
    depends on BR2_PACKAGE_BCM_REFSW && BR2_PACKAGE_WPEFRAMEWORK_OPEN_REMOTECONTROL_IR
    help
       Enable the Nexus IR remote input

config BR2_PACKAGE_WPEFRAMEWORK_OPEN_REMOTECONTROL_IRNEXUS_MODE
    string "IR mode"
    default "16"
    depends on BR2_PACKAGE_WPEFRAMEWORK_OPEN_REMOTECONTROL_IRNEXUS
    help
       Sets the IR Mode to be used with IR Nexus. Every remote has a different mode and key mapping.

config BR2_PACKAGE_WPEFRAMEWORK_OPEN_REMOTECONTROL_RF
    bool "RF (Radio Frequency)"
    help
       Select devices which are based on Radio Frequency (RF) technology

endif

config BR2_PACKAGE_WPEFRAMEWORK_OPEN_SNAPSHOT
	bool "Snapshot"
	help
	   Snapshot Plugin

config BR2_PACKAGE_WPEFRAMEWORK_OPEN_TRACECONTROL
	bool "TraceControl"
	help
	   TraceControl Plugin

menuconfig BR2_PACKAGE_WPEFRAMEWORK_OPEN_WEBKITBROWSER
	bool "WebKitBrowser"
	depends on BR2_PACKAGE_WPEWEBKIT
	help
	   WebKitBrowser Plugin

if BR2_PACKAGE_WPEFRAMEWORK_OPEN_WEBKITBROWSER

config BR2_PACKAGE_WPEFRAMEWORK_OPEN_WEBKITBROWSER_AUTOSTART
    bool "autostart"
    default y

config BR2_PACKAGE_WPEFRAMEWORK_OPEN_WEBKITBROWSER_STARTURL
    string "start-url"
    default "about:blank"

config BR2_PACKAGE_WPEFRAMEWORK_OPEN_WEBKITBROWSER_USERAGENT
    string "useragent"
    default "Mozilla/5.0 (Macintosh, Intel Mac OS X 10_11_4) AppleWebKit/602.1.28+ (KHTML, like Gecko) Version/9.1 Safari/601.5.17"

config BR2_PACKAGE_WPEFRAMEWORK_OPEN_WEBKITBROWSER_MEMORYPROFILE
    string "memory-profile"
    default "128m"

config BR2_PACKAGE_WPEFRAMEWORK_OPEN_WEBKITBROWSER_MEMORYPRESSURE
    string "memory-pressure"
    default "databaseprocess:50m,networkprocess:100m,webprocess:300m,rpcprocess:50m"

config BR2_PACKAGE_WPEFRAMEWORK_OPEN_WEBKITBROWSER_MEDIADISKCACHE
    bool "media-disk-cache"
    default n

config BR2_PACKAGE_WPEFRAMEWORK_OPEN_WEBKITBROWSER_DISKCACHE
    string "disk-cache"
    default "0"

config BR2_PACKAGE_WPEFRAMEWORK_OPEN_WEBKITBROWSER_XHRCACHE
    bool "xhr-cache"
    default false

config BR2_PACKAGE_WPEFRAMEWORK_OPEN_WEBKITBROWSER_TRANSPARENT
    bool "transparent"
    default false

config BR2_PACKAGE_WPEFRAMEWORK_OPEN_YOUTUBE
    bool "youtube"
    help
      A wrapper around the youtube app to start it as a
      wpeframework plugin.

endif

config BR2_PACKAGE_WPEFRAMEWORK_OPEN_WEBPROXY
	bool "WebProxy"
	help
	   WebProxy Plugin

config BR2_PACKAGE_WPEFRAMEWORK_OPEN_WEBSERVER
        bool "WebServer"
        help
           WebServer Plugin


config BR2_PACKAGE_WPEFRAMEWORK_OPEN_WEBSHELL
	bool "WebShell"

	help
	   WebShell Plugin

endif
```

## package/WPEFramework/WPEFramework-Provisioning/Config.in
```kconfig
menuconfig BR2_PACKAGE_WPEFRAMEWORK_PROVISIONING
	bool "Provisioning"
	depends on BR2_PACKAGE_LIBPROVISION
	help
	   WPE Platform Provisioning plugin
```

## package/WPEFramework/WPEFramework-SwitchBoard/Config.in
```kconfig
menuconfig BR2_PACKAGE_WPEFRAMEWORK_SWITCHBOARD
	bool "SwitchBoard"
	help
	   WPE Platform Switch Board plugin
```

## package/aamp/Config.in
```kconfig
config BR2_PACKAGE_AAMP
    bool "aamp"
    default n
    select BR2_PACKAGE_LIBCURL
    select BR2_PACKAGE_LIBDASH
    select BR2_PACKAGE_LIBXML2
    select BR2_PACKAGE_CJSON
    select BR2_PACKAGE_AAMPABR
    select BR2_PACKAGE_GST1_PLUGINS_BASE
    help
       RDK AAMP
```

## package/aampabr/Config.in
```kconfig
config BR2_PACKAGE_AAMPABR
    bool "aampabr"
    depends on BR2_PACKAGE_AAMP
    help
       RDK AAMPABR
```

## package/aampmetrics/Config.in
```kconfig
config BR2_PACKAGE_AAMPMETRICS
    bool "aampmetrics"
    depends on BR2_PACKAGE_AAMP
    help
       RDK AAMPMETRICS
```

## package/aardvark-dns/Config.in
```kconfig
config BR2_PACKAGE_AARDVARK_DNS
	bool "aardvark-dns"
	depends on BR2_PACKAGE_HOST_RUSTC_TARGET_ARCH_SUPPORTS
	select BR2_PACKAGE_HOST_RUSTC
	help
	  Authoritative dns server for A/AAAA container records.
	  Forwards other request to host's /etc/resolv.conf

	  https://github.com/containers/aardvark-dns/
```

## package/ace/Config.in
```kconfig
config BR2_PACKAGE_ACE
	bool "ace"
	depends on BR2_TOOLCHAIN_USES_GLIBC
	depends on !BR2_STATIC_LIBS
	depends on BR2_INSTALL_LIBSTDCPP
	depends on BR2_TOOLCHAIN_GCC_AT_LEAST_4_9 # C++14
	help
	  The ADAPTIVE Communication Environment (ACE(TM))
	  An OO Network Programming Toolkit in C++.

	  http://www.dre.vanderbilt.edu/~schmidt/ACE.html

comment "ACE needs a glibc toolchain, dynamic library, C++, gcc >= 4.9"
	depends on !BR2_TOOLCHAIN_USES_GLIBC || BR2_STATIC_LIBS || \
		!BR2_INSTALL_LIBSTDCPP || \
		!BR2_TOOLCHAIN_GCC_AT_LEAST_4_9
```
