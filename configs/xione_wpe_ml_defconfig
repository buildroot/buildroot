## fs/erofs/Config.in
```kconfig
config BR2_TARGET_ROOTFS_EROFS
	bool "erofs root filesystem"
	select BR2_PACKAGE_HOST_EROFS_UTILS
	help
	  Build a EROFS root filesystem.

if BR2_TARGET_ROOTFS_EROFS

choice
	prompt "Compression algorithm"
	default BR2_TARGET_ROOTFS_EROFS_LZ4HC
	help
	  Select the EROFS compression algorithm to use.

	  LZ4HC (LZ4 High Compression) is the default algorithm and
	  provides a good balance between compression ratio and speed,
	  with increasing levels the compression ratio increases at the
	  penalty of higher compression times, without significant
	  decompression penalty.

	  LZMA provides the best compression ratio but is significantly
	  slower both in compression and decompression, and higher
	  compression levels can have noticeable memory requirements.

	  Custom compression allows for advanced configuration of the
	  compression algorithms, and adds the possibility of
	  finegrained per-file compression using compression hints.

config BR2_TARGET_ROOTFS_EROFS_NONE
	bool "no compression"

config BR2_TARGET_ROOTFS_EROFS_LZ4HC
	bool "lz4hc"

config BR2_TARGET_ROOTFS_EROFS_LZMA
	bool "lzma"

config BR2_TARGET_ROOTFS_EROFS_CUSTOM_COMPRESSION
	bool "custom"

endchoice

if BR2_TARGET_ROOTFS_EROFS_LZ4HC

config BR2_TARGET_ROOTFS_EROFS_LZ4HC_LEVEL
	int "lz4hc compression level"
	default 9
	range 1 12
	help
	  Specify the compression level for LZ4HC compression.

endif # BR2_TARGET_ROOTFS_EROFS_LZ4HC

if BR2_TARGET_ROOTFS_EROFS_LZMA

config BR2_TARGET_ROOTFS_EROFS_LZMA_LEVEL
	int "lzma compression level"
	default 6
	range 0 109
	help
	  Specify the compression level for LZMA compression.

	  Values from 0 to 9 are used for the standard compression,
	  values from 100 to 109 are used for the extreme compression.

endif # BR2_TARGET_ROOTFS_EROFS_LZMA

if BR2_TARGET_ROOTFS_EROFS_CUSTOM_COMPRESSION

config BR2_TARGET_ROOTFS_EROFS_COMPRESSION_ALGORITHMS
	string "compression algorithms"
	default "lz4hc,12"
	help
	  Specify arbitrary compression option, useful in combination
	  with compression hints. Individual algorithms are separated
	  by colon with optional level, e.g. "lz4hc,12:lzma".
	  See erofs-utils documentaion for detailed information.

config BR2_TARGET_ROOTFS_EROFS_COMPRESSION_HINTS
	string "path to compression hints file"
	default ""
	help
	  Path to file containing compression hints. Each line in the
	  file is defined by tokens separated by spaces in the
	  following form. Optionally, instead of the given primary
	  algorithm, algorithms can be specified with zero-based
	  algorithm-index explicitly:

	  <pcluster-size-in-bytes> [algorithm-index] <match-pattern>

	  match-patterns are extended regular expressions, matched
	  against absolute paths within the output filesystem, with no
	  leading /.

endif # BR2_TARGET_ROOTFS_EROFS_LZMA

config BR2_TARGET_ROOTFS_EROFS_DEDUPE
	bool "enable data deduplication"
	depends on !BR2_TARGET_ROOTFS_EROFS_NONE
	help
	  Enable global compressed data deduplication to reduce FS image
	  size. Introduced in Linux 6.1.

config BR2_TARGET_ROOTFS_EROFS_FRAGMENTS
	bool "enable fragments packing"
	help
	  Pack the tail part (pcluster) of compressed files, or entire
	  files, into a special inode for smaller image size.
	  Introduced in Linux 6.1.

config BR2_TARGET_ROOTFS_EROFS_ALL_FRAGMENTS
	bool "enable all-fragments packing"
	help
	  Forcely record the whole files into a special inode for better
	  compression. Introduced in Linux 6.1.

config BR2_TARGET_ROOTFS_EROFS_ZTAILPACKING
	bool "enable ztailpacking"
	help
	  Pack the tail part (pcluster) of compressed files into its
	  metadata to save more space and the tail part I/O. Introduced
	  in Linux 5.17.

config BR2_TARGET_ROOTFS_EROFS_PCLUSTERSIZE
	int "pcluster size"
	default 0
	help
	  Specify the maximum size of physical cluster in bytes, as a
	  multiple of 4KiB, for the big pcluster feature in order to
	  get much better compression ratios (thus better sequential
	  read performance for common storage devices), which has been
	  introduced since Linux 5.13.

endif # BR2_TARGET_ROOTFS_EROFS
```

## fs/fit/Config.in
```kconfig
config BR2_TARGET_ROOTFS_FIT
	bool "Flattened Image Tree support"
	select BR2_PACKAGE_HOST_UBOOT_TOOLS
	help
	  Compile a flattened image tree sources into a flattened
	  image tree blobs. Specify the *.its files to compile in
	  the options below.

	  Please note, that all files referenced in *.its files,
	  should be available in output/images folder.

if BR2_TARGET_ROOTFS_FIT

config BR2_FIT_PATH
	string "Flattened Image Tree source file paths"
	help
	  Paths to the image tree source files. You can
	  provide a list of *.its paths to copy and build,
	  separated by spaces.

	  Please note, that all *.its files must be named uniquely,
	  otherwise the files with the same name will be overwritten.

config BR2_FIT_INSTALL_TARGET
	bool "Install Flattened Image Tree blobs to /boot in target"
	depends on !BR2_TARGET_ROOTFS_INITRAMFS
	help
	  Select this option to have the FIT images installed to
	  /boot in the target root filesystem.

endif
```

## fs/oci/Config.in
```kconfig
config BR2_TARGET_ROOTFS_OCI
	bool "oci image"
	depends on BR2_PACKAGE_HOST_GO_TARGET_ARCH_SUPPORTS
	help
	  Build an OCI (Open Container Initiative) image.

	  By default, the image is generated in a directory called
	  rootfs-oci:

	  $ cd output/images
	  $ ls rootfs-oci/
	  blobs  index.json  oci-layout

	  You can push the image to a registry. Example using skopeo:

	  $ skopeo copy --dest-creds <user>:<pass> \
	           oci:rootfs-oci:<tag> docker://<user>/<image>[:tag]

	  And pull/run it with docker:

	  $ docker run -it <user>/<image>[:tag]

if BR2_TARGET_ROOTFS_OCI

config BR2_TARGET_ROOTFS_OCI_AUTHOR
	string "author name and/or email address"
	default "Buildroot"
	help
	  Name and/or email address of the person which created the
	  image.

config BR2_TARGET_ROOTFS_OCI_TAG
	string "image tag"
	default "latest"
	help
	  Tag to be used in the container image. If empty, 'latest' will
	  be used by default.

config BR2_TARGET_ROOTFS_OCI_ENTRYPOINT
	string "entrypoint"
	default "sh"
	help
	  Command to execute when the container starts.

	  Spaces must be quoted or escaped, like for a shell string:
	    /usr/bin/env sh -c
	    /bin/my-init --some-option "1 2 3 4" some\ arg --

	  See the Docker documentation on how entrypoint and command
	  interact together:
	    https://docs.docker.com/engine/reference/builder/#understand-how-cmd-and-entrypoint-interact

config BR2_TARGET_ROOTFS_OCI_CMD
	string "command (or entrypoint arguments)"
	help
	  Default command, or entrypoint arguments, of the container.

	  Spaces must be quoted or escaped, like for a shell string:
	    "your shell scriptlet"
	    /usr/bin/env sh

	  See the Docker documentation on how entrypoint and command
	  interact together:
	    https://docs.docker.com/engine/reference/builder/#understand-how-cmd-and-entrypoint-interact

config BR2_TARGET_ROOTFS_OCI_WORKDIR
	string "working directory"
	help
	  Working directory of the entrypoint process in the
	  container.

config BR2_TARGET_ROOTFS_OCI_UID
	string "username or UID"
	default "0"
	help
	  The username or UID of user the process run as.

config BR2_TARGET_ROOTFS_OCI_ENV_VARS
	string "environment variables"
	help
	  Default environment variables for the container.
	  Space-separated list of variable=value assignments.

config BR2_TARGET_ROOTFS_OCI_PORTS
	string "ports"
	help
	  Default set of ports to expose from a container running
	  this image as a space-separted list of ports in the following
	  format:

	  <port>/tcp, <port>/udp, <port> (same as <port>/tcp).

config BR2_TARGET_ROOTFS_OCI_LABELS
	string "labels"
	help
	  Metadata in the format KEY=VALUE for the container compliant
	  with OCI annotation rules. If KEY starts with a dot, it will
	  be prefixed with "org.opencontainers.image"
	  (e.g. .url -> org.opencontainers.image.url).

config BR2_TARGET_ROOTFS_OCI_ARCHIVE
	bool "pack oci image into a tar archive"
	help
	  Select whether the image should be packed into a TAR archive.

endif
```

## fs/squashfs/Config.in
```kconfig
config BR2_TARGET_ROOTFS_SQUASHFS
	bool "squashfs root filesystem"
	help
	  Build a squashfs root filesystem

if BR2_TARGET_ROOTFS_SQUASHFS

choice
	prompt "block size"
	default BR2_TARGET_ROOTFS_SQUASHFS_BS_128K
	help
	  Data block size. Bigger values can improve
	  compression ratio.

	  If unsure, leave at 128k (default).

config BR2_TARGET_ROOTFS_SQUASHFS_BS_4K
	bool "4k"

config BR2_TARGET_ROOTFS_SQUASHFS_BS_8K
	bool "8k"

config BR2_TARGET_ROOTFS_SQUASHFS_BS_16K
	bool "16k"

config BR2_TARGET_ROOTFS_SQUASHFS_BS_32K
	bool "32k"

config BR2_TARGET_ROOTFS_SQUASHFS_BS_64K
	bool "64k"

config BR2_TARGET_ROOTFS_SQUASHFS_BS_128K
	bool "128k"

config BR2_TARGET_ROOTFS_SQUASHFS_BS_256K
	bool "256k"

config BR2_TARGET_ROOTFS_SQUASHFS_BS_512K
	bool "512k"

config BR2_TARGET_ROOTFS_SQUASHFS_BS_1024K
	bool "1024k"

endchoice

config BR2_TARGET_ROOTFS_SQUASHFS_BS
	string
	default "4K" if BR2_TARGET_ROOTFS_SQUASHFS_BS_4K
	default "8K" if BR2_TARGET_ROOTFS_SQUASHFS_BS_8K
	default "16K" if BR2_TARGET_ROOTFS_SQUASHFS_BS_16K
	default "32K" if BR2_TARGET_ROOTFS_SQUASHFS_BS_32K
	default "64K" if BR2_TARGET_ROOTFS_SQUASHFS_BS_64K
	default "128K" if BR2_TARGET_ROOTFS_SQUASHFS_BS_128K
	default "256K" if BR2_TARGET_ROOTFS_SQUASHFS_BS_256K
	default "512K" if BR2_TARGET_ROOTFS_SQUASHFS_BS_512K
	default "1024K" if BR2_TARGET_ROOTFS_SQUASHFS_BS_1024K

config BR2_TARGET_ROOTFS_SQUASHFS_PAD
	bool "pad to a 4K boundary"
	default y # legacy was always ON
	help
	  Say 'y' here (the default) to pad the the filesystem image
	  to a 4K boundary. Say 'n' to disable padding.

choice
	prompt "Compression algorithm"
	default BR2_TARGET_ROOTFS_SQUASHFS4_GZIP
	help
	  Select the squashfs compression algorithm to use when
	  generating the filesystem.

	  Select "none" to disable compression.

config BR2_TARGET_ROOTFS_SQUASHFS4_GZIP
	bool "gzip"

config BR2_TARGET_ROOTFS_SQUASHFS4_LZ4
	bool "lz4"

config BR2_TARGET_ROOTFS_SQUASHFS4_LZMA
	bool "lzma"

config BR2_TARGET_ROOTFS_SQUASHFS4_LZO
	bool "lzo"

config BR2_TARGET_ROOTFS_SQUASHFS4_XZ
	bool "xz"

config BR2_TARGET_ROOTFS_SQUASHFS4_ZSTD
	bool "zstd"

config BR2_TARGET_ROOTFS_SQUASHFS4_NONE
	bool "none"

endchoice

config BR2_TARGET_ROOTFS_SQUASHFS_EXTREME_COMP
	bool "extreme compression when available"
	default y if BR2_TARGET_ROOTFS_SQUASHFS4_LZ4  # legacy
	depends on !BR2_TARGET_ROOTFS_SQUASHFS4_NONE
	help
	  Use options to increase compression ration as much as
	  possible, like using architecture-specific options, at
	  the cost of time when assembling the filesystem image.

	  For example:
	   - with gzip and lzo, use -Xcompression-level 9
	   - with xz use arch-specific bcj (branch-call-jump) filters
	   - with zstd use -Xcompression-level 22
	   - and more

config BR2_TARGET_ROOTFS_SQUASHFS_COMP_OPTS
	string
	default "-Xcompression-level 9" if BR2_TARGET_ROOTFS_SQUASHFS4_GZIP
	default "-Xcompression-level 9" if BR2_TARGET_ROOTFS_SQUASHFS4_LZO
	default "-Xhc" if BR2_TARGET_ROOTFS_SQUASHFS4_LZ4
	default "-Xbcj arm,armthumb" if BR2_TARGET_ROOTFS_SQUASHFS4_XZ && (BR2_arm || BR_aarch64)
	default "-Xbcj powerpc" if BR2_TARGET_ROOTFS_SQUASHFS4_XZ && (BR2_powerpc || BR2_powerpc64)
	default "-Xbcj sparc" if BR2_TARGET_ROOTFS_SQUASHFS4_XZ && (BR2_sparc || BR2_sparc64)
	default "-Xbcj x86" if BR2_TARGET_ROOTFS_SQUASHFS4_XZ && (BR2_i386 || BR2_x86_64)
	default "-Xcompression-level 22" if BR2_TARGET_ROOTFS_SQUASHFS4_ZSTD
	depends on BR2_TARGET_ROOTFS_SQUASHFS_EXTREME_COMP

endif
```

## fs/user-initrd/Config.in
```kconfig
menuconfig BR2_PACKAGE_USER_INITRD
	bool "customizable user INITRD"
	default n
	help
	  This option allows to create customizable user INITRD.
	  As a C library currently only glibc can be used.

	  Resulting initrd.gz file will be located in "output/images"
	  directory.

if BR2_PACKAGE_USER_INITRD

if BR2_TOOLCHAIN_BUILDROOT_UCLIBC
comment "Currently only glibc can be used as a C library for INITRD."
comment "But currently uClibc C library is selected in toolchain options."
comment "Enable glibc to see options below."
endif

if BR2_TOOLCHAIN_BUILDROOT_GLIBC
comment "glibc will be used as a C library"
endif

if BR2_TOOLCHAIN_BUILDROOT_MUSL
comment "Currently only glibc can be used as a C library for INITRD."
comment "But currently musl C library is selected in toolchain options."
comment "Enable glibc to see options below."
endif

config BR2_PACKAGE_USER_INITRD_BASH
	bool "bash"
	default n
	depends on BR2_PACKAGE_BASH
	depends on BR2_TOOLCHAIN_BUILDROOT_GLIBC

config BR2_PACKAGE_USER_INITRD_CRYPTSETUP
	bool "cryptsetup"
	default n
	depends on BR2_PACKAGE_CRYPTSETUP
	depends on BR2_TOOLCHAIN_BUILDROOT_GLIBC

config BR2_PACKAGE_USER_INITRD_BUSYBOX
	bool "busybox"
	default n
	depends on BR2_PACKAGE_BUSYBOX
	depends on BR2_TOOLCHAIN_BUILDROOT_GLIBC

config BR2_PACKAGE_USER_INITRD_COREUTILS
	bool "coreutils"
	default n
	depends on BR2_PACKAGE_COREUTILS
	depends on BR2_TOOLCHAIN_BUILDROOT_GLIBC

config BR2_PACKAGE_USER_INITRD_PROCPS_NG
	bool "procps-ng"
	default n
	depends on BR2_PACKAGE_PROCPS_NG
	depends on BR2_TOOLCHAIN_BUILDROOT_GLIBC

if BR2_TOOLCHAIN_BUILDROOT_GLIBC

if !BR2_PACKAGE_BASH
comment "bash must be enabled to be able to select it to INITRD"
endif

if !BR2_PACKAGE_CRYPTSETUP
comment "cryptsetup must be enabled to be able to select it to INITRD"
endif

if !BR2_PACKAGE_BUSYBOX
comment "busybox must be enabled to be able to select it to INITRD"
endif

if !BR2_PACKAGE_COREUTILS
comment "coreutils must be enabled to be able to select it to INITRD"
endif

if !BR2_PACKAGE_PROCPS_NG
comment "procps-ng must be enabled to be able to select it to INITRD"
endif

endif
endif
```

## fs/xfs/Config.in
```kconfig
config BR2_TARGET_ROOTFS_XFS
	bool "xfs root filesystem"
	select BR2_PACKAGE_HOST_XFSPROGS
	help
	  Build a xfs root filesystem. If you enable this option, you
	  probably want to enable the xfsprogs package too.

if BR2_TARGET_ROOTFS_XFS

config BR2_TARGET_ROOTFS_XFS_LABEL
	string "filesystem label"
	default "rootfs"

config BR2_TARGET_ROOTFS_XFS_SIZE
	string "exact size"
	default "300M"
	help
	  The size of the filesystem image. This size is passed to the
	  "truncate -s", so this option recognizes unit suffixes such
	  as K,M,G (see the manual page truncate(1)). Note the XFS
	  minimal filesystem size is 300M.

config BR2_TARGET_ROOTFS_XFS_MKFS_OPTIONS
	string "additional mkfs.xfs options"
	help
	  Specify a space-separated list of mkfs.xfs options.

	  For more information about the mke2fs options, see the
	  manual page mkfs.xfs(8).

	  For more information about the XFS features which can be
	  set, see also the manual page xfs(5).

endif # BR2_TARGET_ROOTFS_XFS
```
