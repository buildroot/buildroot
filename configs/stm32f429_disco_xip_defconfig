## configs/vss_vgdrm_wpe_yt_defconfig
```kconfig
BR2_arm=y
BR2_cortex_a15=y
BR2_ARM_FPU_NEON_VFPV4=y
BR2_ARM_INSTRUCTIONS_THUMB2=y
BR2_CCACHE=y
BR2_CCACHE_DIR="$(TOPDIR)/../buildroot-ccache"
BR2_OPTIMIZE_2=y
BR2_GLOBAL_PATCH_DIR="board/vss/patches"
BR2_TOOLCHAIN_BUILDROOT_VENDOR="vss"
BR2_TOOLCHAIN_BUILDROOT_GLIBC=y
BR2_KERNEL_HEADERS_VERSION=y
BR2_DEFAULT_KERNEL_VERSION="4.1.45"
BR2_PACKAGE_HOST_LINUX_HEADERS_CUSTOM_4_1=y
BR2_GLIBC_VERSION_2_23=y
BR2_TOOLCHAIN_BUILDROOT_CXX=y
BR2_PACKAGE_HOST_GDB=y
BR2_TARGET_GENERIC_HOSTNAME="vgw10"
BR2_TARGET_GENERIC_ISSUE="Welcome to VGW10"
BR2_TARGET_GENERIC_CABUNDLE=y
BR2_INIT_NONE=y
BR2_ROOTFS_DEVICE_CREATION_DYNAMIC_EUDEV=y
BR2_TARGET_GENERIC_ROOT_PASSWD="root"
BR2_SYSTEM_BIN_SH_NONE=y
BR2_TARGET_GENERIC_GETTY_PORT="ttyS0"
BR2_ROOTFS_POST_BUILD_SCRIPT="board/bcm/clean-rootfs.sh"
BR2_ROOTFS_POST_IMAGE_SCRIPT="board/bcm/vss.sh"
# BR2_PACKAGE_BUSYBOX is not set
BR2_PACKAGE_AMAZON=y
BR2_PACKAGE_AMAZON_PLATFORM_FAMILY_NAME="wpeframework"
BR2_PACKAGE_AMAZON_PLATFORM_NAME="generic"
BR2_PACKAGE_AMAZON_NUMBER_OF_CONCURRENT_JOBS="64"
BR2_PACKAGE_AMAZON_TAG="1.3.2"
BR2_PACKAGE_AMAZON_DTID="A1NDFSUOYM0X5T"
BR2_PACKAGE_AMAZON_BACKEND=y
BR2_PACKAGE_GSTREAMER1=y
BR2_PACKAGE_GST1_BCM=y
# BR2_PACKAGE_GST1_BCM_UNIFIED_VERSION is not set
BR2_PACKAGE_GST1_BCM_CREATE_BINARY_ML_DELIVERY=y
BR2_PACKAGE_GST1_PLUGINS_BASE_PLUGIN_APP=y
BR2_PACKAGE_GST1_PLUGINS_BASE_PLUGIN_VIDEOCONVERT=y
BR2_PACKAGE_GST1_PLUGINS_BASE_PLUGIN_GIO=y
BR2_PACKAGE_GST1_PLUGINS_BASE_PLUGIN_OGG=y
BR2_PACKAGE_GST1_PLUGINS_BASE_PLUGIN_OPUS=y
BR2_PACKAGE_GST1_PLUGINS_GOOD_PLUGIN_AUDIOFX=y
BR2_PACKAGE_GST1_PLUGINS_GOOD_PLUGIN_AUDIOPARSERS=y
BR2_PACKAGE_GST1_PLUGINS_GOOD_PLUGIN_AUTODETECT=y
BR2_PACKAGE_GST1_PLUGINS_GOOD_PLUGIN_DEINTERLACE=y
BR2_PACKAGE_GST1_PLUGINS_GOOD_PLUGIN_ICYDEMUX=y
BR2_PACKAGE_GST1_PLUGINS_GOOD_PLUGIN_ID3DEMUX=y
BR2_PACKAGE_GST1_PLUGINS_GOOD_PLUGIN_INTERLEAVE=y
BR2_PACKAGE_GST1_PLUGINS_GOOD_PLUGIN_MATROSKA=y
BR2_PACKAGE_GST1_PLUGINS_GOOD_PLUGIN_SOUPHTTPSRC=y
BR2_PACKAGE_GST1_PLUGINS_BAD_PLUGIN_MPEGTSDEMUX=y
BR2_PACKAGE_GST1_PLUGINS_BAD_PLUGIN_VIDEOPARSERS=y
BR2_PACKAGE_GST1_PLUGINS_BAD_PLUGIN_DASH=y
BR2_PACKAGE_GST1_PLUGINS_BAD_PLUGIN_FAAD=y
BR2_PACKAGE_GST1_PLUGINS_BAD_PLUGIN_HLS=y
BR2_PACKAGE_GST1_PLUGINS_BAD_PLUGIN_OPUS=y
BR2_PACKAGE_GST1_PLUGINS_BAD_PLUGIN_SMOOTHSTREAMING=y
BR2_PACKAGE_GST1_PLUGINS_UGLY=y
BR2_PACKAGE_GST1_PLUGINS_UGLY_PLUGIN_MPG123=y
BR2_PACKAGE_MEMSTAT=y
BR2_PACKAGE_STRACE=y
BR2_PACKAGE_NINJA=y
BR2_PACKAGE_BITSTREAM_VERA=y
# BR2_PACKAGE_EUDEV_ENABLE_HWDB is not set
BR2_PACKAGE_VSS_SDK=y
BR2_PACKAGE_VSS_SDK_MOVE_GSTREAMER=y
BR2_PACKAGE_VSS_SDK_INSTALL_INITD=y
BR2_PACKAGE_VSS_SDK_NXSERVER_ARGS="-ir b -sd off -audio_description -hdcp2x_keys /tmp/BCH2 -hdcp1x_keys /proc/device-tree/chosen/cisco,stbplatform/cisco,stbkey/cisco,hdcpbcmcert"
BR2_PACKAGE_TREMOR=y
BR2_PACKAGE_GRAPHITE2=y
BR2_PACKAGE_LCMS2=y
BR2_PACKAGE_LIBMNG=y
BR2_PACKAGE_OPENJPEG=y
BR2_PACKAGE_WEBP=y
BR2_PACKAGE_WPEFRAMEWORK_PORT="55555"
BR2_PACKAGE_WPEFRAMEWORK_PERSISTENT_PATH="/mnt/appspace/wpeframework"
BR2_PACKAGE_WPEFRAMEWORK_SYSTEM_PREFIX="VFG"
BR2_PACKAGE_WPEFRAMEWORK_TEST_LOADER=y
BR2_PACKAGE_WPEFRAMEWORK_TEST_RPCLINK=y
BR2_PACKAGE_WPEFRAMEWORK_GSTREAMERCLIENT=y
# BR2_PACKAGE_WPEFRAMEWORK_CDMI_WIDEVINE_MODULE is not set
BR2_PACKAGE_WPEFRAMEWORK_MONITOR=y
BR2_PACKAGE_WPEFRAMEWORK_REMOTECONTROL=y
BR2_PACKAGE_WPEFRAMEWORK_SNAPSHOT=y
BR2_PACKAGE_WPEFRAMEWORK_TRACECONTROL=y
BR2_PACKAGE_WPEFRAMEWORK_WEBKITBROWSER=y
BR2_PACKAGE_WPEFRAMEWORK_WEBKITBROWSER_STARTURL="https://widgets.metrological.com/vodafone/b16f3497f5eb5e420f08b5d4624dbc8c"
BR2_PACKAGE_WPEFRAMEWORK_WEBKITBROWSER_USERAGENT="Mozilla/5.0 (Macintosh, Intel Mac OS X 10_11_4) AppleWebKit/602.1.28+ (KHTML, like Gecko) Version/9.1 Safari/601.5.17 VGW10-STB"
BR2_PACKAGE_WPEFRAMEWORK_WEBKITBROWSER_MEMORYPRESSURE="databaseprocess:50m,networkprocess:80m,webprocess:250m,rpcprocess:80m"
BR2_PACKAGE_WPEFRAMEWORK_WEBKITBROWSER_DISKCACHE="512m"
BR2_PACKAGE_WPEFRAMEWORK_WEBKITBROWSER_XHRCACHE=y
BR2_PACKAGE_WPEFRAMEWORK_WEBKITBROWSER_TRANSPARENT=y
BR2_PACKAGE_WPEFRAMEWORK_WEBKITBROWSER_WINDOWCLOSE=y
BR2_PACKAGE_WPEFRAMEWORK_AMAZON_TAB=y
BR2_PACKAGE_WPEFRAMEWORK_AMAZON_TRANSPARENT=y
BR2_PACKAGE_WPEFRAMEWORK_APPS=y
BR2_PACKAGE_WPEFRAMEWORK_UX=y
BR2_PACKAGE_WPEFRAMEWORK_PROVISIONING=y
BR2_PACKAGE_WPEFRAMEWORK_PROVISIONING_URI="provisioning-vodafone.metrological.com:80"
BR2_PACKAGE_WPEFRAMEWORK_PROVISIONING_OPERATOR="vodafone"
BR2_PACKAGE_WPEFRAMEWORK_PROVISIONING_BLOBWRITER=y
BR2_PACKAGE_WPEFRAMEWORK_PROVISIONING_BLOBWRITER_BLOBS="sagePlayready:/mnt/flash/native-drm/prdy/playready3x.bin:false;sageNetflix:/mnt/flash/native-drm/netflix/netflix.bin:false"
BR2_PACKAGE_WPEWEBKIT=y
BR2_PACKAGE_WPEWEBKIT_BUILD_CUSTOM_VERSION="5f899bc2e0e3736908d46ddf473dc4fe5c7f5c95"
BR2_PACKAGE_WPEWEBKIT_ENABLE_NATIVE_AUDIO=y
BR2_PACKAGE_C_ARES=y
BR2_PACKAGE_NGHTTP2=y
BR2_PACKAGE_LIBUV=y
BR2_PACKAGE_ORC=y
BR2_PACKAGE_ICU_USE_ICUDATA=y
BR2_PACKAGE_SHARED_MIME_INFO=y956e67bd4844963a37dd373c3f37ba76d622d682
```

## configs/vss_wpe_ml_defconfig
```kconfig
BR2_arm=y
BR2_cortex_a15=y
BR2_ARM_FPU_VFPV2=y
BR2_CCACHE=y
BR2_CCACHE_DIR="$(TOPDIR)/../buildroot-ccache"
BR2_OPTIMIZE_2=y
BR2_TOOLCHAIN_EXTERNAL=y
BR2_TOOLCHAIN_EXTERNAL_CUSTOM=y
BR2_TOOLCHAIN_EXTERNAL_PATH="/opt/toolchain/vss"
BR2_TOOLCHAIN_EXTERNAL_CUSTOM_PREFIX="arm-buildroot-linux-gnueabihf"
BR2_TOOLCHAIN_EXTERNAL_GCC_5=y
BR2_TOOLCHAIN_EXTERNAL_HEADERS_4_4=y
BR2_TOOLCHAIN_EXTERNAL_CUSTOM_GLIBC=y
BR2_TOOLCHAIN_EXTERNAL_CXX=y
BR2_PACKAGE_HOST_GDB=y
BR2_TARGET_GENERIC_CABUNDLE=y
BR2_INIT_NONE=y
BR2_ROOTFS_DEVICE_CREATION_DYNAMIC_EUDEV=y
BR2_TARGET_GENERIC_ROOT_PASSWD="root"
BR2_TARGET_GENERIC_GETTY_PORT="ttyS0"
BR2_ROOTFS_POST_IMAGE_SCRIPT="board/bcm/vss.sh"
# BR2_PACKAGE_BUSYBOX is not set
BR2_PACKAGE_GSTREAMER1=y
BR2_PACKAGE_GST1_BCM=y
BR2_PACKAGE_GST1_PLUGINS_BASE_PLUGIN_APP=y
BR2_PACKAGE_GST1_PLUGINS_BASE_PLUGIN_VIDEOCONVERT=y
BR2_PACKAGE_GST1_PLUGINS_BASE_PLUGIN_GIO=y
BR2_PACKAGE_GST1_PLUGINS_BASE_PLUGIN_OGG=y
BR2_PACKAGE_GST1_PLUGINS_BASE_PLUGIN_OPUS=y
BR2_PACKAGE_GST1_PLUGINS_GOOD_PLUGIN_AUDIOFX=y
BR2_PACKAGE_GST1_PLUGINS_GOOD_PLUGIN_AUDIOPARSERS=y
BR2_PACKAGE_GST1_PLUGINS_GOOD_PLUGIN_AUTODETECT=y
BR2_PACKAGE_GST1_PLUGINS_GOOD_PLUGIN_DEINTERLACE=y
BR2_PACKAGE_GST1_PLUGINS_GOOD_PLUGIN_ICYDEMUX=y
BR2_PACKAGE_GST1_PLUGINS_GOOD_PLUGIN_ID3DEMUX=y
BR2_PACKAGE_GST1_PLUGINS_GOOD_PLUGIN_INTERLEAVE=y
BR2_PACKAGE_GST1_PLUGINS_GOOD_PLUGIN_MATROSKA=y
BR2_PACKAGE_GST1_PLUGINS_GOOD_PLUGIN_SOUPHTTPSRC=y
BR2_PACKAGE_GST1_PLUGINS_BAD_PLUGIN_MPEGTSDEMUX=y
BR2_PACKAGE_GST1_PLUGINS_BAD_PLUGIN_VIDEOPARSERS=y
BR2_PACKAGE_GST1_PLUGINS_BAD_PLUGIN_DASH=y
BR2_PACKAGE_GST1_PLUGINS_BAD_PLUGIN_FAAD=y
BR2_PACKAGE_GST1_PLUGINS_BAD_PLUGIN_HLS=y
BR2_PACKAGE_GST1_PLUGINS_BAD_PLUGIN_OPUS=y
BR2_PACKAGE_GST1_PLUGINS_BAD_PLUGIN_SMOOTHSTREAMING=y
BR2_PACKAGE_GST1_PLUGINS_UGLY=y
BR2_PACKAGE_GST1_PLUGINS_UGLY_PLUGIN_MPG123=y
BR2_PACKAGE_MEMSTAT=y
BR2_PACKAGE_STRACE=y
BR2_PACKAGE_NINJA=y
BR2_PACKAGE_BITSTREAM_VERA=y
# BR2_PACKAGE_EUDEV_ENABLE_HWDB is not set
BR2_PACKAGE_VSS_SDK=y
BR2_PACKAGE_OPENSSL=y
BR2_PACKAGE_GRAPHITE2=y
BR2_PACKAGE_LIBMNG=y
BR2_PACKAGE_WEBP=y
BR2_PACKAGE_WPEFRAMEWORK=y
BR2_PACKAGE_WPEFRAMEWORK_PORT="55555"
BR2_PACKAGE_WPEFRAMEWORK_PERSISTENT_PATH="/mnt/appspace"
BR2_PACKAGE_WPEFRAMEWORK_TEST_LOADER=y
BR2_PACKAGE_WPEFRAMEWORK_TEST_RPCLINK=y
BR2_PACKAGE_WPEFRAMEWORK_EGLTEST=y
BR2_PACKAGE_WPEFRAMEWORK_VIRTUALINPUT=y
BR2_PACKAGE_WPEFRAMEWORK_MONITOR=y
BR2_PACKAGE_WPEFRAMEWORK_CDMI_PLAYREADY_VGDRM=y
BR2_PACKAGE_WPEFRAMEWORK_REMOTECONTROL=y
BR2_PACKAGE_WPEFRAMEWORK_SNAPSHOT=y
BR2_PACKAGE_WPEFRAMEWORK_TRACECONTROL=y
BR2_PACKAGE_WPEFRAMEWORK_WEBKITBROWSER=y
BR2_PACKAGE_WPEFRAMEWORK_YOUTUBE=y
BR2_PACKAGE_WPEWEBKIT=y
BR2_PACKAGE_WPEWEBKIT_ENABLE_NATIVE_AUDIO=y
BR2_PACKAGE_C_ARES=y
BR2_PACKAGE_ORC=y
BR2_PACKAGE_ICU_USE_ICUDATA=y
BR2_PACKAGE_SHARED_MIME_INFO=y
BR2_PACKAGE_UTIL_LINUX_PIVOT_ROOT=y
```

## configs/vss_wpe_nf_amz_yt_defconfig
```kconfig
BR2_arm=y
BR2_cortex_a15=y
BR2_ARM_FPU_NEON_VFPV4=y
BR2_ARM_INSTRUCTIONS_THUMB2=y
BR2_CCACHE=y
BR2_CCACHE_DIR="$(TOPDIR)/../buildroot-ccache"
BR2_OPTIMIZE_2=y
BR2_GLOBAL_PATCH_DIR="board/vss/patches"
BR2_TOOLCHAIN_BUILDROOT_VENDOR="vss"
BR2_TOOLCHAIN_BUILDROOT_GLIBC=y
BR2_KERNEL_HEADERS_VERSION=y
BR2_DEFAULT_KERNEL_VERSION="4.1.45"
BR2_PACKAGE_HOST_LINUX_HEADERS_CUSTOM_4_1=y
BR2_GLIBC_VERSION_2_23=y
BR2_TOOLCHAIN_BUILDROOT_CXX=y
BR2_PACKAGE_HOST_GDB=y
BR2_TARGET_GENERIC_HOSTNAME="vgw10"
BR2_TARGET_GENERIC_ISSUE="Welcome to VGW10"
BR2_TARGET_GENERIC_CABUNDLE=y
BR2_INIT_NONE=y
BR2_ROOTFS_DEVICE_CREATION_DYNAMIC_EUDEV=y
BR2_TARGET_GENERIC_ROOT_PASSWD="root"
BR2_SYSTEM_BIN_SH_NONE=y
BR2_TARGET_GENERIC_GETTY_PORT="ttyS0"
BR2_ROOTFS_POST_BUILD_SCRIPT="board/bcm/clean-rootfs.sh"
BR2_ROOTFS_POST_IMAGE_SCRIPT="board/bcm/vss.sh"
# BR2_PACKAGE_BUSYBOX is not set
BR2_PACKAGE_AMAZON=y
BR2_PACKAGE_AMAZON_PLATFORM_FAMILY_NAME="wpeframework"
BR2_PACKAGE_AMAZON_PLATFORM_NAME="generic"
BR2_PACKAGE_AMAZON_NUMBER_OF_CONCURRENT_JOBS="64"
BR2_PACKAGE_AMAZON_TAG="1.3.2"
BR2_PACKAGE_AMAZON_DTID="A1NDFSUOYM0X5T"
BR2_PACKAGE_AMAZON_BACKEND=y
BR2_PACKAGE_GSTREAMER1=y
BR2_PACKAGE_GST1_BCM=y
# BR2_PACKAGE_GST1_BCM_UNIFIED_VERSION is not set
BR2_PACKAGE_GST1_BCM_ENABLE_SVP=y
BR2_PACKAGE_GST1_BCM_CREATE_BINARY_ML_DELIVERY=y
BR2_PACKAGE_GST1_PLUGINS_BASE_PLUGIN_APP=y
BR2_PACKAGE_GST1_PLUGINS_BASE_PLUGIN_VIDEOCONVERT=y
BR2_PACKAGE_GST1_PLUGINS_BASE_PLUGIN_GIO=y
BR2_PACKAGE_GST1_PLUGINS_BASE_PLUGIN_OGG=y
BR2_PACKAGE_GST1_PLUGINS_BASE_PLUGIN_OPUS=y
BR2_PACKAGE_GST1_PLUGINS_GOOD_PLUGIN_AUDIOFX=y
BR2_PACKAGE_GST1_PLUGINS_GOOD_PLUGIN_AUDIOPARSERS=y
BR2_PACKAGE_GST1_PLUGINS_GOOD_PLUGIN_AUTODETECT=y
BR2_PACKAGE_GST1_PLUGINS_GOOD_PLUGIN_DEINTERLACE=y
BR2_PACKAGE_GST1_PLUGINS_GOOD_PLUGIN_ICYDEMUX=y
BR2_PACKAGE_GST1_PLUGINS_GOOD_PLUGIN_ID3DEMUX=y
BR2_PACKAGE_GST1_PLUGINS_GOOD_PLUGIN_INTERLEAVE=y
BR2_PACKAGE_GST1_PLUGINS_GOOD_PLUGIN_MATROSKA=y
BR2_PACKAGE_GST1_PLUGINS_GOOD_PLUGIN_SOUPHTTPSRC=y
BR2_PACKAGE_GST1_PLUGINS_BAD_PLUGIN_MPEGTSDEMUX=y
BR2_PACKAGE_GST1_PLUGINS_BAD_PLUGIN_VIDEOPARSERS=y
BR2_PACKAGE_GST1_PLUGINS_BAD_PLUGIN_DASH=y
BR2_PACKAGE_GST1_PLUGINS_BAD_PLUGIN_FAAD=y
BR2_PACKAGE_GST1_PLUGINS_BAD_PLUGIN_HLS=y
BR2_PACKAGE_GST1_PLUGINS_BAD_PLUGIN_OPUS=y
BR2_PACKAGE_GST1_PLUGINS_BAD_PLUGIN_SMOOTHSTREAMING=y
BR2_PACKAGE_GST1_PLUGINS_UGLY=y
BR2_PACKAGE_GST1_PLUGINS_UGLY_PLUGIN_MPG123=y
BR2_PACKAGE_NETFLIX5=y
BR2_PACKAGE_NETFLIX5_DISABLE_TOOLS=y
BR2_PACKAGE_MEMSTAT=y
BR2_PACKAGE_STRACE=y
BR2_PACKAGE_NINJA=y
BR2_PACKAGE_BITSTREAM_VERA=y
# BR2_PACKAGE_EUDEV_ENABLE_HWDB is not set
BR2_PACKAGE_VSS_SDK=y
BR2_PACKAGE_VSS_SDK_USE_SAGE=y
BR2_PACKAGE_VSS_SDK_MOVE_GSTREAMER=y
BR2_PACKAGE_VSS_SDK_INSTALL_INITD=y
BR2_PACKAGE_VSS_SDK_NXSERVER_ARGS="-ir b -sd off -audio_description -hdcp2x_keys /tmp/BCH2 -hdcp1x_keys /proc/device-tree/chosen/cisco,stbplatform/cisco,stbkey/cisco,hdcpbcmcert"
BR2_PACKAGE_LCMS2=y
BR2_PACKAGE_OPENJPEG=y
BR2_PACKAGE_WPEFRAMEWORK_PORT="55555"
BR2_PACKAGE_WPEFRAMEWORK_PERSISTENT_PATH="/mnt/appspace/wpeframework"
BR2_PACKAGE_WPEFRAMEWORK_SYSTEM_PREFIX="VFG"
BR2_PACKAGE_WPEFRAMEWORK_TEST_LOADER=y
BR2_PACKAGE_WPEFRAMEWORK_TEST_RPCLINK=y
BR2_PACKAGE_WPEFRAMEWORK_GSTREAMERCLIENT=y
BR2_PACKAGE_WPEFRAMEWORK_CRYPTOGRAPHY=y
BR2_PACKAGE_WPEFRAMEWORK_CRYPTOGRAPHY_IMPLEMENTATION_NEXUS=y
# BR2_PACKAGE_WPEFRAMEWORK_CDMI_SOFTWARE_OVERRIDE is not set
BR2_PACKAGE_WPEFRAMEWORK_CDMI_PLAYREADY_SECURE_STOP_METERING_CERTIFICATE="/usr/share/WPEFramework/OCDM/metering.cert"
BR2_PACKAGE_WPEFRAMEWORK_MONITOR=y
BR2_PACKAGE_WPEFRAMEWORK_REMOTECONTROL=y
BR2_PACKAGE_WPEFRAMEWORK_SNAPSHOT=y
BR2_PACKAGE_WPEFRAMEWORK_TRACECONTROL=y
BR2_PACKAGE_WPEFRAMEWORK_WEBKITBROWSER=y
BR2_PACKAGE_WPEFRAMEWORK_WEBKITBROWSER_STARTURL="https://widgets.metrological.com/vodafone/b16f3497f5eb5e420f08b5d4624dbc8c"
BR2_PACKAGE_WPEFRAMEWORK_WEBKITBROWSER_USERAGENT="Mozilla/5.0 (Macintosh, Intel Mac OS X 10_11_4) AppleWebKit/602.1.28+ (KHTML, like Gecko) Version/9.1 Safari/601.5.17 VGW10-STB"
BR2_PACKAGE_WPEFRAMEWORK_WEBKITBROWSER_MEMORYPRESSURE="databaseprocess:50m,networkprocess:80m,webprocess:250m,rpcprocess:80m"
BR2_PACKAGE_WPEFRAMEWORK_WEBKITBROWSER_DISKCACHE="512m"
BR2_PACKAGE_WPEFRAMEWORK_WEBKITBROWSER_XHRCACHE=y
BR2_PACKAGE_WPEFRAMEWORK_WEBKITBROWSER_TRANSPARENT=y
BR2_PACKAGE_WPEFRAMEWORK_WEBKITBROWSER_WINDOWCLOSE=y
BR2_PACKAGE_WPEFRAMEWORK_AMAZON_TAB=y
BR2_PACKAGE_WPEFRAMEWORK_AMAZON_TRANSPARENT=y
BR2_PACKAGE_WPEFRAMEWORK_APPS=y
BR2_PACKAGE_WPEFRAMEWORK_UX=y
BR2_PACKAGE_WPEFRAMEWORK_NETFLIX=y
BR2_PACKAGE_WPEFRAMEWORK_PLUGIN_NETFLIX_MODEL="Vodafone Germany_GigaTV 4k Box"
BR2_PACKAGE_WPEFRAMEWORK_PLUGIN_NETFLIX_FRIENDLY_NAME="Vodafone GigaTV"
BR2_PACKAGE_WPEFRAMEWORK_PLUGIN_NETFLIX_VERSION_POSTFIX="bram-2_0"
BR2_PACKAGE_WPEFRAMEWORK_PLUGIN_NETFLIX_APPBOOTKEY="MIICIjANBgkqhkiG9w0BAQEFAAOCAg8AMIICCgKCAgEAze85sEHMHya+MAnRi1IM1/0WLIscNlVGqx67AqA+F5MKyHMT9qhwE2Jd0rUjHWvh6+PlHdZ0N+ArhLdZgD2jTfPbOFzhdYLnIwiRKUDqciSF8fI1tONjyCgJ5sDxaDznkot5evzygUraUP2y9s9ZMsEePep2O5a/DJguSHeqkM1at+oOYw+bJgNiigA5v1QgFd6zQZNkCi/EW6oKbFxman57KqH1DJklkW5pnCdKVNiQVHX5IpoZG6vCMWw9TlfNjj6slD7v5JA+l2++lE14wB5+g9m7ZMOxxx1NhLLg/7tS/2jWtawyygA+2OE3Yv4pjRGi0v2menFCgNRVxsxnGcf7mQ76UPqIyUHEw9eIc5is/0erakApjA6wvputhMxoczOvGXRiTJZCxMC2NDolw4uUxW64baLZDASSXxlz3nqhI+Z6Ce9oolE+G44XzwrkWuVz47gG3KjBFGkr1TZoiXa8ewUSMm27fFpIGDNf1vk/ktpJ5CVmKorD3S1gtGlxki+91XdP5nMKFfmumtJiM+wvPXzc6l1Mps7ymvN7eg5H49ByXWvcZIr3X5k4mwzwcVTgChvaO7p3UigelTABju8APLsEPh8HWMewuQ2lXclYcQmNywTn4Lyh9h47mK0SZc3wSd6EehCDgfajuzXpIKi5uucpoS3cf28D6DTHXLECAwEAAQ=="
BR2_PACKAGE_WPEFRAMEWORK_PLUGIN_NETFLIX_DDP2=y
BR2_PACKAGE_WPEFRAMEWORK_PLUGIN_NETFLIX_DDP5_1=y
BR2_PACKAGE_WPEFRAMEWORK_PLUGIN_VIDEO_AVC_HIGH=y
BR2_PACKAGE_WPEFRAMEWORK_PLUGIN_NETFLIX_HEVC=y
BR2_PACKAGE_WPEFRAMEWORK_PLUGIN_NETFLIX_VP9_P2=y
BR2_PACKAGE_WPEFRAMEWORK_PLUGIN_NETFLIX_DEVICE_KEYS="/mnt/flash/native-drm/netflix/netflix.bin"
BR2_PACKAGE_WPEFRAMEWORK_PROVISIONING=y
BR2_PACKAGE_WPEFRAMEWORK_PROVISIONING_URI="provisioning-vodafone.metrological.com:80"
BR2_PACKAGE_WPEFRAMEWORK_PROVISIONING_OPERATOR="vodafone"
BR2_PACKAGE_WPEFRAMEWORK_PROVISIONING_BLOBWRITER=y
BR2_PACKAGE_WPEFRAMEWORK_PROVISIONING_BLOBWRITER_BLOBS="sagePlayready:/mnt/flash/native-drm/prdy/playready3x.bin:false;sageNetflix:/mnt/flash/native-drm/netflix/netflix.bin:false;"
BR2_PACKAGE_WPEWEBKIT=y
BR2_PACKAGE_WPEWEBKIT_BUILD_CUSTOM_VERSION="5f899bc2e0e3736908d46ddf473dc4fe5c7f5c95"
BR2_PACKAGE_WPEWEBKIT_ENABLE_NATIVE_AUDIO=y
BR2_PACKAGE_LIBUV=y
BR2_PACKAGE_ORC=y
BR2_PACKAGE_ICU_USE_ICUDATA=y
BR2_PACKAGE_NCURSES=y
BR2_PACKAGE_SHARED_MIME_INFO=y
```

## configs/wandboard_defconfig
```kconfig
# Architecture
BR2_arm=y
BR2_cortex_a9=y
BR2_ARM_ENABLE_NEON=y
BR2_ARM_ENABLE_VFP=y
BR2_ARM_FPU_VFPV3=y

# Linux headers same as kernel, a 5.13 series
BR2_PACKAGE_HOST_LINUX_HEADERS_CUSTOM_5_13=y

# System
BR2_TARGET_GENERIC_GETTY_PORT="ttymxc0"

# Image
BR2_ROOTFS_OVERLAY="board/wandboard/rootfs_overlay"
BR2_ROOTFS_POST_IMAGE_SCRIPT="board/freescale/common/imx/post-image.sh"

# Filesystem
BR2_TARGET_ROOTFS_EXT2=y
BR2_TARGET_ROOTFS_EXT2_4=y

# Bootloader
BR2_TARGET_UBOOT=y
BR2_TARGET_UBOOT_BUILD_SYSTEM_KCONFIG=y
BR2_TARGET_UBOOT_CUSTOM_VERSION=y
BR2_TARGET_UBOOT_CUSTOM_VERSION_VALUE="2021.07"
BR2_TARGET_UBOOT_BOARD_DEFCONFIG="wandboard"
BR2_TARGET_UBOOT_FORMAT_IMG=y
BR2_TARGET_UBOOT_SPL=y
BR2_TARGET_UBOOT_SPL_NAME="SPL"

# Kernel
BR2_LINUX_KERNEL=y
BR2_LINUX_KERNEL_CUSTOM_VERSION=y
BR2_LINUX_KERNEL_CUSTOM_VERSION_VALUE="5.13"
BR2_LINUX_KERNEL_DEFCONFIG="imx_v6_v7"
BR2_LINUX_KERNEL_DTS_SUPPORT=y
BR2_LINUX_KERNEL_INTREE_DTS_NAME="imx6q-wandboard imx6dl-wandboard imx6q-wandboard-revb1 imx6dl-wandboard-revb1 imx6q-wandboard-revd1 imx6dl-wandboard-revd1 imx6qp-wandboard-revd1"
BR2_LINUX_KERNEL_INSTALL_TARGET=y
BR2_LINUX_KERNEL_NEEDS_HOST_OPENSSL=y

# Required tools to create the SD image
BR2_PACKAGE_HOST_DOSFSTOOLS=y
BR2_PACKAGE_HOST_GENIMAGE=y
BR2_PACKAGE_HOST_MTOOLS=y
BR2_PACKAGE_HOST_UBOOT_TOOLS=y
```
