## raspberrypi3_wpe_ml_wifi_bt_defconfig
```kconfig
BR2_arm=y
BR2_cortex_a7=y
BR2_ARM_FPU_NEON_VFPV4=y
BR2_ARM_INSTRUCTIONS_THUMB2=y
BR2_CCACHE=y
BR2_OPTIMIZE_2=y
BR2_TOOLCHAIN_BUILDROOT_GLIBC=y
BR2_PACKAGE_HOST_LINUX_HEADERS_CUSTOM_4_9=y
BR2_TOOLCHAIN_BUILDROOT_CXX=y
BR2_PACKAGE_HOST_GDB=y
BR2_TARGET_GENERIC_HOSTNAME="rpi3-wpe-ml-wifi-bt"
BR2_TARGET_GENERIC_ISSUE="Welcome"
BR2_TARGET_GENERIC_CABUNDLE=y
BR2_ROOTFS_DEVICE_CREATION_DYNAMIC_EUDEV=y
BR2_TARGET_GENERIC_ROOT_PASSWD="root"
# BR2_TARGET_GENERIC_GETTY is not set
BR2_SYSTEM_DHCP="eth0"
BR2_ROOTFS_POST_BUILD_SCRIPT="board/raspberrypi3/post-build.sh"
BR2_ROOTFS_POST_IMAGE_SCRIPT="board/raspberrypi3/post-image.sh"
BR2_ROOTFS_POST_SCRIPT_ARGS="--add-pi3-miniuart-bt-overlay --rpi-wifi --tvmode-720 --overclock-pi3 --silent"
BR2_LINUX_KERNEL=y
BR2_LINUX_KERNEL_CUSTOM_GIT=y
BR2_LINUX_KERNEL_CUSTOM_REPO_URL="https://github.com/raspberrypi/linux.git"
BR2_LINUX_KERNEL_CUSTOM_REPO_VERSION="935c7ce84c982a26f567a03a58a1537424569938"
BR2_LINUX_KERNEL_PATCH="board/raspberrypi3/linux"
BR2_LINUX_KERNEL_DEFCONFIG="bcm2709"
BR2_LINUX_KERNEL_DTS_SUPPORT=y
BR2_LINUX_KERNEL_INTREE_DTS_NAME="bcm2710-rpi-3-b bcm2710-rpi-cm3"
BR2_PACKAGE_BUSYBOX_SMP=y
BR2_PACKAGE_GSTREAMER1=y
BR2_PACKAGE_GST1_PLUGINS_BASE_PLUGIN_APP=y
BR2_PACKAGE_GST1_PLUGINS_BASE_PLUGIN_VIDEOCONVERT=y
BR2_PACKAGE_GST1_PLUGINS_BASE_PLUGIN_GIO=y
BR2_PACKAGE_GST1_PLUGINS_GOOD_PLUGIN_AUDIOFX=y
BR2_PACKAGE_GST1_PLUGINS_GOOD_PLUGIN_AUDIOPARSERS=y
BR2_PACKAGE_GST1_PLUGINS_GOOD_PLUGIN_AUTODETECT=y
BR2_PACKAGE_GST1_PLUGINS_GOOD_PLUGIN_DEINTERLACE=y
BR2_PACKAGE_GST1_PLUGINS_GOOD_PLUGIN_ICYDEMUX=y
BR2_PACKAGE_GST1_PLUGINS_GOOD_PLUGIN_ID3DEMUX=y
BR2_PACKAGE_GST1_PLUGINS_GOOD_PLUGIN_INTERLEAVE=y
BR2_PACKAGE_GST1_PLUGINS_GOOD_PLUGIN_SOUPHTTPSRC=y
BR2_PACKAGE_GST1_PLUGINS_BAD_PLUGIN_MPEGTSDEMUX=y
BR2_PACKAGE_GST1_PLUGINS_BAD_PLUGIN_VIDEOPARSERS=y
BR2_PACKAGE_GST1_PLUGINS_BAD_PLUGIN_DASH=y
BR2_PACKAGE_GST1_PLUGINS_BAD_PLUGIN_FAAD=y
BR2_PACKAGE_GST1_PLUGINS_BAD_PLUGIN_HLS=y
BR2_PACKAGE_GST1_PLUGINS_BAD_PLUGIN_SMOOTHSTREAMING=y
BR2_PACKAGE_GST1_PLUGINS_UGLY=y
BR2_PACKAGE_GST1_PLUGINS_UGLY_PLUGIN_MPG123=y
BR2_PACKAGE_GST_OMX=y
BR2_PACKAGE_NETFLIX=y
BR2_PACKAGE_NETFLIX_LIB=y
BR2_PACKAGE_NINJA=y
BR2_PACKAGE_PLAYREADY=y
BR2_PACKAGE_BITSTREAM_VERA=y
BR2_PACKAGE_RPI_FIRMWARE=y
BR2_PACKAGE_RPI_FIRMWARE_X=y
BR2_PACKAGE_RPI_WIFI_FIRMWARE=y
BR2_PACKAGE_RPI_BT_FIRMWARE=y
BR2_PACKAGE_RFKILL=y
BR2_PACKAGE_RPI_USERLAND=y
BR2_PACKAGE_NODEJS=y
BR2_PACKAGE_NODEJS_MODULES_ADDITIONAL="canvas"
BR2_PACKAGE_NODEJS_MODULES_ADDITIONAL_DEPS="pango giflib"
BR2_PACKAGE_PYTHON=y
BR2_PACKAGE_CAIRO_SVG=y
BR2_PACKAGE_GIFLIB=y
BR2_PACKAGE_PANGO=y
BR2_PACKAGE_WPEFRAMEWORK=y
BR2_PACKAGE_WPEFRAMEWORK_VIRTUALINPUT=y
BR2_PACKAGE_WPEFRAMEWORK_PROVISIONPROXY=y
BR2_PACKAGE_WPEFRAMEWORK_DEVICEINFO=y
BR2_PACKAGE_WPEFRAMEWORK_LOCATIONSYNC=y
BR2_PACKAGE_WPEFRAMEWORK_MONITOR=y
BR2_PACKAGE_WPEFRAMEWORK_TIMESYNC=y
BR2_PACKAGE_WPEFRAMEWORK_REMOTECONTROL=y
BR2_PACKAGE_WPEFRAMEWORK_SNAPSHOT=y
BR2_PACKAGE_WPEFRAMEWORK_TRACECONTROL=y
BR2_PACKAGE_WPEFRAMEWORK_WEBKITBROWSER=y
BR2_PACKAGE_WPEFRAMEWORK_WEBKITBROWSER_STARTURL="file:///www/index.html"
BR2_PACKAGE_WPEFRAMEWORK_WEBKITBROWSER_USERAGENT="Mozilla/5.0 (Macintosh, Intel Mac OS X 10_11_4) AppleWebKit/602.1.28+ (KHTML, like Gecko) Version/9.1 Safari/601.5.17 WPE-Reference"
BR2_PACKAGE_WPEFRAMEWORK_WEBKITBROWSER_MEMORYPROFILE="n"
BR2_PACKAGE_WPEFRAMEWORK_WEBKITBROWSER_MEMORYPRESSURE="databaseprocess:100m,networkprocess:100m,webprocess:400m,rpcprocess:100m"
BR2_PACKAGE_WPEFRAMEWORK_WEBKITBROWSER_DISKCACHE="512m"
BR2_PACKAGE_WPEFRAMEWORK_WEBKITBROWSER_XHRCACHE=y
BR2_PACKAGE_WPEFRAMEWORK_YOUTUBE=y
BR2_PACKAGE_WPEFRAMEWORK_WEBSERVER=y
BR2_PACKAGE_WPEFRAMEWORK_DIALSERVER=y
BR2_PACKAGE_WPEFRAMEWORK_NETFLIX=y
BR2_PACKAGE_WPEFRAMEWORK_PLUGIN_NETFLIX_AUTOSTART=y
BR2_PACKAGE_WPEFRAMEWORK_PROVISIONING=y
BR2_PACKAGE_WPEFRAMEWORK_POC=y
BR2_PACKAGE_WPEFRAMEWORK_WIFI=y
BR2_PACKAGE_WPEWEBKIT=y
BR2_PACKAGE_LIBXKBCOMMON=y
BR2_PACKAGE_ORC=y
BR2_PACKAGE_ICU_USE_ICUDATA=y
BR2_PACKAGE_SHARED_MIME_INFO=y
BR2_PACKAGE_BLUEZ5_UTILS=y
BR2_PACKAGE_BLUEZ5_UTILS_OBEX=y
BR2_PACKAGE_BLUEZ5_UTILS_CLIENT=y
BR2_PACKAGE_DROPBEAR=y
BR2_PACKAGE_WPA_SUPPLICANT_AP_SUPPORT=y
BR2_PACKAGE_WPA_SUPPLICANT_WIFI_DISPLAY=y
BR2_PACKAGE_WPA_SUPPLICANT_AUTOSCAN=y
BR2_PACKAGE_WPA_SUPPLICANT_EAP=y
BR2_PACKAGE_WPA_SUPPLICANT_DEBUG_SYSLOG=y
BR2_PACKAGE_WPA_SUPPLICANT_WPS=y
BR2_PACKAGE_WPA_SUPPLICANT_CLI=y
BR2_PACKAGE_WPA_SUPPLICANT_PASSPHRASE=y
BR2_PACKAGE_NANO=y
BR2_TARGET_ROOTFS_EXT2=y
BR2_TARGET_ROOTFS_EXT2_4=y
BR2_TARGET_ROOTFS_EXT2_LABEL="root"
BR2_TARGET_ROOTFS_EXT2_BLOCKS=400000
BR2_PACKAGE_HOST_DOSFSTOOLS=y
BR2_PACKAGE_HOST_GENIMAGE=y
BR2_PACKAGE_HOST_MTOOLS=y
```

## raspberrypi3_wpeframework_ml_4G_defconfig
```kconfig
BR2_arm=y
BR2_cortex_a7=y
BR2_ARM_FPU_NEON_VFPV4=y
BR2_ARM_INSTRUCTIONS_THUMB2=y
BR2_CCACHE=y
BR2_CCACHE_DIR="$(TOPDIR)/rpi23.buildroot-ccache"
BR2_OPTIMIZE_2=y
BR2_TOOLCHAIN_BUILDROOT_GLIBC=y
BR2_PACKAGE_HOST_LINUX_HEADERS_CUSTOM_4_9=y
BR2_TOOLCHAIN_BUILDROOT_CXX=y
BR2_PACKAGE_HOST_GDB=y
BR2_TARGET_GENERIC_CABUNDLE=y
BR2_ROOTFS_DEVICE_CREATION_DYNAMIC_EUDEV=y
BR2_TARGET_GENERIC_ROOT_PASSWD="root"
# BR2_TARGET_GENERIC_GETTY is not set
BR2_ROOTFS_POST_BUILD_SCRIPT="board/raspberrypi3/post-build.sh"
BR2_ROOTFS_POST_IMAGE_SCRIPT="board/raspberrypi3/post-image.sh"
BR2_ROOTFS_POST_SCRIPT_ARGS="--add-pi3-miniuart-bt-overlay --tvmode-720 --overclock-pi3 --silent"
BR2_LINUX_KERNEL=y
BR2_LINUX_KERNEL_CUSTOM_GIT=y
BR2_LINUX_KERNEL_CUSTOM_REPO_URL="https://github.com/raspberrypi/linux.git"
BR2_LINUX_KERNEL_CUSTOM_REPO_VERSION="8bf13deebd582fd64a6595d23e9c965b652ef7c8"
BR2_LINUX_KERNEL_USE_CUSTOM_CONFIG=y
BR2_LINUX_KERNEL_CUSTOM_CONFIG_FILE="board/raspberrypi/rpi-4G-linux-4.config"
BR2_LINUX_KERNEL_DTS_SUPPORT=y
BR2_LINUX_KERNEL_INTREE_DTS_NAME="bcm2710-rpi-3-b bcm2710-rpi-cm3"
BR2_PACKAGE_BUSYBOX_SMP=y
BR2_PACKAGE_GSTREAMER1=y
BR2_PACKAGE_GST1_PLUGINS_BASE_PLUGIN_APP=y
BR2_PACKAGE_GST1_PLUGINS_BASE_PLUGIN_VIDEOCONVERT=y
BR2_PACKAGE_GST1_PLUGINS_BASE_PLUGIN_GIO=y
BR2_PACKAGE_GST1_PLUGINS_GOOD_PLUGIN_AUDIOFX=y
BR2_PACKAGE_GST1_PLUGINS_GOOD_PLUGIN_AUDIOPARSERS=y
BR2_PACKAGE_GST1_PLUGINS_GOOD_PLUGIN_AUTODETECT=y
BR2_PACKAGE_GST1_PLUGINS_GOOD_PLUGIN_DEINTERLACE=y
BR2_PACKAGE_GST1_PLUGINS_GOOD_PLUGIN_ICYDEMUX=y
BR2_PACKAGE_GST1_PLUGINS_GOOD_PLUGIN_ID3DEMUX=y
BR2_PACKAGE_GST1_PLUGINS_GOOD_PLUGIN_INTERLEAVE=y
BR2_PACKAGE_GST1_PLUGINS_GOOD_PLUGIN_SOUPHTTPSRC=y
BR2_PACKAGE_GST1_PLUGINS_BAD_PLUGIN_MPEGTSDEMUX=y
BR2_PACKAGE_GST1_PLUGINS_BAD_PLUGIN_VIDEOPARSERS=y
BR2_PACKAGE_GST1_PLUGINS_BAD_PLUGIN_DASH=y
BR2_PACKAGE_GST1_PLUGINS_BAD_PLUGIN_FAAD=y
BR2_PACKAGE_GST1_PLUGINS_BAD_PLUGIN_HLS=y
BR2_PACKAGE_GST1_PLUGINS_BAD_PLUGIN_SMOOTHSTREAMING=y
BR2_PACKAGE_GST1_PLUGINS_UGLY=y
BR2_PACKAGE_GST1_PLUGINS_UGLY_PLUGIN_MPG123=y
BR2_PACKAGE_GST_OMX=y
BR2_PACKAGE_NETFLIX=y
BR2_PACKAGE_NETFLIX_LIB=y
BR2_PACKAGE_NINJA=y
BR2_PACKAGE_PLAYREADY=y
BR2_PACKAGE_BITSTREAM_VERA=y
BR2_PACKAGE_WESTEROS=y
BR2_PACKAGE_LINUX_FIRMWARE=y
BR2_PACKAGE_LINUX_FIRMWARE_BRCM_BCM43XX=y
BR2_PACKAGE_LINUX_FIRMWARE_BRCM_BCM43XXX=y
BR2_PACKAGE_LINUX_FIRMWARE_BNX2X=y
BR2_PACKAGE_RPI_FIRMWARE=y
# BR2_PACKAGE_EUDEV_ENABLE_HWDB is not set
BR2_PACKAGE_RPI_USERLAND=y
BR2_PACKAGE_NODEJS=y
BR2_PACKAGE_NODEJS_MODULES_ADDITIONAL="canvas"
BR2_PACKAGE_NODEJS_MODULES_ADDITIONAL_DEPS="pango giflib"
BR2_PACKAGE_CAIRO_SVG=y
BR2_PACKAGE_GIFLIB=y
BR2_PACKAGE_PANGO=y
BR2_PACKAGE_WPEWEBKIT=y
BR2_PACKAGE_ORC=y
BR2_PACKAGE_ICU_USE_ICUDATA=y
BR2_PACKAGE_SHARED_MIME_INFO=y
BR2_PACKAGE_DNSMASQ=y
# BR2_PACKAGE_DNSMASQ_TFTP is not set
BR2_PACKAGE_DROPBEAR=y
BR2_PACKAGE_GESFTPSERVER=y
BR2_PACKAGE_IPTABLES=y
BR2_PACKAGE_IW=y
BR2_PACKAGE_PPPD=y
BR2_PACKAGE_WPA_SUPPLICANT=y
BR2_PACKAGE_WPA_SUPPLICANT_AP_SUPPORT=y
BR2_PACKAGE_WPA_SUPPLICANT_MESH_NETWORKING=y
BR2_PACKAGE_WPA_SUPPLICANT_AUTOSCAN=y
BR2_PACKAGE_WPA_SUPPLICANT_EAP=y
BR2_PACKAGE_WPA_SUPPLICANT_HOTSPOT=y
BR2_PACKAGE_WPA_SUPPLICANT_WPS=y
BR2_PACKAGE_WPA_SUPPLICANT_CLI=y
BR2_PACKAGE_WPA_SUPPLICANT_WPA_CLIENT_SO=y
BR2_PACKAGE_WPA_SUPPLICANT_PASSPHRASE=y
BR2_PACKAGE_WPEFRAMEWORK=y
BR2_PACKAGE_WPEFRAMEWORK_DEBUG=y
BR2_PACKAGE_WPEFRAMEWORK_DISABLE_INITD=y
BR2_PACKAGE_WPEFRAMEWORK_TEST_LOADER=y
BR2_PACKAGE_WPEFRAMEWORK_VIRTUALINPUT=y
BR2_PACKAGE_WPEFRAMEWORK_CLOSED_MODULES=y
BR2_PACKAGE_WPEFRAMEWORK_PROVISIONPROXY=y
BR2_PACKAGE_WPEFRAMEWORK_PROVISIONING=y
BR2_PACKAGE_WPEFRAMEWORK_DIALSERVER=y
BR2_PACKAGE_WPEFRAMEWORK_NETFLIX=y
BR2_PACKAGE_WPEFRAMEWORK_COMPOSITOR=y
BR2_PACKAGE_WPEFRAMEWORK_SWITCHBOARD=y
BR2_PACKAGE_WPEFRAMEWORK_DICTIONARY=y
BR2_PACKAGE_WPEFRAMEWORK_OPEN=y
BR2_PACKAGE_WPEFRAMEWORK_OPEN_COMMANDER=y
BR2_PACKAGE_WPEFRAMEWORK_OPEN_DEVICEINFO=y
BR2_PACKAGE_WPEFRAMEWORK_OPEN_LOCATIONSYNC=y
BR2_PACKAGE_WPEFRAMEWORK_OPEN_LOCATIONSYNC_URI="jsonip.metrological.com"
BR2_PACKAGE_WPEFRAMEWORK_OPEN_MONITOR=y
BR2_PACKAGE_WPEFRAMEWORK_OPEN_TIMESYNC=y
BR2_PACKAGE_WPEFRAMEWORK_OPEN_REMOTECONTROL=y
BR2_PACKAGE_WPEFRAMEWORK_OPEN_SNAPSHOT=y
BR2_PACKAGE_WPEFRAMEWORK_OPEN_TRACECONTROL=y
BR2_PACKAGE_WPEFRAMEWORK_OPEN_WEBKITBROWSER=y
BR2_PACKAGE_WPEFRAMEWORK_OPEN_WEBPROXY=y
BR2_PACKAGE_WPEFRAMEWORK_OPEN_WEBSERVER=y
BR2_PACKAGE_WPEFRAMEWORK_OPEN_WEBSHELL=y
BR2_TARGET_ROOTFS_CPIO_BZIP2=y
BR2_TARGET_ROOTFS_INITRAMFS=y
BR2_TARGET_ROOTFS_TAR_BZIP2=y
```

## support/testing/tests/package/br2-external/clang-compiler-rt/package/libfuzzer/Config.in
```kconfig
config BR2_PACKAGE_LIBFUZZER
	bool "libfuzzer"
	help
	  This project aims at hosting tutorials,
	  examples, discussions, research proposals,
	  and other resources related to fuzzing.

	  https://github.com/google/fuzzing
```

## support/testing/tests/package/br2-external/gumbo-parser/package/gumbo-parser-test/Config.in
```kconfig
config BR2_PACKAGE_GUMBO_PARSER_TEST
	bool "gumbo-parser-test"
	depends on BR2_PACKAGE_GUMBO_PARSER
	help
	  Test program for gumbo-parser library.
	  This package builds a simple test program that demonstrates
	  basic HTML parsing functionality using gumbo-parser.
```

## support/testing/tests/package/br2-external/polkit/package/polkit-rules-test/Config.in
```kconfig
config BR2_PACKAGE_POLKIT_RULES_TEST
	bool "polkit rules test"
	depends on BR2_PACKAGE_POLKIT
	help
	  Simple test to ensure polkit is loading and enforcing rules
	  correctly.
```

## support/testing/tests/package/br2-external/python-pybind/Config.in
```kconfig
source "$BR2_EXTERNAL_PYTHON_PYBIND_PATH/package/python-pybind-example/Config.in"
```

## support/testing/tests/package/br2-external/python-pybind/package/python-pybind-example/Config.in
```kconfig
config BR2_PACKAGE_PYTHON_PYBIND_EXAMPLE
	bool "python-pybind-example"
	depends on BR2_PACKAGE_PYTHON3
	select BR2_PACKAGE_PYTHON_PYBIND
	help
	  This test creates a cpp macro later used on target in python
```

## support/testing/tests/package/test_uboot_tools/example.its
```
/dts-v1/;

/ {
    description = "Test FIT (build only)";
    #address-cells = <1>;

    images {
        kernel {
            description = "This file, pretending to be kernel";
            data = /incbin/("example.its");
            type = "kernel";
            arch = "arm64";
            os = "linux";
            compression = "none";
            load = <0x40400000>;
            entry = <0x40400000>;
            hash-1 {
                algo = "crc16-ccitt";
            };
            hash-2 {
                algo = "crc32";
            };
            hash-3 {
                algo = "md5";
            };
            hash-4 {
                algo = "sha1";
            };
            hash-5 {
                algo = "sha256";
            };
            hash-6 {
                algo = "sha384";
            };
            hash-7 {
                algo = "sha512";
            };
        };
    };

    configurations {
        default = "config-1";
        config-1 {
            description = "Test entry";
            kernel = "kernel";
        };
    };
};
```

## toolchain/toolchain-bare-metal-buildroot/Config.in
```kconfig
if BR2_TOOLCHAIN_BARE_METAL_BUILDROOT

config BR2_TOOLCHAIN_BARE_METAL_BUILDROOT_ARCH
	string "list of architecture tuples"
	help
	  This option allows to define the list of architecture
	  tuples for which bare-metal toolchains will be created.
	  One toolchain will be built for each of the architecture
	  tuples specified in this option.

	  For example, to build both a Microblaze and a RISC-V bare
	  metal toolchain, use the following definition:
	  "microblazeel-buildroot-elf riscv32-buildroot-elf"

config BR2_TOOLCHAIN_BARE_METAL_BUILDROOT_MULTILIB
	bool "Enable multilib"
	help
	  Sometimes the default GCC and newlib libraries for a given
	  architecture are not the desired ABI. Since ABI
	  definitions are different for each architecture, this
	  option will enable multilib configuration, so that all
	  available ABI libraries are built which will guarantee
	  that the desired version will be available for user
	  applications.

	  When enabled, this option will apply to all architecture
	  tuples in the list.

source "package/newlib-bare-metal/Config.in"

endif # BR2_TOOLCHAIN_BARE_METAL_BUILDROOT
```
