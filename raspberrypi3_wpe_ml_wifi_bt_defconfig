## toolchain/toolchain-buildroot/Config.in
```kconfig
# Config entries for internal toolchain backend

if BR2_TOOLCHAIN_BUILDROOT

comment "Toolchain Buildroot Options"

config BR2_TOOLCHAIN_BUILDROOT_VENDOR
	string "custom toolchain vendor name"
	default "buildroot"
	help
	  This option allows to customize the "vendor" part of the
	  toolchain tuple, where the toolchain tuple has the form
	  <arch>-<vendor>-<os>-<libc>. The default value, "buildroot",
	  is fine for most cases, except in very specific situations
	  where gcc might make different decisions based on the vendor
	  part of the tuple. The value "unknown" is not allowed, as the
	  cross-compiling toolchain might then be confused with the
	  native toolchain when the target and host architecture are
	  identical. The value can not be empty either.

	  If you're not sure, just leave the default "buildroot" value.

choice
	prompt "C library"
	default BR2_TOOLCHAIN_BUILDROOT_GLIBC

config BR2_TOOLCHAIN_BUILDROOT_UCLIBC
	bool "uClibc-ng"
	depends on BR2_PACKAGE_UCLIBC_SUPPORTS
	select BR2_TOOLCHAIN_USES_UCLIBC
	help
	  This option selects uClibc-ng as the C library for the
	  cross-compilation toolchain.

	  http://uclibc-ng.org

config BR2_TOOLCHAIN_BUILDROOT_GLIBC
	bool "glibc"
	depends on BR2_PACKAGE_GLIBC_SUPPORTS
	select BR2_TOOLCHAIN_USES_GLIBC
	help
	  This option selects glibc as the C library for the
	  cross-compilation toolchain.

	  http://www.gnu.org/software/libc/

comment "glibc needs a toolchain w/ kernel headers >= 3.2"
	depends on BR2_PACKAGE_GLIBC_ARCH_SUPPORTS
	depends on !BR2_TOOLCHAIN_HEADERS_AT_LEAST_3_2

# glibc >= 2.26 require kernel headers >= 3.10 on powerpc64le.
comment "glibc on powerpc64le needs a toolchain w/ headers >= 3.10"
	depends on BR2_powerpc64le
	depends on !BR2_TOOLCHAIN_HEADERS_AT_LEAST_3_10

# Support for MIPS NAN2008 needs headers >= 4.5
comment "glibc on MIPS w/ NAN2008 needs a toolchain w/ headers >= 4.5"
	depends on BR2_MIPS_NAN_2008
	depends on !BR2_TOOLCHAIN_HEADERS_AT_LEAST_4_5

comment "glibc on RISC-V 64-bit needs a toolchain w/ headers >= 5.0"
	depends on BR2_RISCV_64
	depends on !BR2_TOOLCHAIN_HEADERS_AT_LEAST_5_0

comment "glibc on RISC-V 32-bit needs a toolchain w/ headers >= 5.4"
	depends on BR2_RISCV_32
	depends on !BR2_TOOLCHAIN_HEADERS_AT_LEAST_5_4

comment "glibc on ARC needs a toolchain w/ headers >= 5.1"
	depends on BR2_arc
	depends on !BR2_TOOLCHAIN_HEADERS_AT_LEAST_5_1

comment "glibc on or1k needs a toolchain w/ headers >= 5.4"
	depends on BR2_or1k
	depends on !BR2_TOOLCHAIN_HEADERS_AT_LEAST_5_4

config BR2_TOOLCHAIN_BUILDROOT_MUSL
	bool "musl"
	depends on BR2_PACKAGE_MUSL_SUPPORTS
	select BR2_TOOLCHAIN_USES_MUSL
	help
	  This option selects musl as the C library for the
	  cross-compilation toolchain.

	  https://www.musl-libc.org/

config BR2_TOOLCHAIN_BUILDROOT_NONE
	bool "none"
	depends on !BR2_PACKAGE_UCLIBC_SUPPORTS && \
		!BR2_PACKAGE_GLIBC_SUPPORTS && \
		!BR2_PACKAGE_MUSL_SUPPORTS
	help
	  This option is visible if no C library is available for the
	  currently selected configuration. If you select this option,
	  the build will refuse to start as Buildroot needs a C
	  library to build a toolchain. Change your configuration
	  settings to make sure one of the C libraries is selected.

endchoice

config BR2_TOOLCHAIN_BUILDROOT_LIBC
	string
	default "uclibc" if BR2_TOOLCHAIN_BUILDROOT_UCLIBC
	default "glibc"  if BR2_TOOLCHAIN_BUILDROOT_GLIBC
	default "musl"	 if BR2_TOOLCHAIN_BUILDROOT_MUSL

source "package/linux-headers/Config.in.host"
source "package/linux-headers/Config.in"
source "package/musl/Config.in"
source "package/uclibc/Config.in"
source "package/glibc/Config.in"
source "package/binutils/Config.in.host"
source "package/gcc/Config.in.host"
source "package/gcc/Config.in"
endif
```

## toolchain/toolchain-external/toolchain-external-arm-aarch64/Config.in
```kconfig
config BR2_TOOLCHAIN_EXTERNAL_ARM_AARCH64
	bool "Arm AArch64 12.2.rel1"
	depends on BR2_aarch64
	depends on BR2_HOSTARCH = "x86_64"
	depends on !BR2_ARCH_NEEDS_GCC_AT_LEAST_13
	select BR2_TOOLCHAIN_EXTERNAL_GLIBC
	select BR2_TOOLCHAIN_HAS_SSP
	select BR2_INSTALL_LIBSTDCPP
	select BR2_TOOLCHAIN_HEADERS_AT_LEAST_4_20
	select BR2_TOOLCHAIN_GCC_AT_LEAST_12
	select BR2_TOOLCHAIN_HAS_FORTRAN
	select BR2_TOOLCHAIN_HAS_OPENMP
	help
	  Arm toolchain for the AArch64 architecture.

	  This is the same toolchain that was previously distributed by
	  Linaro.

	  https://developer.arm.com/open-source/gnu-toolchain
```

## toolchain/toolchain-external/toolchain-external-arm-arm/Config.in
```kconfig
comment "Arm toolchains available for Cortex-A with NEON + EABIhf"
	depends on BR2_arm
	depends on !BR2_ARM_CPU_ARMV7A || !BR2_ARM_EABIHF || !BR2_ARM_CPU_HAS_NEON

config BR2_TOOLCHAIN_EXTERNAL_ARM_ARM
	bool "Arm ARM 13.2.rel1"
	depends on BR2_arm
	depends on BR2_ARM_CPU_ARMV7A || BR2_ARM_CPU_ARMV8A
	depends on BR2_ARM_CPU_HAS_NEON
	depends on BR2_HOSTARCH = "x86_64" || BR2_HOSTARCH = "aarch64"
	depends on BR2_ARM_EABIHF
	depends on !BR2_ARCH_NEEDS_GCC_AT_LEAST_13
	select BR2_TOOLCHAIN_EXTERNAL_GLIBC
	select BR2_TOOLCHAIN_HAS_SSP
	select BR2_INSTALL_LIBSTDCPP
	select BR2_TOOLCHAIN_HEADERS_AT_LEAST_4_20
	select BR2_TOOLCHAIN_GCC_AT_LEAST_13
	select BR2_TOOLCHAIN_HAS_FORTRAN
	select BR2_TOOLCHAIN_HAS_OPENMP
	help
	  Arm toolchain for the ARM architecture. It uses GCC 13.2,
	  GDB 13, glibc 2.38, Binutils 2.41. It generates code
	  that runs on all Cortex-A profile devices. The code
	  generated uses the hard floating point calling convention,
	  and uses the NEON FPU instructions.

	  This is the same toolchain that was previously distributed by
	  Linaro.

	  https://developer.arm.com/open-source/gnu-toolchain
```

## toolchain/toolchain-external/toolchain-external-synopsys-arc/Config.in
```kconfig
config BR2_TOOLCHAIN_EXTERNAL_SYNOPSYS_ARC
	bool "Synopsys ARC 2024.06 toolchain"
	depends on BR2_arc750d || BR2_arc770d || \
		BR2_archs38_64mpy || BR2_archs38_full || \
		BR2_archs4x_rel31 || BR2_archs4x
	depends on BR2_HOSTARCH = "x86_64"
	depends on !BR2_ARCH_NEEDS_GCC_AT_LEAST_15
	# The toolchains have libncurses and libexpat in their
	# sysroot, confusing Buildroot and causing build
	# issues. Disable until the toolchains get fixed.
	depends on BR2_BROKEN
	select BR2_INSTALL_LIBSTDCPP
	select BR2_TOOLCHAIN_HAS_SSP
	select BR2_TOOLCHAIN_HEADERS_AT_LEAST_5_16
	select BR2_TOOLCHAIN_GCC_AT_LEAST_14
	help
	  Toolchain for the ARC cores, from
	  https://github.com/foss-for-synopsys-dwc-arc-processors/toolchain/releases
```
