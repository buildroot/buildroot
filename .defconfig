## configs/freescale_imx95_15x15_frdm_defconfig
```kconfig
BR2_cortex_a55=y
BR2_TOOLCHAIN_EXTERNAL=y
BR2_TOOLCHAIN_EXTERNAL_BOOTLIN=y
BR2_TOOLCHAIN_EXTERNAL_BOOTLIN_AARCH64_GLIBC_STABLE=y
BR2_GLOBAL_PATCH_DIR="board/freescale/imx95-15x15-frdm/patches"
BR2_DOWNLOAD_FORCE_CHECK_HASHES=y
BR2_ROOTFS_POST_IMAGE_SCRIPT="board/freescale/common/imx/imx95-bootloader-prepare.sh board/freescale/common/imx/post-image.sh"
BR2_LINUX_KERNEL=y
BR2_LINUX_KERNEL_CUSTOM_TARBALL=y
BR2_LINUX_KERNEL_CUSTOM_TARBALL_LOCATION="$(call github,nxp-imx,linux-imx,lf-6.18.37-2.1.0)/linux-imx-lf-6.18.37-2.1.0.tar.gz"
BR2_LINUX_KERNEL_DEFCONFIG="imx_v8"
BR2_LINUX_KERNEL_DTS_SUPPORT=y
BR2_LINUX_KERNEL_INTREE_DTS_NAME="freescale/imx95-15x15-frdm"
BR2_PACKAGE_FREESCALE_IMX=y
BR2_PACKAGE_FREESCALE_IMX_PLATFORM_IMX95=y
BR2_PACKAGE_IMX_OEI=y
BR2_PACKAGE_IMX_OEI_TARGET_BOARD="mx95lp4x-15"
BR2_PACKAGE_FIRMWARE_ELE_IMX=y
BR2_PACKAGE_FIRMWARE_IMX=y
BR2_PACKAGE_FIRMWARE_IMX_LPDDR4X=y
BR2_PACKAGE_IMX_SM=y
BR2_TARGET_ROOTFS_EXT2=y
# BR2_TARGET_ROOTFS_TAR is not set
BR2_TARGET_ARM_TRUSTED_FIRMWARE=y
BR2_TARGET_ARM_TRUSTED_FIRMWARE_CUSTOM_TARBALL=y
BR2_TARGET_ARM_TRUSTED_FIRMWARE_CUSTOM_TARBALL_LOCATION="$(call github,nxp-imx,imx-atf,lf-6.18.37-2.1.0)/imx-atf-lf-6.18.37-2.1.0.tar.gz"
BR2_TARGET_ARM_TRUSTED_FIRMWARE_PLATFORM="imx95"
BR2_TARGET_ARM_TRUSTED_FIRMWARE_BL31=y
BR2_TARGET_UBOOT=y
BR2_TARGET_UBOOT_BUILD_SYSTEM_KCONFIG=y
BR2_TARGET_UBOOT_CUSTOM_TARBALL=y
BR2_TARGET_UBOOT_CUSTOM_TARBALL_LOCATION="$(call github,nxp-imx,uboot-imx,lf-6.18.37-2.1.0)/uboot-imx-lf-6.18.37-2.1.0.tar.gz"
BR2_TARGET_UBOOT_BOARD_DEFCONFIG="imx95_15x15_frdm"
BR2_TARGET_UBOOT_CONFIG_FRAGMENT_FILES="board/freescale/imx95-15x15-frdm/uboot.fragment"
BR2_TARGET_UBOOT_NEEDS_DTC=y
BR2_TARGET_UBOOT_NEEDS_OPENSSL=y
BR2_TARGET_UBOOT_NEEDS_GNUTLS=y
BR2_TARGET_UBOOT_SPL=y
BR2_PACKAGE_HOST_DOSFSTOOLS=y
BR2_PACKAGE_HOST_GENIMAGE=y
BR2_PACKAGE_HOST_IMX_MKIMAGE=y
BR2_PACKAGE_HOST_MTOOLS=y
```

## configs/imx91frdm_defconfig
```kconfig
BR2_aarch64=y
BR2_cortex_a55=y
BR2_ARM_FPU_VFPV4D16=y
BR2_TOOLCHAIN_EXTERNAL=y
BR2_TOOLCHAIN_EXTERNAL_BOOTLIN=y
BR2_TOOLCHAIN_EXTERNAL_BOOTLIN_AARCH64_GLIBC_STABLE=y
BR2_GLOBAL_PATCH_DIR="board/freescale/imx91frdm/patches"
BR2_DOWNLOAD_FORCE_CHECK_HASHES=y
BR2_TARGET_GENERIC_GETTY_PORT="ttyLP0"
BR2_ROOTFS_POST_IMAGE_SCRIPT="board/freescale/common/imx/post-image.sh"
BR2_LINUX_KERNEL=y
BR2_LINUX_KERNEL_CUSTOM_VERSION=y
BR2_LINUX_KERNEL_CUSTOM_VERSION_VALUE="7.3"
BR2_LINUX_KERNEL_USE_ARCH_DEFAULT_CONFIG=y
BR2_LINUX_KERNEL_DTS_SUPPORT=y
BR2_LINUX_KERNEL_INTREE_DTS_NAME="freescale/imx91-11x11-frdm"
BR2_LINUX_KERNEL_NEEDS_HOST_OPENSSL=y
BR2_PACKAGE_FREESCALE_IMX=y
BR2_PACKAGE_FREESCALE_IMX_PLATFORM_IMX91=y
BR2_PACKAGE_FIRMWARE_ELE_IMX=y
BR2_PACKAGE_FIRMWARE_IMX=y
BR2_TARGET_ROOTFS_EXT2=y
BR2_TARGET_ROOTFS_EXT2_4=y
BR2_TARGET_ROOTFS_EXT2_SIZE="120M"
BR2_TARGET_ARM_TRUSTED_FIRMWARE=y
BR2_TARGET_ARM_TRUSTED_FIRMWARE_CUSTOM_TARBALL=y
BR2_TARGET_ARM_TRUSTED_FIRMWARE_CUSTOM_TARBALL_LOCATION="$(call github,nxp-imx,imx-atf,lf-6.18.37-2.1.0)/imx-atf-lf-6.18.37-2.1.0.tar.gz"
BR2_TARGET_ARM_TRUSTED_FIRMWARE_PLATFORM="imx91"
BR2_TARGET_UBOOT=y
BR2_TARGET_UBOOT_BUILD_SYSTEM_KCONFIG=y
BR2_TARGET_UBOOT_CUSTOM_VERSION=y
BR2_TARGET_UBOOT_CUSTOM_VERSION_VALUE="2026.10"
BR2_TARGET_UBOOT_BOARD_DEFCONFIG="imx91_11x11_frdm"
BR2_TARGET_UBOOT_NEEDS_DTC=y
BR2_TARGET_UBOOT_NEEDS_PYLIBFDT=y
BR2_TARGET_UBOOT_NEEDS_OPENSSL=y
BR2_TARGET_UBOOT_NEEDS_ATF_BL31=y
BR2_TARGET_UBOOT_NEEDS_IMX_FIRMWARE=y
BR2_TARGET_UBOOT_NEEDS_IMX_ELE_FIRMWARE=y
BR2_TARGET_UBOOT_FORMAT_CUSTOM=y
BR2_TARGET_UBOOT_FORMAT_CUSTOM_NAME="flash.bin"
BR2_TARGET_UBOOT_SPL=y
BR2_PACKAGE_HOST_DOSFSTOOLS=y
BR2_PACKAGE_HOST_GENIMAGE=y
BR2_PACKAGE_HOST_MTOOLS=y
BR2_PACKAGE_HOST_UBOOT_TOOLS=y
```

## configs/imx93frdm_defconfig
```kconfig
BR2_aarch64=y
BR2_cortex_a55=y
BR2_ARM_FPU_VFPV4D16=y
BR2_TOOLCHAIN_EXTERNAL=y
BR2_TOOLCHAIN_EXTERNAL_BOOTLIN=y
BR2_TOOLCHAIN_EXTERNAL_BOOTLIN_AARCH64_GLIBC_STABLE=y
BR2_GLOBAL_PATCH_DIR="board/freescale/imx93frdm/patches"
BR2_DOWNLOAD_FORCE_CHECK_HASHES=y
BR2_TARGET_GENERIC_GETTY_PORT="ttyLP0"
BR2_ROOTFS_POST_IMAGE_SCRIPT="board/freescale/common/imx/post-image.sh"
BR2_LINUX_KERNEL=y
BR2_LINUX_KERNEL_CUSTOM_VERSION=y
BR2_LINUX_KERNEL_CUSTOM_VERSION_VALUE="7.3"
BR2_LINUX_KERNEL_USE_ARCH_DEFAULT_CONFIG=y
BR2_LINUX_KERNEL_DTS_SUPPORT=y
BR2_LINUX_KERNEL_INTREE_DTS_NAME="freescale/imx93-11x11-frdm"
BR2_LINUX_KERNEL_NEEDS_HOST_OPENSSL=y
BR2_PACKAGE_FREESCALE_IMX=y
BR2_PACKAGE_FREESCALE_IMX_PLATFORM_IMX93=y
BR2_PACKAGE_FIRMWARE_ELE_IMX=y
BR2_PACKAGE_FIRMWARE_IMX=y
BR2_TARGET_ROOTFS_EXT2=y
BR2_TARGET_ROOTFS_EXT2_4=y
BR2_TARGET_ROOTFS_EXT2_SIZE="120M"
BR2_TARGET_ARM_TRUSTED_FIRMWARE=y
BR2_TARGET_ARM_TRUSTED_FIRMWARE_CUSTOM_VERSION=y
BR2_TARGET_ARM_TRUSTED_FIRMWARE_CUSTOM_VERSION_VALUE="v2.15.0"
BR2_TARGET_ARM_TRUSTED_FIRMWARE_PLATFORM="imx93"
BR2_TARGET_UBOOT=y
BR2_TARGET_UBOOT_BUILD_SYSTEM_KCONFIG=y
BR2_TARGET_UBOOT_CUSTOM_VERSION=y
BR2_TARGET_UBOOT_CUSTOM_VERSION_VALUE="2026.10"
BR2_TARGET_UBOOT_BOARD_DEFCONFIG="imx93_frdm"
BR2_TARGET_UBOOT_NEEDS_DTC=y
BR2_TARGET_UBOOT_NEEDS_PYLIBFDT=y
BR2_TARGET_UBOOT_NEEDS_OPENSSL=y
BR2_TARGET_UBOOT_NEEDS_ATF_BL31=y
BR2_TARGET_UBOOT_NEEDS_IMX_FIRMWARE=y
BR2_TARGET_UBOOT_NEEDS_IMX_ELE_FIRMWARE=y
BR2_TARGET_UBOOT_FORMAT_CUSTOM=y
BR2_TARGET_UBOOT_FORMAT_CUSTOM_NAME="flash.bin"
BR2_TARGET_UBOOT_SPL=y
BR2_PACKAGE_HOST_DOSFSTOOLS=y
BR2_PACKAGE_HOST_GENIMAGE=y
BR2_PACKAGE_HOST_MTOOLS=y
BR2_PACKAGE_HOST_UBOOT_TOOLS=y
```

## configs/socfpga_agilex5_vendor_defconfig
```kconfig
BR2_cortex_a55=y
BR2_TOOLCHAIN_EXTERNAL=y
BR2_TOOLCHAIN_EXTERNAL_BOOTLIN=y
BR2_TOOLCHAIN_EXTERNAL_BOOTLIN_AARCH64_GLIBC_STABLE=y
BR2_GLOBAL_PATCH_DIR="board/altera/agilex5/patches"
BR2_DOWNLOAD_FORCE_CHECK_HASHES=y
BR2_TARGET_GENERIC_HOSTNAME="agilex5"
BR2_TARGET_GENERIC_GETTY_PORT="ttyS0"
BR2_SYSTEM_DHCP="eth0"
BR2_ROOTFS_POST_IMAGE_SCRIPT="support/scripts/genimage.sh"
BR2_ROOTFS_POST_IMAGE_SCRIPT_ARGS="-c board/altera/agilex5/genimage.cfg"
BR2_LINUX_KERNEL=y
BR2_LINUX_KERNEL_CUSTOM_GIT=y
BR2_LINUX_KERNEL_CUSTOM_REPO_URL="https://github.com/altera-fpga/linux-socfpga.git"
BR2_LINUX_KERNEL_CUSTOM_REPO_VERSION="QPDS26.1.1_REL_GSRD_PR"
BR2_LINUX_KERNEL_USE_ARCH_DEFAULT_CONFIG=y
BR2_LINUX_KERNEL_CONFIG_FRAGMENT_FILES="board/altera/agilex5/linux.fragment"
BR2_LINUX_KERNEL_DTS_SUPPORT=y
BR2_LINUX_KERNEL_INTREE_DTS_NAME="intel/socfpga_agilex5_socdk"
BR2_LINUX_KERNEL_INSTALL_TARGET=y
BR2_LINUX_KERNEL_NEEDS_HOST_OPENSSL=y
BR2_TARGET_ROOTFS_EXT2=y
BR2_TARGET_ROOTFS_EXT2_4=y
BR2_TARGET_ROOTFS_EXT2_SIZE="256M"
# BR2_TARGET_ROOTFS_TAR is not set
BR2_TARGET_ARM_TRUSTED_FIRMWARE=y
BR2_TARGET_ARM_TRUSTED_FIRMWARE_CUSTOM_GIT=y
BR2_TARGET_ARM_TRUSTED_FIRMWARE_CUSTOM_REPO_URL="https://github.com/altera-fpga/arm-trusted-firmware.git"
BR2_TARGET_ARM_TRUSTED_FIRMWARE_CUSTOM_REPO_VERSION="QPDS26.1.1_REL_GSRD_PR"
BR2_TARGET_ARM_TRUSTED_FIRMWARE_PLATFORM="agilex5"
BR2_TARGET_UBOOT=y
BR2_TARGET_UBOOT_BUILD_SYSTEM_KCONFIG=y
BR2_TARGET_UBOOT_CUSTOM_GIT=y
BR2_TARGET_UBOOT_CUSTOM_REPO_URL="https://github.com/altera-fpga/u-boot-socfpga.git"
BR2_TARGET_UBOOT_CUSTOM_REPO_VERSION="QPDS26.1.1_REL_GSRD_PR"
BR2_TARGET_UBOOT_BOARD_DEFCONFIG="socfpga_agilex5"
BR2_TARGET_UBOOT_CONFIG_FRAGMENT_FILES="board/altera/agilex5/uboot.fragment"
BR2_TARGET_UBOOT_NEEDS_DTC=y
BR2_TARGET_UBOOT_NEEDS_OPENSSL=y
BR2_TARGET_UBOOT_NEEDS_ATF_BL31=y
BR2_TARGET_UBOOT_USE_BINMAN=y
# BR2_TARGET_UBOOT_FORMAT_BIN is not set
BR2_TARGET_UBOOT_FORMAT_ITB=y
BR2_TARGET_UBOOT_SPL=y
BR2_TARGET_UBOOT_SPL_NAME="spl/u-boot-spl-dtb.hex"
BR2_PACKAGE_HOST_DOSFSTOOLS=y
BR2_PACKAGE_HOST_GENIMAGE=y
BR2_PACKAGE_HOST_MTOOLS=y
```

## package/armadillo/Config.in
```kconfig
comment "armadillo needs a toolchain w/ C++, gcc >= 8"
	depends on BR2_PACKAGE_OPENBLAS_ARCH_SUPPORTS
	depends on !BR2_INSTALL_LIBSTDCPP || !BR2_TOOLCHAIN_GCC_AT_LEAST_8

comment "armadillo needs a toolchain w/ fortran, C++, gcc >= 8"
	depends on !BR2_PACKAGE_OPENBLAS_ARCH_SUPPORTS # otherwise, see comment above
	depends on BR2_PACKAGE_LAPACK_ARCH_SUPPORTS
	depends on !BR2_TOOLCHAIN_HAS_FORTRAN || !BR2_INSTALL_LIBSTDCPP
	depends on !BR2_TOOLCHAIN_GCC_AT_LEAST_8

config BR2_PACKAGE_ARMADILLO
	bool "armadillo"
	depends on BR2_PACKAGE_OPENBLAS_ARCH_SUPPORTS || \
		(BR2_PACKAGE_LAPACK_ARCH_SUPPORTS && BR2_TOOLCHAIN_HAS_FORTRAN)
	depends on BR2_INSTALL_LIBSTDCPP
	depends on BR2_TOOLCHAIN_GCC_AT_LEAST_8 # armadillo requires gcc >= 8.1
	help
	  Armadillo: An Open Source C++ Linear Algebra Library for
	  Fast Prototyping and Computationally Intensive Experiments.

	  http://arma.sourceforge.net/

if BR2_PACKAGE_ARMADILLO

choice
	prompt "BLAS implementation"

config BR2_PACKAGE_ARMADILLO_OPENBLAS
	bool "openblas"
	depends on BR2_PACKAGE_OPENBLAS_ARCH_SUPPORTS
	select BR2_PACKAGE_OPENBLAS

config BR2_PACKAGE_ARMADILLO_LAPACK
	bool "lapack"
	depends on BR2_PACKAGE_LAPACK_ARCH_SUPPORTS && BR2_TOOLCHAIN_HAS_FORTRAN
	select BR2_PACKAGE_LAPACK

endchoice

endif
```

## package/atf/Config.in
```kconfig
config BR2_PACKAGE_ATF
	bool "atf"
	depends on BR2_INSTALL_LIBSTDCPP
	depends on BR2_TOOLCHAIN_GCC_AT_LEAST_10 # C++20
	depends on BR2_USE_MMU # fork()
	help
	  ATF, or Automated Testing Framework, is a collection of
	  libraries to write test programs in C, C++ and POSIX shell.

	  https://github.com/freebsd/atf

comment "atf needs a toolchain w/ C++, gcc >= 10"
	depends on !BR2_INSTALL_LIBSTDCPP || !BR2_TOOLCHAIN_GCC_AT_LEAST_10
	depends on BR2_USE_MMU
```

## package/binutils/Config.in.host
```kconfig
comment "Binutils Options"

config BR2_PACKAGE_HOST_BINUTILS_SUPPORTS_CFI
	bool
	default y
	depends on !BR2_microblaze

choice
	prompt "Binutils Version"
	default BR2_BINUTILS_VERSION_2_43_X
	help
	  Select the version of binutils you wish to use.

config BR2_BINUTILS_VERSION_2_42_X
	bool "binutils 2.42"

config BR2_BINUTILS_VERSION_2_43_X
	bool "binutils 2.43.1"

config BR2_BINUTILS_VERSION_2_44_X
	bool "binutils 2.44"

endchoice

config BR2_BINUTILS_VERSION
	string
	default "2.42"		if BR2_BINUTILS_VERSION_2_42_X
	default "2.43.1"	if BR2_BINUTILS_VERSION_2_43_X
	default "2.44"		if BR2_BINUTILS_VERSION_2_44_X

config BR2_BINUTILS_GPROFNG
	bool "gprofng support"
	help
	  This option enables support for gprofng, a new profiler.

config BR2_BINUTILS_EXTRA_CONFIG_OPTIONS
	string "Additional binutils options"
	default ""
	help
	  Any additional binutils options you may want to include.
```

## package/btop/Config.in
```kconfig
config BR2_PACKAGE_BTOP
	bool "btop"
	depends on BR2_INSTALL_LIBSTDCPP
	depends on BR2_TOOLCHAIN_HAS_THREADS
	depends on BR2_USE_WCHAR
	depends on BR2_ENABLE_LOCALE
	depends on BR2_TOOLCHAIN_GCC_AT_LEAST_14
	depends on !BR2_TOOLCHAIN_USES_UCLIBC # no quick_exit()
	help
	  Resource monitor that shows usage and stats for processor,
	  memory, disks, network and processes.

	  https://github.com/aristocratos/btop

if BR2_PACKAGE_BTOP

config BR2_PACKAGE_BTOP_GPU
	bool "GPU monitoring support"
	depends on !BR2_STATIC_LIBS # dlopen()
	help
	  Enable GPU monitoring. Intel i915 GPUs are accessed through
	  the kernel perf interface. NVIDIA and AMD GPUs additionally
	  require NVML and ROCm SMI respectively at runtime.

comment "GPU monitoring needs a toolchain w/ dynamic library"
	depends on BR2_STATIC_LIBS

endif

comment "btop needs a glibc or musl toolchain w/ C++, threads, wchar, locale, gcc >= 14"
	depends on BR2_TOOLCHAIN_USES_UCLIBC \
		|| !BR2_INSTALL_LIBSTDCPP \
		|| !BR2_TOOLCHAIN_HAS_THREADS \
		|| !BR2_USE_WCHAR \
		|| !BR2_ENABLE_LOCALE \
		|| !BR2_TOOLCHAIN_GCC_AT_LEAST_14
```

## package/chawan/Config.in
```kconfig
config BR2_PACKAGE_CHAWAN_ARCH_SUPPORTS
	bool
	default y
	depends on BR2_USE_MMU
	depends on !BR2_or1k

config BR2_PACKAGE_CHAWAN
	bool "chawan"
	depends on BR2_PACKAGE_CHAWAN_ARCH_SUPPORTS
	depends on BR2_TOOLCHAIN_GCC_AT_LEAST_11
	select BR2_PACKAGE_BROTLI
	select BR2_PACKAGE_LIBSSH2
	select BR2_PACKAGE_OPENSSL
	help
	  A TUI Web-Browser.

	  https://chawan.net/

comment "chawan needs a toolchain w/ gcc >= 11"
	depends on BR2_PACKAGE_CHAWAN_ARCH_SUPPORTS
	depends on !BR2_TOOLCHAIN_GCC_AT_LEAST_11
```

## package/cpp-argparse/Config.in
```kconfig
config BR2_PACKAGE_CPP_ARGPARSE
	bool "cpp-argparse"
	depends on BR2_INSTALL_LIBSTDCPP
	depends on BR2_TOOLCHAIN_GCC_AT_LEAST_8
	help
	  Argument Parser for Modern C++. A header-only library
	  for parsing command-line arguments.

	  https://github.com/p-ranav/argparse

comment "cpp-argparse needs a toolchain w/ C++, gcc >= 8"
	depends on !BR2_INSTALL_LIBSTDCPP || !BR2_TOOLCHAIN_GCC_AT_LEAST_8
```

## package/cutekeyboard/Config.in
```kconfig
config BR2_PACKAGE_CUTEKEYBOARD
	bool "cutekeyboard"
	depends on BR2_PACKAGE_QT5 || BR2_PACKAGE_QT6
	depends on BR2_PACKAGE_QT5_JSCORE_AVAILABLE || BR2_PACKAGE_QT6 # qt5declarative
	select BR2_PACKAGE_QT5DECLARATIVE if BR2_PACKAGE_QT5
	select BR2_PACKAGE_QT5DECLARATIVE_QUICK if BR2_PACKAGE_QT5
	select BR2_PACKAGE_QT5QUICKCONTROLS2 if BR2_PACKAGE_QT5
	select BR2_PACKAGE_QT6DECLARATIVE if BR2_PACKAGE_QT6
	select BR2_PACKAGE_QT6DECLARATIVE_QUICK if BR2_PACKAGE_QT6
	help
	  CuteKeyboard is a Qt virtual keyboard plugin for
	  embedded applications.

	  https://amarula.github.io/cutekeyboard/

if BR2_PACKAGE_CUTEKEYBOARD

config BR2_PACKAGE_CUTEKEYBOARD_EXAMPLES
	bool "cutekeyboard examples"
	help
	  Compile also application example

endif
```

## package/dovecot/Config.in
```kconfig
config BR2_PACKAGE_DOVECOT
	bool "dovecot"
	depends on !BR2_STATIC_LIBS
	depends on BR2_USE_MMU # fork()
	select BR2_PACKAGE_LIBICONV if !BR2_ENABLE_LOCALE
	select BR2_PACKAGE_LIBOPENSSL_ENGINES if BR2_PACKAGE_LIBOPENSSL
	select BR2_PACKAGE_LIBXCRYPT if BR2_TOOLCHAIN_USES_GLIBC
	select BR2_PACKAGE_PCRE2_32 if BR2_PACKAGE_PCRE2
	select BR2_PACKAGE_OPENSSL
	select BR2_PACKAGE_ZLIB
	help
	  Dovecot is an open source IMAP and POP3 email server for
	  Linux/UNIX- like systems, written with security primarily in
	  mind. Dovecot is an excellent choice for both small and large
	  installations. It's fast, simple to set up, requires no
	  special administration and it uses very little memory.

	  http://www.dovecot.org

if BR2_PACKAGE_DOVECOT

config BR2_PACKAGE_DOVECOT_MYSQL
	bool "mysql support"
	depends on BR2_INSTALL_LIBSTDCPP # mariadb
	depends on BR2_TOOLCHAIN_HAS_THREADS # mariadb
	depends on BR2_TOOLCHAIN_HAS_ATOMIC || BR2_TOOLCHAIN_HAS_SYNC_8 # mariadb
	depends on BR2_USE_WCHAR # mariadb
	select BR2_PACKAGE_MARIADB
	help
	  Enable MySQL support.

comment "mysql support needs a toolchain w/ C++, threads, wchar"
	depends on BR2_TOOLCHAIN_HAS_ATOMIC || BR2_TOOLCHAIN_HAS_SYNC_8
	depends on !BR2_INSTALL_LIBSTDCPP || !BR2_TOOLCHAIN_HAS_THREADS || \
		!BR2_USE_WCHAR

config BR2_PACKAGE_DOVECOT_POSTGRESQL
	bool "postgresql support"
	depends on !BR2_sparc # postgresql
	depends on BR2_USE_WCHAR # postgresql
	depends on BR2_ENABLE_LOCALE # postgresql
	depends on BR2_TOOLCHAIN_HAS_THREADS_NPTL # postgresql
	depends on !BR2_OPTIMIZE_FAST # postgresql
	select BR2_PACKAGE_POSTGRESQL
	help
	  Enable PostgreSQL support.

comment "postgresql needs a toolchain w/ wchar, NPTL, locale"
	depends on !BR2_sparc
	depends on !BR2_USE_WCHAR
	depends on !BR2_ENABLE_LOCALE
	depends on !BR2_TOOLCHAIN_HAS_THREADS_NPTL
	depends on BR2_OPTIMIZE_FAST

config BR2_PACKAGE_DOVECOT_SQLITE
	bool "sqlite support"
	select BR2_PACKAGE_SQLITE
	help
	  Enable SQLite support.

source "package/dovecot-pigeonhole/Config.in"

endif # BR2_PACKAGE_DOVECOT

comment "dovecot needs a toolchain w/ dynamic library"
	depends on BR2_USE_MMU
	depends on BR2_STATIC_LIBS
```
