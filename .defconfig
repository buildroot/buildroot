## package/drogon/Config.in
```kconfig
config BR2_PACKAGE_DROGON
	bool "drogon"
	depends on BR2_INSTALL_LIBSTDCPP
	depends on BR2_TOOLCHAIN_GCC_AT_LEAST_11 # C++17/20
	depends on BR2_TOOLCHAIN_HAS_THREADS
	depends on BR2_USE_MMU # fork()
	select BR2_PACKAGE_JSONCPP
	select BR2_PACKAGE_UTIL_LINUX
	select BR2_PACKAGE_UTIL_LINUX_LIBUUID
	select BR2_PACKAGE_ZLIB
	help
	  Drogon is a C++17/20 based HTTP application framework.
	  Drogon can be used to easily build various types of web
	  application server programs using C++.

	  https://github.com/drogonframework/drogon

if BR2_PACKAGE_DROGON

config BR2_PACKAGE_DROGON_BROTLI
	bool "build Brotli"
	select BR2_PACKAGE_BROTLI
	help
	  Add support for brotli compression.

config BR2_PACKAGE_DROGON_CTL
	bool "build drogon_ctl"
	help
	  drogon_ctl is a command-line tool used to generate
	  project skeletons and source code.

config BR2_PACKAGE_DROGON_EXAMPLES
	bool "build examples"

config BR2_PACKAGE_DROGON_ORM
	bool "build orm"
	help
	  Enable the ORM module for typed database access.

config BR2_PACKAGE_DROGON_YAML_CONFIG
	bool "build yaml config"
	select BR2_PACKAGE_YAML_CPP
	help
	  Add support for YAML configuration via yaml-cpp.

endif

comment "drogon needs a toolchain w/ C++, threads, gcc >= 11"
	depends on BR2_USE_MMU
	depends on !BR2_INSTALL_LIBSTDCPP || \
		!BR2_TOOLCHAIN_GCC_AT_LEAST_11 || \
		!BR2_TOOLCHAIN_HAS_THREADS
```

## package/eigen/Config.in
```kconfig
config BR2_PACKAGE_EIGEN
	bool "eigen"
	depends on BR2_INSTALL_LIBSTDCPP
	depends on BR2_TOOLCHAIN_GCC_AT_LEAST_6 # C++14
	help
	  Eigen is a C++ template library for linear algebra: vectors,
	  matrices, and related algorithms. It is versatile, fast,
	  elegant and works on many platforms (OS/Compilers).

	  This package only installs header files to the include path.
	  If you just want to use Eigen, you can use the header files
	  right away. There is no binary to link to. Eigen is a pure
	  template library defined in the headers.

	  https://gitlab.com/libeigen/eigen

comment "eigen needs a toolchain w/ C++, gcc >= 6"
	depends on !BR2_INSTALL_LIBSTDCPP || !BR2_TOOLCHAIN_GCC_AT_LEAST_6
```

## package/espflash/Config.in
```kconfig
config BR2_PACKAGE_ESPFLASH
	bool "espflash"
	depends on BR2_PACKAGE_HOST_RUSTC_TARGET_ARCH_SUPPORTS
	depends on BR2_PACKAGE_HAS_UDEV
	select BR2_PACKAGE_HOST_RUSTC
	help
	  Serial flasher utilities for Espressif devices, based
	  loosely on esptool.py. Supports the ESP32,
	  ESP32-C2/C3/C5/C6/C61, ESP32-H2/H4, ESP32-P4, and
	  ESP32-S2/S3/S31.

	  https://github.com/esp-rs/espflash

comment "espflash needs udev /dev management"
	depends on BR2_PACKAGE_HOST_RUSTC_TARGET_ARCH_SUPPORTS
	depends on !BR2_PACKAGE_HAS_UDEV
```

## package/freescale-imx/imx-oei/Config.in
```kconfig
config BR2_PACKAGE_IMX_OEI
	bool "imx-oei"
	depends on BR2_PACKAGE_HOST_ARM_GNU_TOOLCHAIN_SUPPORTS
	help
	  imx-oei contains the source code for the Optional Executable
	  Image (OEI), which is a piece of code executed by the boot CPU
	  that initializes various aspects of the hardware
	  (i.e. DDR, TCM).

	  https://github.com/nxp-imx/imx-oei

if BR2_PACKAGE_IMX_OEI

config BR2_PACKAGE_IMX_OEI_TARGET_BOARD
	string "Target board"
	default "mx95lp5"
	help
	  Which board to build the OEI for.

config BR2_PACKAGE_IMX_OEI_TARGET_REV
	string
	default "b0" if BR2_PACKAGE_FREESCALE_IMX_PLATFORM_IMX95B0

endif
```

## package/freescale-imx/imx-sm/Config.in
```kconfig
config BR2_PACKAGE_IMX_SM
	bool "imx-sm"
	depends on BR2_PACKAGE_HOST_ARM_GNU_TOOLCHAIN_SUPPORTS
	help
	  imx-sm contains the source code for the System Manager (SM)
	  firmware used on NXP SoCs such as MX95 and MX943.

	  https://github.com/nxp-imx/imx-sm

if BR2_PACKAGE_IMX_SM

config BR2_PACKAGE_IMX_SM_CFG
	string "Target configuration"
	default "mx95evk"
	help
	  Which configuration to use in the build process.

endif
```

## package/gdb/Config.in.host
```kconfig
config BR2_PACKAGE_HOST_GDB_ARCH_SUPPORTS
	bool
	default y
	depends on !((BR2_arm || BR2_armeb) && BR2_BINFMT_FLAT)
	depends on !BR2_microblaze

comment "Host GDB Options"
	depends on !BR2_TOOLCHAIN_EXTERNAL_GDB_SERVER_COPY
	depends on BR2_PACKAGE_HOST_GDB_ARCH_SUPPORTS

comment "cross gdb for the host needs host and target gcc >= 9"
	depends on !BR2_HOST_GCC_AT_LEAST_9 || \
		!BR2_TOOLCHAIN_GCC_AT_LEAST_9

config BR2_PACKAGE_HOST_GDB
	bool "Build cross gdb for the host"
	# When the external toolchain gdbserver is used, we shouldn't
	# allow to build a cross-gdb, as the one of the external
	# toolchain should be used.
	depends on !BR2_TOOLCHAIN_EXTERNAL_GDB_SERVER_COPY
	depends on BR2_PACKAGE_HOST_GDB_ARCH_SUPPORTS
	depends on BR2_HOST_GCC_AT_LEAST_9 && BR2_TOOLCHAIN_GCC_AT_LEAST_9
	help
	  Build a cross gdb that runs on the host machine and debugs
	  programs running on the target. It requires 'gdbserver'
	  installed on the target, see BR2_PACKAGE_GDB_SERVER to
	  enable it.

if BR2_PACKAGE_HOST_GDB

config BR2_PACKAGE_HOST_GDB_TUI
	bool "TUI support"
	help
	  This option enables terminal user interface (TUI) for gdb

config BR2_PACKAGE_HOST_GDB_PYTHON3
	bool "Python support"
	help
	  This option enables the Python 3 support in the cross gdb.

config BR2_PACKAGE_HOST_GDB_SIM
	bool "Simulator support"
	depends on !BR2_arc
	help
	  This option enables the simulator support in the cross gdb.

choice
	prompt "GDB debugger Version"
	default BR2_GDB_VERSION_16
	help
	  Select the version of gdb you wish to use.

config BR2_GDB_VERSION_15
	bool "gdb 15.x"

config BR2_GDB_VERSION_16
	bool "gdb 16.x"

config BR2_GDB_VERSION_17
	bool "gdb 17.x"

endchoice

endif

# If cross-gdb is not enabled, the latest stable version is chosen.
config BR2_GDB_VERSION
	string
	default "15.2"	   if BR2_GDB_VERSION_15
	default "16.3"	   if BR2_GDB_VERSION_16
	default "17.1"	   if BR2_GDB_VERSION_17
	depends on BR2_PACKAGE_GDB || BR2_PACKAGE_HOST_GDB
```

## package/gensio/Config.in
```kconfig
config BR2_PACKAGE_GENSIO
	bool "gensio"
	depends on BR2_USE_MMU # fork()
	depends on !BR2_STATIC_LIBS # dlfcn.h
	depends on BR2_TOOLCHAIN_HAS_ATOMIC
	help
	  A library to abstract stream I/O like serial port, TCP,
	  telnet, UDP, SSL, IPMI SOL, etc.

	  https://github.com/cminyard/gensio

comment "gensio needs a toolchain w/ dynamic library"
	depends on BR2_USE_MMU
	depends on BR2_TOOLCHAIN_HAS_ATOMIC
	depends on BR2_STATIC_LIBS
```

## package/gtkiostream/Config.in
```kconfig
config BR2_PACKAGE_GTKIOSTREAM_ARCH_SUPPORTS
	bool
	default y if BR2_ENDIAN = "LITTLE"

config BR2_PACKAGE_GTKIOSTREAM
	bool "gtkiostream"
	depends on BR2_PACKAGE_GTKIOSTREAM_ARCH_SUPPORTS
	depends on BR2_INSTALL_LIBSTDCPP # eigen
	depends on BR2_TOOLCHAIN_GCC_AT_LEAST_6 # eigen
	depends on BR2_TOOLCHAIN_HAS_THREADS
	select BR2_PACKAGE_ALSA_LIB_MIXER if BR2_PACKAGE_ALSA_LIB
	select BR2_PACKAGE_EIGEN
	select BR2_PACKAGE_FFTW
	select BR2_PACKAGE_FFTW_DOUBLE
	select BR2_PACKAGE_FFTW_SINGLE
	help
	  This package provides many useful software engineering and
	  signal processing includes and linkable library.

	  https://github.com/flatmax/gtkiostream

comment "gtkiostream needs a toolchain w/ C++, gcc >= 6, threads"
	depends on BR2_PACKAGE_GTKIOSTREAM_ARCH_SUPPORTS
	depends on !BR2_INSTALL_LIBSTDCPP || \
		!BR2_TOOLCHAIN_GCC_AT_LEAST_6 || \
		!BR2_TOOLCHAIN_HAS_THREADS
```

## package/hare-dbus/Config.in
```kconfig
config BR2_PACKAGE_HARE_DBUS
	bool "hare-dbus"
	depends on BR2_PACKAGE_HOST_HARE_TARGET_ARCH_SUPPORTS
	select BR2_PACKAGE_HOST_HARE
	select BR2_PACKAGE_HARE_EV
	select BR2_PACKAGE_HARE_XML
	help
	  D-Bus client implementation for Hare.

	  https://git.sr.ht/~whynothugo/hare-dbus
```

## package/hare-ev/Config.in
```kconfig
config BR2_PACKAGE_HARE_EV
	bool "hare-ev"
	depends on BR2_PACKAGE_HOST_HARE_TARGET_ARCH_SUPPORTS
	select BR2_PACKAGE_HOST_HARE
	help
	  This package provides an event loop for Hare programs.

	  https://git.sr.ht/~sircmpwn/hare-ev
```

## package/hare-xml/Config.in
```kconfig
config BR2_PACKAGE_HARE_XML
	bool "hare-xml"
	depends on BR2_PACKAGE_HOST_HARE_TARGET_ARCH_SUPPORTS
	select BR2_PACKAGE_HOST_HARE
	help
	  This package provides XML support for Hare.

	  https://git.sr.ht/~sircmpwn/hare-xml
```

## package/hare/Config.in.host
```kconfig
config BR2_PACKAGE_HOST_HARE_TARGET_ARCH_SUPPORTS
	bool
	default y if BR2_aarch64
	default y if BR2_RISCV_64
	default y if BR2_x86_64

config BR2_PACKAGE_HOST_HARE
	bool "host hare"
	depends on BR2_PACKAGE_HOST_HARE_TARGET_ARCH_SUPPORTS
	help
	  The Hare programming language

	  https://harelang.org/
```
