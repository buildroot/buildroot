## package/intelce-sdk/package/Config.in
```kconfig
source  package/intelce-sdk/package/intelce-8051_SDK/Config.in
if BR2_PACKAGE_INTELCE_SDK_V21
source  package/intelce-sdk/package/intelce-alsa/Config.in
endif
source  package/intelce-sdk/package/intelce-alsa_shim/Config.in
source  package/intelce-sdk/package/intelce-api/Config.in
source  package/intelce-sdk/package/intelce-audio/Config.in
if BR2_PACKAGE_INTELCE_SDK_V36
source  package/intelce-sdk/package/intelce-audio_fw_bin/Config.in
endif
if BR2_PACKAGE_INTELCE_SDK_V21
source  package/intelce-sdk/package/intelce-audio_fw/Config.in 
endif
source  package/intelce-sdk/package/intelce-auto_eas/Config.in
source  package/intelce-sdk/package/intelce-avcap/Config.in
source  package/intelce-sdk/package/intelce-avcap_samples/Config.in
source  package/intelce-sdk/package/intelce-bufmon/Config.in
source  package/intelce-sdk/package/intelce-cefdk/Config.in
source  package/intelce-sdk/package/intelce-clock/Config.in
source  package/intelce-sdk/package/intelce-clock_control/Config.in
source  package/intelce-sdk/package/intelce-clock_recovery/Config.in
source  package/intelce-sdk/package/intelce-common/Config.in
source  package/intelce-sdk/package/intelce-config_database/Config.in
source  package/intelce-sdk/package/intelce-core/Config.in
if BR2_PACKAGE_INTELCE_SDK_V36
source  package/intelce-sdk/package/intelce-cosai/Config.in
endif
source  package/intelce-sdk/package/intelce-demux/Config.in
if BR2_PACKAGE_INTELCE_SDK_V21
source  package/intelce-sdk/package/intelce-DirectFB_1_4/Config.in
endif
if BR2_PACKAGE_INTELCE_SDK_V36
source  package/intelce-sdk/package/intelce-devmem/Config.in
endif
source  package/intelce-sdk/package/intelce-display/Config.in
source  package/intelce-sdk/package/intelce-edl/Config.in
if BR2_PACKAGE_INTELCE_SDK_V36
source  package/intelce-sdk/package/intelce-expbus/Config.in
endif
source  package/intelce-sdk/package/intelce-flash_appdata/Config.in
source  package/intelce-sdk/package/intelce-flash_encryption_signing_tools/Config.in
source  package/intelce-sdk/package/intelce-flashtool/Config.in
if BR2_PACKAGE_INTELCE_SDK_V36
source  package/intelce-sdk/package/intelce-fw_load/Config.in
endif
source  package/intelce-sdk/package/intelce-generic_timer/Config.in
if BR2_PACKAGE_INTELCE_SDK_V36
source  package/intelce-sdk/package/intelce-gpio/Config.in
endif
if BR2_PACKAGE_INTELCE_SDK_V36
source  package/intelce-sdk/package/intelce-graphics_2d/Config.in
endif
source  package/intelce-sdk/package/intelce-graphics_apps/Config.in
source  package/intelce-sdk/package/intelce-graphics/Config.in
source  package/intelce-sdk/package/intelce-gsven/Config.in
source  package/intelce-sdk/package/intelce-hdmi_hdcp/Config.in
source  package/intelce-sdk/package/intelce-htuple/Config.in
source  package/intelce-sdk/package/intelce-idl/Config.in
if BR2_PACKAGE_INTELCE_SDK_V36
source  package/intelce-sdk/package/intelce-idtsal/Config.in
endif
source  package/intelce-sdk/package/intelce-idts_common/Config.in
if BR2_PACKAGE_INTELCE_SDK_V36
source  package/intelce-sdk/package/intelce-idts_core/Config.in
source  package/intelce-sdk/package/intelce-idts_media/Config.in
endif
source  package/intelce-sdk/package/intelce-idts_security/Config.in
source  package/intelce-sdk/package/intelce-init_man/Config.in
source  package/intelce-sdk/package/intelce-intel_ce_pm/Config.in
if BR2_PACKAGE_INTELCE_SDK_V36
source  package/intelce-sdk/package/intelce-iosf/Config.in
endif
if BR2_PACKAGE_INTELCE_SDK_V21
source  package/intelce-sdk/package/intelce-ipclib/Config.in
endif
source  package/intelce-sdk/package/intelce-itstore/Config.in
source  package/intelce-sdk/package/intelce-keyrefresh/Config.in
source  package/intelce-sdk/package/intelce-mfhlib/Config.in
if BR2_PACKAGE_INTELCE_SDK_V36
source  package/intelce-sdk/package/intelce-mspod/Config.in
endif
source  package/intelce-sdk/package/intelce-mux/Config.in
source  package/intelce-sdk/package/intelce-nand_config/Config.in
source  package/intelce-sdk/package/intelce-nsprpub_mw_dep/Config.in
source  package/intelce-sdk/package/intelce-osal/Config.in
source  package/intelce-sdk/package/intelce-pal/Config.in
if BR2_PACKAGE_INTELCE_SDK_V36
source  package/intelce-sdk/package/intelce-performancetools/Config.in
endif
source  package/intelce-sdk/package/intelce-pic24/Config.in
source  package/intelce-sdk/package/intelce-pic24_uart/Config.in
source  package/intelce-sdk/package/intelce-pic24_uart_drv/Config.in
source  package/intelce-sdk/package/intelce-platform_config/Config.in
if BR2_PACKAGE_INTELCE_SDK_V36
source  package/intelce-sdk/package/intelce-punit_fw_upgrade/Config.in
endif
if BR2_PACKAGE_INTELCE_SDK_V36
source  package/intelce-sdk/package/intelce-pwm/Config.in
endif
source  package/intelce-sdk/package/intelce-remux/Config.in
source  package/intelce-sdk/package/intelce-sec/Config.in
source  package/intelce-sdk/package/intelce-sec_diagnose/Config.in
if BR2_PACKAGE_INTELCE_SDK_V36
source  package/intelce-sdk/package/intelce-sec_fw/Config.in
endif
source  package/intelce-sdk/package/intelce-smd_avcap_shim/Config.in
source  package/intelce-sdk/package/intelce-SMD_Common/Config.in
source  package/intelce-sdk/package/intelce-smd_sample_apps/Config.in
source  package/intelce-sdk/package/intelce-smd_tools/Config.in
if BR2_PACKAGE_INTELCE_SDK_V36
source  package/intelce-sdk/package/intelce-soc_audio/Config.in
endif
source  package/intelce-sdk/package/intelce-sven/Config.in
source  package/intelce-sdk/package/intelce-system_utils/Config.in
if BR2_PACKAGE_INTELCE_SDK_V36
source  package/intelce-sdk/package/intelce-thermal/Config.in
endif
source  package/intelce-sdk/package/intelce-transcoder_common/Config.in
source  package/intelce-sdk/package/intelce-transcoder_device/Config.in
source  package/intelce-sdk/package/intelce-transcoder_pipeline/Config.in
source  package/intelce-sdk/package/intelce-transcoder_server/Config.in
source  package/intelce-sdk/package/intelce-tsout/Config.in
source  package/intelce-sdk/package/intelce-viddec/Config.in
source  package/intelce-sdk/package/intelce-viddec_fw/Config.in
source  package/intelce-sdk/package/intelce-videnc/Config.in
source  package/intelce-sdk/package/intelce-video_ces/Config.in
source  package/intelce-sdk/package/intelce-vidpproc/Config.in
source  package/intelce-sdk/package/intelce-vidpproc_fw/Config.in
source  package/intelce-sdk/package/intelce-vidrend/Config.in
source  package/intelce-sdk/package/intelce-vidsink/Config.in
if BR2_PACKAGE_INTELCE_SDK_V36
source  package/intelce-sdk/package/intelce-watchdog/Config.in
endif
```

## package/intelce-sdk/package/intelce-8051_SDK/Config.in
```kconfig
config BR2_PACKAGE_INTELCE_8051_SDK
	bool "8051 SDK" 
	depends on BR2_PACKAGE_INTELCE_SDK 
```

## package/intelce-sdk/package/intelce-DirectFB_1_4/Config.in
```kconfig
config BR2_PACKAGE_INTELCE_DIRECTFB_1_4
bool "DirectFB_1_4"
default n
depends on BR2_PACKAGE_INTELCE_SDK
select BR2_PACKAGE_INTELCE_LINUX
select BR2_PACKAGE_INTELCE_OSAL
select BR2_PACKAGE_INTELCE_PAL
select BR2_PACKAGE_INTELCE_IDL
select BR2_PACKAGE_INTELCE_DISPLAY
select BR2_PACKAGE_INTELCE_SYSTEM_UTILS
select BR2_PACKAGE_INTELCE_GRAPGICS
select BR2_PACKAGE_INTELCE_PLATFORM_CONFIG
help
None
```

## package/intelce-sdk/package/intelce-SMD_Common/Config.in
```kconfig
config BR2_PACKAGE_INTELCE_SMD_COMMON
	bool "SMD_Common"
	default n
	depends on BR2_PACKAGE_INTELCE_SDK
	help
	  None
```

## package/intelce-sdk/package/intelce-alsa/Config.in
```kconfig
config BR2_PACKAGE_INTELCE_ALSA
bool "alsa"
default n
depends on BR2_PACKAGE_INTELCE_SDK
help
None
```

## package/intelce-sdk/package/intelce-alsa_shim/Config.in
```kconfig
config BR2_PACKAGE_INTELCE_ALSA_SHIM
	bool "alsa_shim"
	default n
	depends on BR2_PACKAGE_INTELCE_SDK
	select BR2_PACKAGE_INTELCE_SYSTEM_UTILS
	select BR2_PACKAGE_INTELCE_AUTO_EAS
	select BR2_PACKAGE_INTELCE_AUDIO
	select BR2_PACKAGE_INTELCE_AUTO_EAS
	select BR2_PACKAGE_INTELCE_OSAL
	select BR2_PACKAGE_INTELCE_SVEN
	select BR2_PACKAGE_INTELCE_CORE
	select BR2_PACKAGE_INTELCE_SMD_COMMON
	select BR2_PACKAGE_INTELCE_API
	select BR2_PACKAGE_ALSA_LIB
	help
	  None
```

## package/intelce-sdk/package/intelce-api/Config.in
```kconfig
config BR2_PACKAGE_INTELCE_API
	bool "api"
	default n
	depends on BR2_PACKAGE_INTELCE_SDK
	select BR2_PACKAGE_INTELCE_SMD_COMMON
	help
	  None
```

## package/intelce-sdk/package/intelce-audio/Config.in
```kconfig
config BR2_PACKAGE_INTELCE_AUDIO
bool "audio"
default n
depends on BR2_PACKAGE_INTELCE_SDK
select BR2_PACKAGE_INTELCE_PAL
select BR2_PACKAGE_INTELCE_AUTO_EAS
select BR2_PACKAGE_INTELCE_OSAL
select BR2_PACKAGE_INTELCE_COMMON
select BR2_PACKAGE_INTELCE_SMD_TOOLS
select BR2_PACKAGE_INTELCE_SVEN
select BR2_PACKAGE_INTELCE_CORE
select BR2_PACKAGE_INTELCE_SMD_COMMON
select BR2_PACKAGE_INTELCE_API
select BR2_PACKAGE_INTELCE_PLATFORM_CONFIG
select BR2_PACKAGE_INTELCE_HTUPLE
select BR2_PACKAGE_INTELCE_CLOCK
select BR2_PACKAGE_INTELCE_CLOCK_RECOVERY
select BR2_PACKAGE_INTELCE_CLOCK_CONTROL
select BR2_PACKAGE_INTELCE_DISPLAY
select BR2_PACKAGE_INTELCE_AUDIO_FW if BR2_PACKAGE_INTELCE_SDK_V21
select BR2_PACKAGE_INTELCE_AUDIO_FW_BIN if BR2_PACKAGE_INTELCE_SDK_V36
select BR2_PACKAGE_INTELCE_FW_LOAD  if BR2_PACKAGE_INTELCE_SDK_V36
select BR2_PACKAGE_INTELCE_IOSF  if BR2_PACKAGE_INTELCE_SDK_V36
select BR2_PACKAGE_INTELCE_AVCAP
select BR2_PACKAGE_INTELCE_INTEL_CE_PM
help
None
```

## package/intelce-sdk/package/intelce-audio_fw_bin/Config.in
```kconfig
config BR2_PACKAGE_INTELCE_AUDIO_FW_BIN
bool "audio_fw"
default n
depends on BR2_PACKAGE_INTELCE_SDK
help
Prebuild audio firmware binaries for CE4200
```

## package/intelce-sdk/package/intelce-avcap/Config.in
```kconfig
config BR2_PACKAGE_INTELCE_AVCAP
bool "avcap"
default n
depends on BR2_PACKAGE_INTELCE_SDK
select BR2_PACKAGE_INTELCE_OSAL
select BR2_PACKAGE_INTELCE_IDL
select BR2_PACKAGE_INTELCE_CORE
select BR2_PACKAGE_INTELCE_PLATFORM_CONFIG
select BR2_PACKAGE_INTELCE_DISPLAY
select BR2_PACKAGE_INTELCE_INTEL_CE_PM
select BR2_PACKAGE_INTELCE_SVEN
select BR2_PACKAGE_INTELCE_CLOCK_CONTROL
select BR2_PACKAGE_INTELCE_SYSTEM_UTILS
select BR2_PACKAGE_INTELCE_IOSF if BR2_PACKAGE_INTELCE_SDK_V36
help
None
```

## package/intelce-sdk/package/intelce-avcap_samples/Config.in
```kconfig
config BR2_PACKAGE_INTELCE_AVCAP_SAMPLES
	bool "avcap_samples"
	default n
	depends on BR2_PACKAGE_INTELCE_SDK
	select BR2_PACKAGE_INTELCE_AVCAP
	select BR2_PACKAGE_INTELCE_DISPLAY
	select BR2_PACKAGE_INTELCE_BUFMON
	select BR2_PACKAGE_INTELCE_COMMON
	select BR2_PACKAGE_INTELCE_VIDREND
	select BR2_PACKAGE_INTELCE_VIDPPROC
	select BR2_PACKAGE_INTELCE_VIDDEC
	select BR2_PACKAGE_INTELCE_AUDIO
	select BR2_PACKAGE_INTELCE_CORE
	select BR2_PACKAGE_INTELCE_DEMUX
	select BR2_PACKAGE_INTELCE_CLOCK
	select BR2_PACKAGE_INTELCE_CLOCK_RECOVERY
	select BR2_PACKAGE_INTELCE_SMD_TOOLS
	select BR2_PACKAGE_INTELCE_SMD_SAMPLE_APPS
	help
	  None
```

## package/intelce-sdk/package/intelce-cefdk/Config.in
```kconfig
config BR2_PACKAGE_INTELCE_CEFDK
	bool "cefdk"
	default n
	depends on BR2_PACKAGE_INTELCE_SDK
	select BR2_PACKAGE_INTELCE_FLASH_ENCRYPTION_SIGNING_TOOLS
	help
	  None
```

## package/intelce-sdk/package/intelce-clock_control/Config.in
```kconfig
config BR2_PACKAGE_INTELCE_CLOCK_CONTROL
	bool "clock_control"
	default n
	depends on BR2_PACKAGE_INTELCE_SDK
	select BR2_PACKAGE_INTELCE_SVEN
	select BR2_PACKAGE_INTELCE_IDL
	select BR2_PACKAGE_INTELCE_OSAL
	select BR2_PACKAGE_INTELCE_PAL
	select BR2_PACKAGE_INTELCE_PLATFORM_CONFIG
	help
	  None
```

## package/intelce-sdk/package/intelce-clock_recovery/Config.in
```kconfig
config BR2_PACKAGE_INTELCE_CLOCK_RECOVERY
	bool "clock_recovery"
	default n
	depends on BR2_PACKAGE_INTELCE_SDK
	select BR2_PACKAGE_INTELCE_PAL
	select BR2_PACKAGE_INTELCE_AUTO_EAS
	select BR2_PACKAGE_INTELCE_OSAL
	select BR2_PACKAGE_INTELCE_HTUPLE
	select BR2_PACKAGE_INTELCE_SMD_TOOLS
	select BR2_PACKAGE_INTELCE_SVEN
	select BR2_PACKAGE_INTELCE_CORE
	select BR2_PACKAGE_INTELCE_SMD_COMMON
	select BR2_PACKAGE_INTELCE_API
	select BR2_PACKAGE_INTELCE_PLATFORM_CONFIG
	select BR2_PACKAGE_INTELCE_CLOCK
	help
	  None
```

## package/intelce-sdk/package/intelce-common/Config.in
```kconfig
config BR2_PACKAGE_INTELCE_COMMON
	bool "common"
	default n
	depends on BR2_PACKAGE_INTELCE_SDK
	select BR2_PACKAGE_INTELCE_PAL
	select BR2_PACKAGE_INTELCE_AUTO_EAS
	select BR2_PACKAGE_INTELCE_CLOCK
	select BR2_PACKAGE_INTELCE_OSAL
	select BR2_PACKAGE_INTELCE_HTUPLE
	select BR2_PACKAGE_INTELCE_SMD_TOOLS
	select BR2_PACKAGE_INTELCE_SVEN
	select BR2_PACKAGE_INTELCE_CORE
	select BR2_PACKAGE_INTELCE_API
	select BR2_PACKAGE_INTELCE_SMD_COMMON
	help
	  None
```
