## package/igh-ethercat/Config.in
```kconfig
comment "igh-ethercat needs a Linux kernel to be built"
	depends on !BR2_LINUX_KERNEL

config BR2_PACKAGE_IGH_ETHERCAT
	bool "igh-ethercat"
	depends on BR2_LINUX_KERNEL
	help
	  IgH EtherCAT Master for Linux.

	  http://www.etherlab.org/en/ethercat/index.php

if BR2_PACKAGE_IGH_ETHERCAT

config BR2_PACKAGE_IGH_ETHERCAT_CLITOOL
	bool "Enable CLI Tool"
	depends on BR2_INSTALL_LIBSTDCPP
	help
	  Enable the EtherCAT CLI tool for testing and diagnostics.

config BR2_PACKAGE_IGH_ETHERCAT_USERLIB
	bool "Enable User Space Library"
	help
	  Install the EtherCAT user space library.

config BR2_PACKAGE_IGH_ETHERCAT_TTY
	bool "Enable TTY Driver"
	help
	  Enable the EtherCAT TTY driver for serial communication
	  support.

config BR2_PACKAGE_IGH_ETHERCAT_GENERIC
	bool "Enable Generic Driver"
	help
	  Enable the generic EtherCAT master driver.

config BR2_PACKAGE_IGH_ETHERCAT_8139TOO
	bool "8139too Driver"
	help
	  Enable Realtek 8139too-based EtherCAT driver.

config BR2_PACKAGE_IGH_ETHERCAT_E100
	bool "e100 Driver"
	help
	  Enable Intel e100-based EtherCAT driver.

config BR2_PACKAGE_IGH_ETHERCAT_E1000
	bool "e1000 Driver"
	help
	  Enable Intel e1000-based EtherCAT driver.

config BR2_PACKAGE_IGH_ETHERCAT_E1000E
	bool "e1000e Driver"
	help
	  Enable Intel e1000e-based EtherCAT driver.

config BR2_PACKAGE_IGH_ETHERCAT_GENET
	bool "genet Driver"
	help
	  Enable Broadcom GENET-based EtherCAT driver.

config BR2_PACKAGE_IGH_ETHERCAT_IGB
	bool "igb Driver"
	help
	  Enable Intel igb-based EtherCAT driver.

config BR2_PACKAGE_IGH_ETHERCAT_IGC
	bool "igc Driver"
	help
	  Enable Intel igc-based EtherCAT driver.

config BR2_PACKAGE_IGH_ETHERCAT_R8169
	bool "r8169 Driver"
	help
	  Enable Realtek r8169-based EtherCAT driver.

config BR2_PACKAGE_IGH_ETHERCAT_STMMAC_PCI
	bool "stmmac-pci Driver"
	help
	  Enable Synopsys STMMAC PCI-based EtherCAT driver.

config BR2_PACKAGE_IGH_ETHERCAT_STMMAC
	bool "stmmac Driver"
	help
	  Enable Synopsys STMMAC-based EtherCAT driver.

config BR2_PACKAGE_IGH_ETHERCAT_DWMAC_INTEL
	bool "dwmac-intel Driver"
	help
	  Enable Intel DesignWare MAC-based EtherCAT driver.

config BR2_PACKAGE_IGH_ETHERCAT_CCAT
	bool "ccat Driver"
	help
	  Enable CCAT-based EtherCAT driver.

endif
```

## package/igt-gpu-tools/Config.in
```kconfig
config BR2_PACKAGE_IGT_GPU_TOOLS
	bool "igt-gpu-tools"
	depends on BR2_USE_MMU # fork()
	depends on BR2_ENABLE_LOCALE
	depends on !BR2_STATIC_LIBS
	depends on BR2_TOOLCHAIN_HAS_THREADS_NPTL
	depends on BR2_PACKAGE_HAS_UDEV
	depends on BR2_USE_WCHAR # elfutils, procps-ng
	depends on BR2_TOOLCHAIN_HEADERS_AT_LEAST_4_11 # linux/dma-buf.h
	select BR2_PACKAGE_BUSYBOX_SHOW_OTHERS # procps-ng
	select BR2_PACKAGE_CAIRO
	select BR2_PACKAGE_CAIRO_PNG
	select BR2_PACKAGE_ELFUTILS
	select BR2_PACKAGE_KMOD
	select BR2_PACKAGE_LIBDRM
	select BR2_PACKAGE_LIBGLIB2
	select BR2_PACKAGE_LIBPCIACCESS
	select BR2_PACKAGE_PIXMAN
	select BR2_PACKAGE_PROCPS_NG
	select BR2_PACKAGE_ZLIB
	help
	  IGT GPU Tools is a collection of tools for development and
	  testing of the DRM drivers.

	  https://gitlab.freedesktop.org/drm/igt-gpu-tools

if BR2_PACKAGE_IGT_GPU_TOOLS

config BR2_PACKAGE_IGT_GPU_TOOLS_TESTS
	bool "enable tests"
	help
	  Enable IGT tests, resulting in individual executables
	  for GPU testing under /usr/libexec/igt-gpu-tools.

endif

comment "igt-gpu-tools needs udev /dev management and toolchain w/ NPTL, wchar, dynamic library, locale, headers >= 4.11"
	depends on BR2_USE_MMU
	depends on !BR2_PACKAGE_HAS_UDEV || BR2_STATIC_LIBS || \
		!BR2_TOOLCHAIN_HAS_THREADS_NPTL || !BR2_USE_WCHAR || \
		!BR2_ENABLE_LOCALE || \
		!BR2_TOOLCHAIN_HEADERS_AT_LEAST_4_11
```

## package/imagemagick/Config.in.host
```kconfig
config BR2_PACKAGE_HOST_IMAGEMAGICK
	bool "host imagemagick"
	help
	  ImageMagick(R) is a software suite to create, edit, and
	  compose bitmap images. It can read, convert and write images
	  in a variety of formats (about 100) including DPX, EXR, GIF,
	  JPEG, JPEG-2000, PDF, PhotoCD, PNG, Postscript, SVG, and TIFF.
	  Use ImageMagick to translate, flip, mirror, rotate, scale,
	  shear and transform images, adjust image colors, apply various
	  special effects, or draw text, lines, polygons, ellipses and
	  Bézier curves.

	  http://www.imagemagick.org/

if BR2_PACKAGE_HOST_IMAGEMAGICK

config BR2_PACKAGE_HOST_IMAGEMAGICK_SVG
	bool "SVG support"
	depends on BR2_PACKAGE_HOST_RUSTC_ARCH_SUPPORTS # host-librsvg
	depends on BR2_HOST_GCC_AT_LEAST_4_9 # host-pango -> host-harfbuzz
	select BR2_PACKAGE_HOST_IMAGEMAGICK_XML
	help
	  Say 'y' here is you need ImageMagick tools (like convert)
	  to support SVG.

	  This is not enabled by default, as it brings quite a few
	  extra dependencies, and thus extra build time.

comment "SVG support needs host gcc >= 4.9"
	depends on BR2_PACKAGE_HOST_RUSTC_ARCH_SUPPORTS
	depends on !BR2_HOST_GCC_AT_LEAST_4_9

config BR2_PACKAGE_HOST_IMAGEMAGICK_XML
	bool "XML support"
	help
	  Say 'y' here if you need ImageMagick to support XML. Indeed,
	  ImageMagick does not trust unvalidated XMP profiles in
	  images. If such a XML profile is encountered inside e.g. a
	  PNG image the processing is aborted. Validating the XMP
	  profile requires that ImageMagick is compiled with XML
	  support.

endif
```

## package/imx-mkimage/Config.in.host
```kconfig
config BR2_PACKAGE_HOST_IMX_MKIMAGE
	bool "host imx-mkimage"
	help
	  imx-mkimage is used to combine input images and generate
	  final boot image with appropriate IVT set.

	  https://github.com/nxp-imx/imx-mkimage
```

## package/inadyn/Config.in
```kconfig
config BR2_PACKAGE_INADYN
	bool "inadyn"
	depends on BR2_USE_MMU # Uses fork()
	depends on !BR2_STATIC_LIBS # dlopen()
	select BR2_PACKAGE_LIBCONFUSE
	help
	  In-a-Dyn is Dynamic DNS (DDNS) client with HTTPS support used
	  to automate the task of keeping your Internet name in sync
	  with your public (DHCP/PPPoE) IP address.  It can also be used
	  when you have backup connections to the Internet.

	  For HTTPS support you need to select one of the libraries:
	  OpenSSL, GnuTLS, or mbed TLS (PolarSSL).

	  https://github.com/troglobit/inadyn

comment "inadyn needs a toolchain w/ dynamic library"
	depends on BR2_STATIC_LIBS
	depends on BR2_USE_MMU
```

## package/iniparser/Config.in
```kconfig
config BR2_PACKAGE_INIPARSER
	bool "iniparser"
	help
	  iniparser is a simple C library offering ini file
	  parsing services.

	  https://gitlab.com/iniparser/iniparser
```

## package/intel-mediadriver/Config.in
```kconfig
config BR2_PACKAGE_INTEL_MEDIADRIVER
	bool "intel-mediadriver"
	depends on BR2_x86_64
	depends on !BR2_STATIC_LIBS # mesa3d, libva
	depends on BR2_INSTALL_LIBSTDCPP # mesa3d
	depends on BR2_TOOLCHAIN_HAS_SYNC_1 # mesa3d
	depends on BR2_TOOLCHAIN_HAS_THREADS # libva
	depends on BR2_TOOLCHAIN_HAS_THREADS_NPTL # mesa3d
	select BR2_PACKAGE_INTEL_GMMLIB
	select BR2_PACKAGE_LIBPCIACCESS
	select BR2_PACKAGE_LIBVA
	select BR2_PACKAGE_MESA3D
	help
	  The Intel(R) Media Driver for VAAPI is a new VA-API (Video
	  Acceleration API) user mode driver supporting hardware
	  accelerated decoding, encoding, and video post processing for
	  GEN based graphics hardware.

	  https://github.com/intel/media-driver

if BR2_PACKAGE_INTEL_MEDIADRIVER

config BR2_PACKAGE_INTEL_MEDIADRIVER_GEN8
	bool "Gen8 support"
	default y
	help
	  Enable support for Gen8 GPUs (Coffee Lake)

endif # BR2_PACKAGE_INTEL_MEDIADRIVER

comment "intel-mediadriver needs a toolchain w/ dynamic library, C++, NPTL"
	depends on BR2_x86_64 && BR2_TOOLCHAIN_HAS_SYNC_1
	depends on BR2_STATIC_LIBS || !BR2_INSTALL_LIBSTDCPP || \
		!BR2_TOOLCHAIN_HAS_THREADS_NPTL
```

## package/intel-vpl-gpu-rt/Config.in
```kconfig
config BR2_PACKAGE_INTEL_VPL_GPU_RT
	bool "intel-vpl-gpu-rt"
	depends on BR2_x86_64 # intel-mediadriver
	depends on BR2_PACKAGE_LIBVPL_ARCH_SUPPORTS # libvpl
	depends on BR2_INSTALL_LIBSTDCPP # libvpl
	depends on !BR2_STATIC_LIBS # libvpl
	depends on BR2_TOOLCHAIN_GCC_AT_LEAST_7 # libvpl
	depends on BR2_TOOLCHAIN_HAS_SYNC_1 # intel-mediadriver
	depends on BR2_TOOLCHAIN_HAS_THREADS # libvpl
	depends on BR2_TOOLCHAIN_HAS_THREADS_NPTL # intel-mediadriver
	select BR2_PACKAGE_INTEL_MEDIADRIVER # runtime
	select BR2_PACKAGE_LIBVA
	select BR2_PACKAGE_LIBVPL
	help
	  Intel® Video Processing Library (Intel® VPL) GPU Runtime is a
	  Runtime implementation of Intel® VPL API for Intel Gen GPUs,
	  starting with Tiger Lake.

	  https://github.com/intel/vpl-gpu-rt

comment "intel-vpl-gpu-rt needs a toolchain w/ dynamic library, gcc >= 7, C++, NPTL"
	depends on BR2_x86_64
	depends on BR2_PACKAGE_LIBVPL_ARCH_SUPPORTS
	depends on BR2_TOOLCHAIN_HAS_SYNC_1
	depends on BR2_STATIC_LIBS || !BR2_TOOLCHAIN_GCC_AT_LEAST_7 || \
		!BR2_INSTALL_LIBSTDCPP || !BR2_TOOLCHAIN_HAS_THREADS
```

## package/intelce-sdk/Config.in
```kconfig
source package/intelce-sdk/intelce-sdk/Config.in

if BR2_PACKAGE_INTELCE_SDK

source "package/intelce-sdk/package/intelce-loaddrivers/Config.in" 

choice
	default BR2_PACKAGE_INTELCE_SDK_V21
    bool "Intel SDK version"
	help
	  Choose the Intel SDK version.

config BR2_PACKAGE_INTELCE_SDK_V21
	bool "21.1.11182.271361"
	help
	  Choose the Intel SDK v21.

config BR2_PACKAGE_INTELCE_SDK_V36
	bool "36.0.14495.347773"
	help
	  Choose the Intel SDK v36.

endchoice
    
	menu "Intel SDK Package Selection"
	    source "package/intelce-sdk/package/Config.in"  
    endmenu
endif
```

## package/intelce-sdk/intelce-sdk/Config.in
```kconfig
config BR2_PACKAGE_INTELCE_SDK
	bool "Intel CE SDK"
	help
	  The Intel SDK build environment.
```
