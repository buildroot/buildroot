## package/gstreamer1/gst1-aamp/Config.in
```kconfig
config BR2_PACKAGE_GST1_AAMP
        bool "gst-aamp"
        select BR2_PACKAGE_AAMP
        help
          GStreamer plug-in to use AAMP DRM functionalities.
```

## package/gstreamer1/gst1-bcm/Config.in
```kconfig
menuconfig BR2_PACKAGE_GST1_BCM
	bool "gst1-bcm"
	select BR2_PACKAGE_GST1_PLUGINS_BASE
	depends on BR2_PACKAGE_BCM_REFSW || BR2_PACKAGE_ACN_SDK || BR2_PACKAGE_HOMECAST_SDK || BR2_PACKAGE_VSS_SDK
	help
	  Broadcom NEXUS GStreamer 1.x plugins

if BR2_PACKAGE_GST1_BCM

comment "Broadcom Nexus specific plugins"

config BR2_PACKAGE_GST1_BCM_VP9_SUPPORT
	bool "VP9 support"
	depends on BR2_PACKAGE_HAS_VP9_DECODER
	default n
	help
	  If this plugin supports VP9, provide VP9 via typefindelements

config BR2_PACKAGE_GST1_BCM_AUDFILTER
	bool "audfilter"
	default y
	help 
	  Add BRCM libbrcmaudiofilter.so    

config BR2_PACKAGE_GST1_BCM_AUDIODECODE
	bool "audiodecode"
	default y
	help 
	  Add BRCM libbrcmaudiodecoder.so

config BR2_PACKAGE_GST1_BCM_AUDIOSINK  
	bool "audiosink"
	default y
	help 
	  Add BRCM libbrcmaudiosink.so

config BR2_PACKAGE_GST1_BCM_VIDEODECODE
	bool "videodecode"
	default y
	help 
	  Add BRCM libbrcmvideodecoder.so
   
config BR2_PACKAGE_GST1_BCM_VIDEOSINK     
	bool "videosink"
	default y
	help 
	  Add BRCM libbrcmvideosink.so
  
config BR2_PACKAGE_GST1_BCM_VIDFILTER      
	bool "vidfilter"
	default y
	help 
	  Add BRCM libbrcmvidfilter.so

config BR2_PACKAGE_GST1_BCM_ENABLE_SVP
	bool "enable svp"
	default n
	depends on BR2_PACKAGE_BCM_REFSW_SAGE
	help 
	  Enable SVP support

endif
```

## package/gstreamer1/gst1-bluetoothaudiosink/Config.in
```kconfig
config BR2_PACKAGE_GST1_BLUETOOTHAUDIOSINK
        bool "gst1-bluetoothaudiosink"
        help
          GStreamer plug-in for playing audio through Bluetooth sink devices.
```

## package/gstreamer1/gst1-cencdecrypt/Config.in
```kconfig
config BR2_PACKAGE_GST1_CENCDECRYPT
        bool "gst1-cencdecrypt"
        help
          GStreamer plug-in to use OpenCDMI CDM decrypt functionalities.
```

## package/gstreamer1/gst1-fluendo-ismd/Config.in
```kconfig
config BR2_PACKAGE_GST1_FLUENDO_ISMD
	bool "gst-fluendo-ismd"
	depends on BR2_PACKAGE_INTELCE_SDK
	help
		This set of GStreamer elements is made for the Intel CE3100 and CE4100
		platforms. It provides video decoders, postprocessing and rendering elements
		as well as audio decoders and rendering elements. This work is based on Intel's
		existing SDK for those platforms and contains improvements made by FLUENDO S.A.

		Those elements are provided in source code form under the license described in
		the COPYING file attached to this source package. They are provided as is.

		If you need support or have questions regarding those please contact Fluendo by
		mail at support@fluendo.com.

comment "gst1-fluendo-ismd requires an Intelce SDK"
	depends on !BR2_PACKAGE_INTELCE_SDK
```

## package/gstreamer1/gst1-instruments/Config.in
```kconfig
config BR2_PACKAGE_GST1_INSTRUMENTS
	bool "gst1-instruments"
	select BR2_PACKAGE_GST1_PLUGINS_BASE
	help
	  GstInstruments
```

## package/gstreamer1/gst1-libav/Config.in
```kconfig
config BR2_PACKAGE_GST1_LIBAV
	bool "gst1-libav"
	depends on BR2_PACKAGE_FFMPEG_ARCH_SUPPORTS
	depends on BR2_TOOLCHAIN_HAS_THREADS # ffmpeg
	select BR2_PACKAGE_FFMPEG
	select BR2_PACKAGE_FFMPEG_SWSCALE
	select BR2_PACKAGE_GST1_PLUGINS_BASE
	help
	  GStreamer plugin (formerly gst-ffmpeg).

	  This package contains GStreamer plugins based on
	  the libav project.

	  The codecs, muxers, bitstreams and filters to build can be
	  selected in the ffmpeg package.

	  https://gstreamer.freedesktop.org/

comment "gst1-libav needs a toolchain w/ threads"
	depends on !BR2_TOOLCHAIN_HAS_THREADS
```

## package/gstreamer1/gst1-openwebrtc/Config.in
```kconfig
config BR2_PACKAGE_GST1_OPENWEBRTC
	bool "gst1-openwebrtc"
	select BR2_PACKAGE_GST1_PLUGINS_BASE
	select BR2_PACKAGE_LIBUSRSCTP
	help
	  GStreamer plugin for OpenWebRTC.

	  http://openwebrtc.io
```

## package/gstreamer1/gst1-plugins-dorne/Config.in
```kconfig
config BR2_PACKAGE_GST1_PLUGINS_DORNE
	bool "gst1-plugins-dorne"
	select BR2_PACKAGE_GLUELOGIC
	select BR2_PACKAGE_GLUELOGIC_QUEUEPLAYER
	select BR2_PACKAGE_GST1_COMMON
	help
	  A basic set of hardware-specific plug-ins for GStreamer.
```

## package/gstreamer1/gstd/Config.in
```kconfig
config BR2_PACKAGE_GSTD
	bool "gstd"
	depends on BR2_USE_WCHAR # libglib2 -> gettext, libsoup
	depends on BR2_TOOLCHAIN_HAS_THREADS # libglib2, libsoup
	depends on BR2_USE_MMU # libdaemon, libglib2
	select BR2_PACKAGE_GSTREAMER1_GST_DEBUG # gst_debug_bin_to_dot_data
	select BR2_PACKAGE_JANSSON
	select BR2_PACKAGE_JSON_GLIB
	select BR2_PACKAGE_LIBDAEMON
	select BR2_PACKAGE_LIBGLIB2
	select BR2_PACKAGE_LIBSOUP
	select BR2_PACKAGE_READLINE
	help
	  GStreamer Daemon, also called gstd, is a GStreamer framework
	  for controlling audio and video streaming using an
	  InterProcess Communication protocol.

	  https://developer.ridgerun.com/wiki/index.php?title=GStreamer_Daemon
```

## package/gstreamermm/Config.in
```kconfig
config BR2_PACKAGE_GSTREAMERMM
	bool "gstreamermm"
	depends on BR2_INSTALL_LIBSTDCPP
	depends on BR2_TOOLCHAIN_GCC_AT_LEAST_4_8 # C++11
	depends on BR2_USE_WCHAR              # libglib2 <- glibmm
	depends on BR2_TOOLCHAIN_HAS_THREADS  # libglib2 <- glibmm
	depends on BR2_USE_MMU                # libglib2 <- glibmm
	select BR2_PACKAGE_GSTREAMER1
	select BR2_PACKAGE_GLIBMM
	select BR2_PACKAGE_LIBSIGC
	help
	  The gstreamermm package is a set of C++ bindings for gstreamer-1.

	  https://wiki.gnome.org/Projects/gstreamermm

comment "gstreamermm needs a toolchain w/ C++, wchar, threads, gcc >= 4.8"
	depends on BR2_USE_MMU
	depends on !BR2_INSTALL_LIBSTDCPP || !BR2_TOOLCHAIN_GCC_AT_LEAST_4_8 \
		|| !BR2_USE_WCHAR || !BR2_TOOLCHAIN_HAS_THREADS
```

## package/gumbo-parser/Config.in
```kconfig
config BR2_PACKAGE_GUMBO_PARSER
	bool "gumbo-parser"
	help
	  Gumbo is an implementation of the HTML5 parsing algorithm
	  implemented as a pure C99 library with no outside
	  dependencies. It's designed to serve as a building block for
	  other tools and libraries such as linters, validators,
	  templating languages, and refactoring and analysis tools.

	  https://codeberg.org/gumbo-parser/gumbo-parser/
```

## package/gyp/Config.in
```kconfig
config BR2_PACKAGE_GYP
        bool "gyp"
	select BR2_PACKAGE_PYTHON 
	select BR2_PACKAGE_PYTHON_SETUPTOOLS 
        help
           GYP is a Meta-Build system: a build system that generates other build systems
```

## package/hawktracer/Config.in
```kconfig
config BR2_PACKAGE_HAWKTRACER
	bool "hawktracer"
	depends on BR2_INSTALL_LIBSTDCPP
	depends on BR2_TOOLCHAIN_GCC_AT_LEAST_4_8 # C++11
	help
	  HawkTracer is a highly portable, low-overhead, configurable
	  profiling tool built in Amazon Video for getting performance
	  metrics from low-end devices.

	  https://www.hawktracer.org/

if BR2_PACKAGE_HAWKTRACER

config BR2_PACKAGE_HAWKTRACER_TCP_LISTENER
	bool "TCP listener"
	default y
	depends on BR2_TOOLCHAIN_HAS_THREADS

comment "TCP listener needs a toolchain w/ threads"
	depends on !BR2_TOOLCHAIN_HAS_THREADS

endif

comment "hawktracer needs a toolchain w/ C++, gcc >= 4.8"
	depends on !BR2_INSTALL_LIBSTDCPP || !BR2_TOOLCHAIN_GCC_AT_LEAST_4_8
```

## package/hddtemp/Config.in
```kconfig
config BR2_PACKAGE_HDDTEMP
	bool "hddtemp"
	depends on BR2_USE_MMU # fork()
	depends on !BR2_STATIC_LIBS
	select BR2_PACKAGE_LIBEXECINFO if !BR2_TOOLCHAIN_USES_GLIBC
	select BR2_PACKAGE_LIBICONV if !BR2_ENABLE_LOCALE
	help
	  hddtemp is a small utility that gives you the temperature of
	  your hard drive by reading S.M.A.R.T. informations, for drives
	  that support this feature.

	  https://github.com/vitlav/hddtemp
	  http://www.guzu.net/linux/hddtemp.php

comment "hddtemp needs dynamic library"
	depends on BR2_USE_MMU
	depends on BR2_STATIC_LIBS
```

## package/heirloom-mailx/Config.in
```kconfig
config BR2_PACKAGE_HEIRLOOM_MAILX
	bool "heirloom-mailx"
	# uses fork()
	depends on BR2_USE_MMU
	depends on !BR2_STATIC_LIBS
	select BR2_PACKAGE_LIBOPENSSL_ENABLE_DES if BR2_PACKAGE_LIBOPENSSL
	select BR2_PACKAGE_LIBOPENSSL_ENABLE_RC2 if BR2_PACKAGE_LIBOPENSSL
	help
	  Heirloom mailx (previously known as nail) is a mail user
	  agent for Unix systems.

	  It can be used as a command-line mail reader, but also more
	  importantly on embedded systems, as a mail composition
	  program and SMTP client, in order to send e-mail from shell
	  scripts. It supports SMTP authentication (login, plain,
	  cram-md5), SMTPS, MIME encoding of attachments, and more.

	  http://heirloom.sourceforge.net/mailx.html

comment "heirloom-mailx needs a toolchain w/ dynamic library"
	depends on BR2_STATIC_LIBS
	depends on BR2_USE_MMU
```

## package/highway/Config.in
```kconfig
config BR2_PACKAGE_HIGHWAY
	bool "highway"
	depends on BR2_TOOLCHAIN_HAS_ATOMIC
	depends on BR2_INSTALL_LIBSTDCPP
	# For gcc bug 58969, see:
	# https://gcc.gnu.org/bugzilla/show_bug.cgi?id=58969
	depends on BR2_TOOLCHAIN_GCC_AT_LEAST_7 # C++11, GCC_BUG_58969
	help
	  Highway is a C++ library that provides portable SIMD/vector
	  intrinsics.

	  https://github.com/google/highway

if BR2_PACKAGE_HIGHWAY

config BR2_PACKAGE_HIGHWAY_CONTRIB
	bool "Enable Contrib"
	help
	  Build Highway contrib library which contains extra
	  SIMD-related utilities: an image class with aligned rows, a
	  math library (16 functions already implemented, mostly
	  trigonometry), and functions for computing dot products and
	  sorting.

config BR2_PACKAGE_HIGHWAY_EXAMPLES
	bool "Enable Examples"
	help
	  Build Highway examples

endif

comment "highway needs a toolchain w/ C++, gcc >= 7"
	depends on BR2_TOOLCHAIN_HAS_ATOMIC
	depends on !BR2_INSTALL_LIBSTDCPP || !BR2_TOOLCHAIN_GCC_AT_LEAST_7
```

## package/homecast-sdk/Config.in
```kconfig
config BR2_PACKAGE_HOMECAST_SDK
	bool "homecast-sdk"
	depends on BR2_mipsel
	select BR2_PACKAGE_HAS_NEXUS
	select BR2_PACKAGE_HAS_LIBEGL
	select BR2_PACKAGE_HAS_LIBGLES
	help
	  Pre-compiled binaries for a platform

if BR2_PACKAGE_HOMECAST_SDK

config BR2_PACKAGE_PROVIDES_NEXUS
	default "homecast-sdk"

config BR2_PACKAGE_PROVIDES_LIBEGL
	default "homecast-sdk"

config BR2_PACKAGE_PROVIDES_LIBGLES
	default "homecast-sdk"

endif
```

## package/horizon-sdk/Config.in
```kconfig
config BR2_PACKAGE_HORIZON_SDK
	bool "horizon-sdk"
	depends on BR2_i386
	select BR2_PACKAGE_HAS_LIBEGL
	select BR2_PACKAGE_HAS_LIBGLES
	help
	  Pre-compiled binaries for a platform

if BR2_PACKAGE_HORIZON_SDK

config BR2_PACKAGE_PROVIDES_LIBEGL
	default "horizon-sdk"

config BR2_PACKAGE_PROVIDES_LIBGLES
	default "horizon-sdk"

endif
```

## package/httping/Config.in
```kconfig
comment "httping needs a toolchain w/ wchar"
	depends on !BR2_USE_WCHAR

config BR2_PACKAGE_HTTPING
	bool "httping"
	depends on BR2_USE_WCHAR
	help
	  Httping is like 'ping' but for http-requests.
	  Give it an url, and it'll show you how long it takes to
	  connect, send a request and retrieve the reply (only the
	  headers).
	  Be aware that the transmission across the network also takes
	  time! So it measures the latency of the webserver + network.

	  http://www.vanheusden.com/httping/

if BR2_PACKAGE_HTTPING

config BR2_PACKAGE_HTTPING_SSL
	bool "enable SSL support"
	select BR2_PACKAGE_OPENSSL
	select BR2_PACKAGE_CA_CERTIFICATES # runtime

config BR2_PACKAGE_HTTPING_TUI
	bool "enable TUI support"
	select BR2_PACKAGE_NCURSES
	select BR2_PACKAGE_NCURSES_WCHAR
	select BR2_PACKAGE_FFTW
	select BR2_PACKAGE_FFTW_DOUBLE

endif
```

## package/hwclock-initscript/Config.in
```kconfig
config BR2_PACKAGE_HWCLOCK_INITSCRIPT
	bool "hwclock-initscript"
	depends on !BR2_PACKAGE_SYSTEMD
	depends on BR2_PACKAGE_BUSYBOX || BR2_PACKAGE_UTIL_LINUX_HWCLOCK
	help
	  Initscript to save the date and time to the hardware clock on
	  shutdown.

	  Note that the kernel already loads the time from the hwclock
	  at boot time, no init script is needed for that.
```

## package/hyperfine/Config.in
```kconfig
config BR2_PACKAGE_HYPERFINE
	bool "hyperfine"
	depends on BR2_PACKAGE_HOST_RUSTC_TARGET_ARCH_SUPPORTS
	select BR2_PACKAGE_HOST_RUSTC
	help
	  hyperfine is a benchmark tool written in Rust. It evaluates
	  execution time of a command passed in arguments and make a
	  relative comparison if multiple arguments are used at the
	  same time.

	  https://github.com/sharkdp/hyperfine
```

## package/iana-assignments/Config.in
```kconfig
config BR2_PACKAGE_IANA_ASSIGNMENTS
	bool "IANA assignments"
	select BR2_PACKAGE_IANA_ASSIGNMENTS_PEN_REG
	help
	  Mirror of the IANA registries periodically updated
	  from https://www.iana.org/protocols.

	  https://github.com/larseggert/iana-assignments

if BR2_PACKAGE_IANA_ASSIGNMENTS

config BR2_PACKAGE_IANA_ASSIGNMENTS_PEN_REG
	bool "PEN (Enterprise Numbers) registry"

endif
```

## package/icudata/Config.in
```kconfig
config BR2_PACKAGE_ICUDATA
	bool "icudata"
	depends on BR2_PACKAGE_ICU_USE_ICUDATA
```
