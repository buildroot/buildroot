## package/python-dicttoxml2/Config.in
```kconfig
config BR2_PACKAGE_PYTHON_DICTTOXML2
	bool "python-dicttoxml2"
	select BR2_PACKAGE_PYTHON3_PYEXPAT
	help
	  Converts a Python dictionary or other native data type into
	  a valid XML string.

	  https://github.com/Ousret/dicttoxml
```

## package/python-diskcache/Config.in
```kconfig
config BR2_PACKAGE_PYTHON_DISKCACHE
	bool "python-diskcache"
	select BR2_PACKAGE_PYTHON3_SQLITE # runtime
	select BR2_PACKAGE_PYTHON3_ZLIB # runtime
	help
	  Disk Cache -- Disk and file backed persistent cache.

	  http://www.grantjenks.com/docs/diskcache/
```

## package/python-distro/Config.in
```kconfig
config BR2_PACKAGE_PYTHON_DISTRO
	bool "python distro"
	help
	  distro provides information about the OS distribution it
	  runs on, such as a reliable machine-readable ID, or version
	  information.

	  It is the recommended replacement for Python's original
	  platform.linux_distribution function (removed in Python
	  3.8). It also provides much more functionality which isn't
	  necessarily Python bound, like a command-line interface.

	  https://github.com/nir0s/distro
```

## package/python-django-enumfields/Config.in
```kconfig
config BR2_PACKAGE_PYTHON_DJANGO_ENUMFIELDS
	bool "python-django-enumfields"
	help
	  Real Python Enums for Django.

	  https://github.com/hzdg/django-enumfields
```

## package/python-dnspython/Config.in
```kconfig
config BR2_PACKAGE_PYTHON_DNSPYTHON
	bool "python-dnspython"
	depends on BR2_PACKAGE_PYTHON3
	help
	  A powerful DNS toolkit for python.

	  http://www.dnspython.org
```

## package/python-docker/Config.in
```kconfig
config BR2_PACKAGE_PYTHON_DOCKER
	bool "python-docker"
	# docker-engine may be running on another host, so no other dependency
	select BR2_PACKAGE_PYTHON3_SSL # runtime
	select BR2_PACKAGE_PYTHON_REQUESTS # runtime
	select BR2_PACKAGE_PYTHON_URLLIB3 # runtime
	help
	  A Python library for the Docker Engine API.

	  https://github.com/docker/docker-py
```

## package/python-dotenv/Config.in
```kconfig
config BR2_PACKAGE_PYTHON_DOTENV
	bool "python-dotenv"
	help
	  Read key-value pairs from a .env file and set them as
	  environment variables.

	  https://github.com/theskumar/python-dotenv
```

## package/python-dpkt/Config.in
```kconfig
config BR2_PACKAGE_PYTHON_DPKT
	bool "python-dpkt"
	select BR2_PACKAGE_PYTHON3_ZLIB # runtime
	help
	  Fast, simple packet creation / parsing, with definitions
	  for the basic TCP/IP protocols.

	  https://github.com/kbandla/dpkt
```

## package/python-dtschema/Config.in
```kconfig
config BR2_PACKAGE_PYTHON_DTSCHEMA
	bool "python-dtschema"
	depends on BR2_PACKAGE_HOST_RUSTC_TARGET_ARCH_SUPPORTS # python-jsonschema -> python-rpds-py
	select BR2_PACKAGE_PYTHON_JSONSCHEMA # runtime
	select BR2_PACKAGE_PYTHON_PYLIBFDT # runtime
	select BR2_PACKAGE_PYTHON_RFC3987 # runtime
	select BR2_PACKAGE_PYTHON_RUAMEL_YAML # runtime
	help
	  DeviceTree validation schema and tools.

	  https://github.com/devicetree-org/dt-schema
```

## package/python-email-validator/Config.in
```kconfig
config BR2_PACKAGE_PYTHON_EMAIL_VALIDATOR
	bool "python-email-validator"
	select BR2_PACKAGE_PYTHON_DNSPYTHON # runtime
	select BR2_PACKAGE_PYTHON_IDNA # runtime
	help
	  A robust email address syntax and deliverability validation
	  library.

	  https://github.com/JoshData/python-email-validator
```

## package/python-emailproxy/Config.in
```kconfig
config BR2_PACKAGE_PYTHON_EMAILPROXY
	bool "python-emailproxy"
	depends on BR2_PACKAGE_HOST_RUSTC_TARGET_ARCH_SUPPORTS # python-cryptography
	select BR2_PACKAGE_PYTHON_CRYPTOGRAPHY # runtime
	select BR2_PACKAGE_PYTHON_PROMPT_TOOLKIT # runtime
	select BR2_PACKAGE_PYTHON_PYASYNCORE # runtime
	help
	  An IMAP/POP/SMTP proxy that transparently adds OAuth 2.0
	  authentication for email clients that don't support this
	  method.

	  https://github.com/simonrob/email-oauth2-proxy
```

## package/python-engineio/Config.in
```kconfig
config BR2_PACKAGE_PYTHON_ENGINEIO
	bool "python-engineio"
	select BR2_PACKAGE_PYTHON_SIMPLE_WEBSOCKET # runtime
	select BR2_PACKAGE_PYTHON3_ZLIB
	help
	  Engine.IO server.

	  http://github.com/miguelgrinberg/python-engineio/
```

## package/python-esptool/Config.in
```kconfig
config BR2_PACKAGE_PYTHON_ESPTOOL
	bool "python-esptool"
	depends on BR2_PACKAGE_HOST_RUSTC_TARGET_ARCH_SUPPORTS # python-cryptography
	select BR2_PACKAGE_PYTHON_ARGCOMPLETE # runtime
	select BR2_PACKAGE_PYTHON_BITSTRING # runtime
	select BR2_PACKAGE_PYTHON_CRYPTOGRAPHY # runtime
	select BR2_PACKAGE_PYTHON_ECDSA # runtime
	select BR2_PACKAGE_PYTHON_INTELHEX # runtime
	select BR2_PACKAGE_PYTHON_PYYAML # runtime
	select BR2_PACKAGE_PYTHON_REEDSOLO # runtime
	select BR2_PACKAGE_PYTHON_SERIAL # runtime
	select BR2_PACKAGE_PYTHON3_ZLIB
	help
	  A serial utility to communicate & flash code to Espressif
	  ESP8266 & ESP32 chips.

	  https://github.com/espressif/esptool
```

## package/python-evdev/Config.in
```kconfig
config BR2_PACKAGE_PYTHON_EVDEV
	bool "python-evdev"
	depends on BR2_TOOLCHAIN_HEADERS_AT_LEAST_4_4
	help
	  Bindings to the Linux input handling subsystem.

	  https://github.com/gvalkov/python-evdev

comment "python-evdev needs a toolchain w/ headers >= 4.4"
	depends on !BR2_TOOLCHAIN_HEADERS_AT_LEAST_4_4
```

## package/python-executing/Config.in
```kconfig
config BR2_PACKAGE_PYTHON_EXECUTING
	bool "python-executing"
	help
	  Get the currently executing AST node of a frame, and other
	  information.

	  https://github.com/alexmojaki/executing
```

## package/python-falcon/Config.in
```kconfig
config BR2_PACKAGE_PYTHON_FALCON
	bool "python-falcon"
	depends on BR2_PACKAGE_PYTHON3
	help
	  An unladen web framework for building APIs and app
	  backends.

	  https://falconframework.org
```

## package/python-farama-notifications/Config.in
```kconfig
config BR2_PACKAGE_PYTHON_FARAMA_NOTIFICATIONS
	bool "python-farama-notifications"
	help
	  Notifications for all Farama Foundation maintained
	  libraries.

	  https://github.com/Farama-Foundation/Farama-Notifications
```

## package/python-fastapi-sessions/Config.in
```kconfig
config BR2_PACKAGE_PYTHON_FASTAPI_SESSIONS
	bool "python-fastapi-sessions"
	depends on BR2_PACKAGE_HOST_RUSTC_TARGET_ARCH_SUPPORTS # python-pydantic -> python-pydantic-core
	select BR2_PACKAGE_PYTHON_FASTAPI # runtime
	select BR2_PACKAGE_PYTHON_ITSDANGEROUS # runtime
	select BR2_PACKAGE_PYTHON_PYDANTIC # runtime
	help
	  Ready-to-use session library for FastAPI.

	  https://github.com/jordanisaacs/fastapi-sessions
```

## package/python-fastapi/Config.in
```kconfig
config BR2_PACKAGE_PYTHON_FASTAPI
	bool "python-fastapi"
	depends on BR2_PACKAGE_HOST_RUSTC_TARGET_ARCH_SUPPORTS # python-pydantic -> python-pydantic-core
	select BR2_PACKAGE_PYTHON_PYDANTIC # runtime
	select BR2_PACKAGE_PYTHON_STARLETTE # runtime
	select BR2_PACKAGE_PYTHON_TYPING_EXTENSIONS # runtime
	help
	  FastAPI framework, high performance, easy to learn, fast to
	  code, ready for production.

	  https://github.com/fastapi/fastapi
```

## package/python-fastui/Config.in
```kconfig
config BR2_PACKAGE_PYTHON_FASTUI
	bool "python-fastui"
	depends on BR2_PACKAGE_HOST_RUSTC_TARGET_ARCH_SUPPORTS # python-pydantic -> python-pydantic-core
	select BR2_PACKAGE_PYTHON_EMAIL_VALIDATOR # runtime
	select BR2_PACKAGE_PYTHON_PYDANTIC # runtime
	help
	  Build better UIs faster.

	  https://github.com/pydantic/FastUI
```

## package/python-filelock/Config.in
```kconfig
config BR2_PACKAGE_PYTHON_FILELOCK
	bool "python-filelock"
	depends on BR2_PACKAGE_PYTHON3
	help
	  A platform independent file lock.

	  https://github.com/benediktschmitt/py-filelock
```

## package/python-flask-caching/Config.in
```kconfig
config BR2_PACKAGE_PYTHON_FLASK_CACHING
	bool "python-flask-caching"
	select BR2_PACKAGE_PYTHON_CACHELIB # runtime
	select BR2_PACKAGE_PYTHON_FLASK # runtime
	help
	  Adds caching support to Flask applications.

	  https://github.com/pallets-eco/flask-caching
```

## package/python-flask-expects-json/Config.in
```kconfig
config BR2_PACKAGE_PYTHON_FLASK_EXPECTS_JSON
	bool "python-flask-expects-json"
	depends on BR2_PACKAGE_HOST_RUSTC_TARGET_ARCH_SUPPORTS # python-jsonschema -> python-rpds-py
	select BR2_PACKAGE_PYTHON_FLASK # runtime
	select BR2_PACKAGE_PYTHON_JSONSCHEMA # runtime
	help
	  Decorator for REST endpoints in flask. Validate JSON request
	  data.

	  https://github.com/fischerfredl/flask-expects-json
```

## package/python-flask-jsonrpc/Config.in
```kconfig
config BR2_PACKAGE_PYTHON_FLASK_JSONRPC
	bool "python-flask-jsonrpc"
	select BR2_PACKAGE_PYTHON_FLASK # runtime
	select BR2_PACKAGE_PYTHON_TYPEGUARD # runtime
	select BR2_PACKAGE_PYTHON_TYPING_INSPECT # runtime
	help
	  A basic JSON-RPC implementation for your Flask-powered sites.

	  https://github.com/cenobites/flask-jsonrpc
```

## package/python-flask-restx/Config.in
```kconfig
config BR2_PACKAGE_PYTHON_FLASK_RESTX
	bool "python-flask-restx"
	depends on BR2_PACKAGE_HOST_RUSTC_TARGET_ARCH_SUPPORTS # python-jsonschema, python-referencing -> python-rpds-py
	select BR2_PACKAGE_PYTHON_ANISO8601 # runtime
	select BR2_PACKAGE_PYTHON_FLASK # runtime
	select BR2_PACKAGE_PYTHON_JSONSCHEMA # runtime
	select BR2_PACKAGE_PYTHON_REFERENCING # runtime
	select BR2_PACKAGE_PYTHON_WERKZEUG # runtime
	help
	  Fully featured framework for fast, easy and documented API
	  development with Flask.

	  https://github.com/python-restx/flask-restx
```
