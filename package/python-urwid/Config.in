## package/python-urwid/Config.in
```kconfig
config BR2_PACKAGE_PYTHON_URWID
	bool "python-urwid"
	select BR2_PACKAGE_PYTHON_TYPING_EXTENSIONS # runtime
	select BR2_PACKAGE_PYTHON_WCWIDTH # runtime
	help
	  Urwid is a console user interface library for Python

	  http://urwid.org/
```

## package/python-uswid/Config.in.host
```kconfig
config BR2_PACKAGE_HOST_PYTHON_USWID
	bool "host python-uswid"
	select BR2_PACKAGE_HOST_PYTHON3
	select BR2_PACKAGE_HOST_PYTHON3_XZ
	help
	  A tiny tool for embedding CoSWID tags in EFI binaries.

	  https://github.com/hughsie/python-uswid
```

## package/python-uvicorn/Config.in
```kconfig
config BR2_PACKAGE_PYTHON_UVICORN
	bool "python-uvicorn"
	select BR2_PACKAGE_PYTHON_CLICK # runtime
	select BR2_PACKAGE_PYTHON_H11 # runtime
	select BR2_PACKAGE_PYTHON3_SSL # runtime
	help
	  The lightning-fast ASGI server.

	  https://www.uvicorn.org/
```

## package/python-uvloop/Config.in
```kconfig
config BR2_PACKAGE_PYTHON_UVLOOP
	bool "python-uvloop"
	depends on BR2_TOOLCHAIN_HAS_SYNC_4 # libuv
	depends on BR2_USE_MMU # libuv
	depends on !BR2_STATIC_LIBS # libuv
	depends on BR2_TOOLCHAIN_HAS_THREADS_NPTL # libuv
	depends on BR2_TOOLCHAIN_GCC_AT_LEAST_4_9 # libuv
	select BR2_PACKAGE_LIBUV
	select BR2_PACKAGE_PYTHON3_SSL
	help
	  Fast implementation of asyncio event loop on top of libuv.

	  http://github.com/MagicStack/uvloop

comment "python-uvloop needs a toolchain w/ NPTL, dynamic library, gcc >= 4.9"
	depends on !BR2_TOOLCHAIN_HAS_THREADS_NPTL || BR2_STATIC_LIBS \
		|| !BR2_TOOLCHAIN_GCC_AT_LEAST_4_9
	depends on BR2_TOOLCHAIN_HAS_SYNC_4
	depends on BR2_USE_MMU
```

## package/python-validators/Config.in
```kconfig
config BR2_PACKAGE_PYTHON_VALIDATORS
	bool "python-validators"
	help
	  Python Data Validation for Humans.

	  https://python-validators.github.io/validators
```

## package/python-varlink/Config.in
```kconfig
config BR2_PACKAGE_PYTHON_VARLINK
	bool "python-varlink"
	help
	  Python implementation of the Varlink protocol.

	  https://github.com/varlink/python
```

## package/python-waitress/Config.in
```kconfig
config BR2_PACKAGE_PYTHON_WAITRESS
	bool "python-waitress"
	help
	  Waitress WSGI server.

	  Waitress is a production-quality pure-Python WSGI server
	  with very acceptable performance. It has no dependencies
	  except ones which live in the Python standard library.
	  It supports HTTP/1.0 and HTTP/1.1.

	  https://github.com/Pylons/waitress
```

## package/python-watchdog/Config.in
```kconfig
config BR2_PACKAGE_PYTHON_WATCHDOG
	bool "python-watchdog"
	help
	  Python API and shell utilities to monitor file system events.

	  http://github.com/gorakhargosh/watchdog
```

## package/python-weasyprint/Config.in
```kconfig
config BR2_PACKAGE_PYTHON_WEASYPRINT
	bool "python-weasyprint"
	depends on BR2_INSTALL_LIBSTDCPP # python-brotli, python-zopfli
	select BR2_PACKAGE_PYTHON_BROTLI # runtime
	select BR2_PACKAGE_PYTHON_CFFI # runtime
	select BR2_PACKAGE_PYTHON_CSSSELECT2 # runtime
	select BR2_PACKAGE_PYTHON_FONTTOOLS # runtime
	select BR2_PACKAGE_PYTHON_HTML5LIB # runtime
	select BR2_PACKAGE_PYTHON_PILLOW # runtime
	select BR2_PACKAGE_PYTHON_PYDYF # runtime
	select BR2_PACKAGE_PYTHON_PYPHEN # runtime
	select BR2_PACKAGE_PYTHON_TINYCSS2 # runtime
	select BR2_PACKAGE_PYTHON_ZOPFLI # runtime
	help
	  The Awesome Document Factory.

	  https://www.courtbouillon.org/weasyprint

comment "python-weasyprint needs a toolchain w/ C++"
	depends on !BR2_INSTALL_LIBSTDCPP
```

## package/python-web2py/Config.in
```kconfig
config BR2_PACKAGE_PYTHON_WEB2PY
	bool "python-web2py"
	select BR2_PACKAGE_PYTHON_PYDAL # runtime
	select BR2_PACKAGE_PYTHON3_ZLIB # runtime
	select BR2_PACKAGE_PYTHON3_PYEXPAT # runtime
	select BR2_PACKAGE_PYTHON3_SQLITE # runtime
	select BR2_PACKAGE_PYTHON_YATL # runtime
	help
	  web2py is a free open source full-stack framework for rapid
	  development of fast, scalable, secure and portable
	  database-driven web-based applications.

	  http://web2py.com

if BR2_PACKAGE_PYTHON_WEB2PY

config BR2_PACKAGE_PYTHON_WEB2PY_INSTALL_ADMIN
	bool "install admin panel application"
	default y
	# web2py will use pydal to generate the password (below), and that
	# uses hashlib.pbkdf2_hmac(), which is only available when python
	# is built with openssl since 3.12 (previously, there was a slow
	# pure-python fallback, dropped in 3.12).
	select BR2_PACKAGE_HOST_PYTHON3_SSL
	help
	  This option install web2py admin panel application.
	  It can be removed to save space on embedded systems.

if BR2_PACKAGE_PYTHON_WEB2PY_INSTALL_ADMIN

config BR2_PACKAGE_PYTHON_WEB2PY_PASSWORD
	string "admin panel password"
	default "web2py"
	help
	  Set the admin panel password.

endif

endif
```

## package/python-webargs/Config.in
```kconfig
config BR2_PACKAGE_PYTHON_WEBARGS
	bool "python-webargs"
	select BR2_PACKAGE_PYTHON_MARSHMALLOW # runtime
	select BR2_PACKAGE_PYTHON_PACKAGING # runtime
	help
	  Declarative parsing and validation of HTTP request objects,
	  with built-in support for popular web frameworks, including
	  Flask, Django, Bottle, Tornado, Pyramid, Falcon, and
	  aiohttp.

	  https://github.com/marshmallow-code/webargs
```

## package/python-webob/Config.in
```kconfig
config BR2_PACKAGE_PYTHON_WEBOB
	bool "python-webob"
	select BR2_PACKAGE_PYTHON_LEGACY_CGI # runtime
	select BR2_PACKAGE_PYTHON3_ZLIB # runtime
	help
	  WSGI request and response object.

	  http://webob.org/
```

## package/python-websocket-client/Config.in
```kconfig
config BR2_PACKAGE_PYTHON_WEBSOCKET_CLIENT
	bool "python-websocket-client"
	select BR2_PACKAGE_PYTHON_SIX # runtime
	select BR2_PACKAGE_PYTHON3_SSL # runtime
	help
	  WebSocket client for python. hybi13 is supported.

	  https://github.com/websocket-client/websocket-client.git
```

## package/python-werkzeug/Config.in
```kconfig
config BR2_PACKAGE_PYTHON_WERKZEUG
	bool "python-werkzeug"
	select BR2_PACKAGE_PYTHON3_ZLIB # runtime
	help
	  Werkzeug is a WSGI utility library for Python. It's widely
	  used and BSD licensed.

	  http://werkzeug.pocoo.org/
```

## package/python-whitenoise/Config.in
```kconfig
config BR2_PACKAGE_PYTHON_WHITENOISE
	bool "python-whitenoise"
	help
	  Radically simplified static file serving for WSGI
	  applications.

	  https://github.com/evansd/whitenoise
```

## package/python-whoosh/Config.in
```kconfig
config BR2_PACKAGE_PYTHON_WHOOSH
	bool "python-whoosh"
	select BR2_PACKAGE_PYTHON3_ZLIB # runtime
	help
	  Whoosh is a fast, pure-Python full text indexing, search and
	  spell checking library.

	  https://pypi.python.org/pypi/Whoosh/
```

## package/python-wsproto/Config.in
```kconfig
config BR2_PACKAGE_PYTHON_WSPROTO
	bool "python-wsproto"
	select BR2_PACKAGE_PYTHON_H11 # runtime
	help
	  WebSockets state-machine based protocol implementation.

	  https://github.com/python-hyper/wsproto/
```

## package/python-xlib/Config.in
```kconfig
config BR2_PACKAGE_PYTHON_XLIB
	bool "python-xlib"
	depends on BR2_PACKAGE_PYTHON3 # host-python-setuptools-scm
	select BR2_PACKAGE_PYTHON_SIX # runtime
	help
	  XLib in pure Python (Py2/Py3 compatible)

	  https://github.com/python-xlib/python-xlib
```

## package/python-xlrd/Config.in
```kconfig
config BR2_PACKAGE_PYTHON_XLRD
	bool "python-xlrd"
	select BR2_PACKAGE_PYTHON3_PYEXPAT
	select BR2_PACKAGE_PYTHON3_ZLIB
	help
	  Library for developers to extract data from Microsoft
	  Excel(tm) spreadsheet files.

	  http://www.python-excel.org/
```

## package/python-xlsxwriter/Config.in
```kconfig
config BR2_PACKAGE_PYTHON_XLSXWRITER
	bool "python-xlsxwriter"
	select BR2_PACKAGE_PYTHON3_ZLIB
	help
	  A Python module for creating Excel XLSX files.

	  https://github.com/jmcnamara/XlsxWriter
```

## package/python-xmljson/Config.in
```kconfig
config BR2_PACKAGE_PYTHON_XMLJSON
	bool "python-xmljson"
	help
	  Converts XML into JSON/Python dicts/arrays and vice-versa.

	  https://github.com/sanand0/xmljson
```

## package/python-yamllint/Config.in
```kconfig
config BR2_PACKAGE_PYTHON_YAMLLINT
	bool "python-yamllint"
	select BR2_PACKAGE_PYTHON_PATHSPEC # runtime
	select BR2_PACKAGE_PYTHON_PYYAML # runtime
	help
	  A linter for YAML files.

	  https://github.com/adrienverge/yamllint
```

## package/python-yarl/Config.in
```kconfig
config BR2_PACKAGE_PYTHON_YARL
	bool "python-yarl"
	select BR2_PACKAGE_PYTHON_IDNA # runtime
	select BR2_PACKAGE_PYTHON_MULTIDICT # runtime
	select BR2_PACKAGE_PYTHON_PROPCACHE # runtime
	help
	  Yet another URL library.

	  http://yarl.readthedocs.io/
```

## package/python-zeroconf/Config.in
```kconfig
config BR2_PACKAGE_PYTHON_ZEROCONF
	bool "python-zeroconf"
	select BR2_PACKAGE_PYTHON_IFADDR # runtime
	help
	  Pure Python Multicast DNS Service Discovery Library
	  (Bonjour/Avahi compatible).

	  https://github.com/jstasiak/python-zeroconf
```

## package/python-zipstream-ng/Config.in
```kconfig
config BR2_PACKAGE_PYTHON_ZIPSTREAM_NG
	bool "python-zipstream-ng"
	select BR2_PACKAGE_PYTHON3_ZSTD # runtime
	help
	  A modern and easy to use streamable zip file generator.

	  https://github.com/pR0Ps/zipstream-ng
```
