## package/optee-test/Config.in
```kconfig
config BR2_PACKAGE_OPTEE_TEST
	bool "optee-test"
	depends on BR2_TARGET_OPTEE_OS
	depends on BR2_TOOLCHAIN_HAS_THREADS # optee-client
	depends on BR2_INSTALL_LIBSTDCPP
	depends on !BR2_STATIC_LIBS # optee-client
	depends on BR2_TOOLCHAIN_HEADERS_AT_LEAST_4_3 # optee-client
	depends on BR2_USE_MMU # optee-client
	select BR2_PACKAGE_OPTEE_CLIENT
	select BR2_TARGET_OPTEE_OS_SDK
	help
	  This build option enables OP-TEE test package from the
	  OP-TEE project. It helps platforms to verify the OP-TEE
	  installation against a set of regression and performance
	  tests.

	  The package generates userspace test applications and
	  data files for the Linux userland. It also generates
	  OP-TEE trusted applications.

	  Trusted application binary files are installed in the target
	  directory /lib/optee_armtz as other trusted applications.
	  At runtime OP-TEE OS can load trusted applications from this
	  non-secure filesystem/directory into the secure world for
	  execution.

	  http://github.com/OP-TEE/optee_test

comment "optee-test needs a toolchain w/ threads, C++, dynamic library, headers >= 4.3"
	depends on BR2_TARGET_OPTEE_OS
	depends on BR2_USE_MMU
	depends on !BR2_TOOLCHAIN_HAS_THREADS || !BR2_INSTALL_LIBSTDCPP || \
		BR2_STATIC_LIBS || !BR2_TOOLCHAIN_HEADERS_AT_LEAST_4_3

if BR2_PACKAGE_OPTEE_TEST

choice
	prompt "optee-test version"
	default BR2_PACKAGE_OPTEE_TEST_AS_OS \
				if BR2_TARGET_OPTEE_OS_CUSTOM_VERSION
	default BR2_PACKAGE_OPTEE_TEST_LATEST \
				if BR2_PACKAGE_HOST_RUSTC_ARCH_SUPPORTS
	help
	  Select the version of optee-test you want to use

config BR2_PACKAGE_OPTEE_TEST_AS_OS
	bool "Same as optee-os being built"
	depends on BR2_TARGET_OPTEE_OS_CUSTOM_VERSION

config BR2_PACKAGE_OPTEE_TEST_LATEST
	bool "4.6.0"
	help
	  Use the latest release tag from the optee-test official Git
	  repository.

config BR2_PACKAGE_OPTEE_TEST_CUSTOM_TARBALL
	bool "Custom tarball"
	help
	  This option allows to specify a URL pointing to an optee-test
	  source tarball. This URL can use any protocol recognized by
	  Buildroot, like http://, ftp://, file:// or scp://.

	  When pointing to a local tarball using file://, you may want
	  to use a make variable like $(TOPDIR) to reference the root of
	  the Buildroot tree.

endchoice

if BR2_PACKAGE_OPTEE_TEST_CUSTOM_TARBALL

config BR2_PACKAGE_OPTEE_TEST_CUSTOM_TARBALL_LOCATION
	string "URL of custom optee-test tarball"

endif

config BR2_PACKAGE_OPTEE_TEST_VERSION
	string
	default BR2_TARGET_OPTEE_OS_CUSTOM_VERSION_VALUE \
				if BR2_PACKAGE_OPTEE_TEST_AS_OS
	default "4.6.0"		if BR2_PACKAGE_OPTEE_TEST_LATEST
	default "custom"	if BR2_PACKAGE_OPTEE_TEST_CUSTOM_TARBALL

endif # BR2_PACKAGE_OPTEE_TEST
```

## package/osm2pgsql/Config.in
```kconfig
config BR2_PACKAGE_OSM2PGSQL
	bool "osm2pgsql"
	depends on BR2_INSTALL_LIBSTDCPP # boost, fmt, libosmium, protozero
	depends on BR2_TOOLCHAIN_GCC_AT_LEAST_4_7 # C++11, libosmium, protozero
	depends on BR2_TOOLCHAIN_HAS_THREADS # boost, libosmium
	depends on BR2_TOOLCHAIN_SUPPORTS_ALWAYS_LOCKFREE_ATOMIC_INTS # boost-filesystem
	depends on BR2_USE_WCHAR # boost, fmt, libosmium
	depends on !BR2_TOOLCHAIN_HAS_GCC_BUG_64735 # std::future
	select BR2_PACKAGE_BOOST
	select BR2_PACKAGE_BOOST_SYSTEM
	select BR2_PACKAGE_BOOST_FILESYSTEM
	select BR2_PACKAGE_BZIP2
	select BR2_PACKAGE_EXPAT
	select BR2_PACKAGE_FMT
	select BR2_PACKAGE_LIBOSMIUM
	select BR2_PACKAGE_PROTOZERO
	select BR2_PACKAGE_ZLIB
	help
	  osm2pgsql is a tool for loading OpenStreetMap data into a
	  PostgreSQL / PostGIS database suitable for applications like
	  rendering into a map, geocoding with Nominatim,
	  or general analysis.

	  https://osm2pgsql.org

comment "osm2pgsql needs a toolchain w/ C++,  wchar, threads, gcc >= 4.7"
	depends on BR2_TOOLCHAIN_SUPPORTS_ALWAYS_LOCKFREE_ATOMIC_INTS
	depends on !BR2_INSTALL_LIBSTDCPP || !BR2_USE_WCHAR || \
		!BR2_TOOLCHAIN_GCC_AT_LEAST_4_7 || !BR2_TOOLCHAIN_HAS_THREADS

comment "osm2pgsql needs a toolchain not affected by GCC bug 64735"
	depends on BR2_TOOLCHAIN_HAS_GCC_BUG_64735
```

## package/p7zip/Config.in
```kconfig
config BR2_PACKAGE_P7ZIP
	bool "p7zip"
	depends on BR2_TOOLCHAIN_HAS_SYNC_4 # __sync_*_4 intrisics
	depends on BR2_INSTALL_LIBSTDCPP
	depends on BR2_TOOLCHAIN_HAS_THREADS
	depends on BR2_USE_WCHAR
	help
	  p7zip is a quick port of the command line version of 7-zip
	  for Unix (see http://www.7-zip.org)

	  7-Zip is a file archiver with highest compression ratio.

	  http://sourceforge.net/projects/p7zip

if BR2_PACKAGE_P7ZIP

choice
	prompt "p7zip binary"
	default BR2_PACKAGE_P7ZIP_7ZR

config BR2_PACKAGE_P7ZIP_7ZA
	bool "7za"
	help
	  Full 7za archiver. The program supports 7z, ZIP, CAB, ARJ,
	  GZIP, BZIP2, TAR, CPIO, RPM and DEB formats

config BR2_PACKAGE_P7ZIP_7ZR
	bool "7zr"
	help
	  Lightweight 7zr archiver. The program only handles 7z archives
	  and cannot handle encrypted archives

endchoice

endif

comment "p7zip needs a toolchain w/ threads, wchar, C++"
	depends on BR2_TOOLCHAIN_HAS_SYNC_4
	depends on !BR2_TOOLCHAIN_HAS_THREADS || !BR2_USE_WCHAR || !BR2_INSTALL_LIBSTDCPP
```

## package/pahole/Config.in.host
```kconfig
config BR2_PACKAGE_HOST_PAHOLE
	bool "host pahole"
	help
	  Pahole and other DWARF utils.

	  https://git.kernel.org/pub/scm/devel/pahole/pahole.git
```

## package/panel-mipi-dbi-firmware/Config.in
```kconfig
config BR2_PACKAGE_PANEL_MIPI_DBI_FIRMWARE
	bool "panel-mipi-dbi firmware"
	help
	  Build and install firmware files for the panel-mipi-dbi DRM
	  driver. The driver requires firmware file(s) to provide
	  initialization commands for the specific display(s) in
	  use. The initialization commands are written in text form
	  and converted to the binary format during the build.

	  If you select this package you will be prompted for the
	  initialization command file(s) to build firmware from.

	  https://github.com/notro/panel-mipi-dbi

if BR2_PACKAGE_PANEL_MIPI_DBI_FIRMWARE

config BR2_PACKAGE_PANEL_MIPI_DBI_FIRMWARE_SOURCE
	string "Source files for panel-mipi-dbi firmware"
	default ""
	help
	  Space separated list of initialization command files for
	  displays used with the panel-mipi-dbi driver. The files will
	  be converted to binary format and installed to /lib/firmware
	  in the rootfs. The binary files will use the basenames of
	  the input files, plus a .bin ending. The basename of each
	  file must match the first element of the "compatible" device
	  tree property of the display the file is for.

endif # BR2_PACKAGE_PANEL_MIPI_DBI_FIRMWARE
```

## package/pangomm2_46/Config.in
```kconfig
config BR2_PACKAGE_PANGOMM2_46
	bool "pangomm (2.46.x)"
	depends on BR2_TOOLCHAIN_HAS_SYNC_4 # pango -> harfbuzz
	depends on BR2_INSTALL_LIBSTDCPP # glibmm/pango
	depends on BR2_TOOLCHAIN_GCC_AT_LEAST_4_9 # C++11
	depends on BR2_TOOLCHAIN_HAS_THREADS # *mm/pango -> libglib2
	depends on BR2_USE_MMU # *mm/pango -> libglib2
	depends on BR2_USE_WCHAR # *mm/pango -> libglib2
	select BR2_PACKAGE_CAIROMM1_14
	select BR2_PACKAGE_GLIBMM2_66
	select BR2_PACKAGE_PANGO
	select BR2_PACKAGE_LIBSIGC2
	help
	  The pangomm package is a set of C++ bindings for Pango.

	  This is the last version before the API and ABI change
	  introduced in 2.48.0 which requires C++17.

	  http://www.gtkmm.org/

comment "pangomm (2.46.x) needs a toolchain w/ C++, wchar, threads, gcc >= 4.9"
	depends on BR2_USE_MMU
	depends on BR2_TOOLCHAIN_HAS_SYNC_4
	depends on !BR2_TOOLCHAIN_GCC_AT_LEAST_4_9 || !BR2_USE_WCHAR \
		|| !BR2_INSTALL_LIBSTDCPP || !BR2_TOOLCHAIN_HAS_THREADS
```

## package/parodus/Config.in
```kconfig
config BR2_PACKAGE_PARODUS
    bool "parodus"
    default n
    select BR2_PACKAGE_NOPOLL
    select BR2_PACKAGE_NANOMSG
    select BR2_PACKAGE_MSGPACK_C
    select BR2_PACKAGE_UCRESOLV
    select BR2_PACKAGE_TROWER_BASE64
    select BR2_PACKAGE_CIMPLOG
    select BR2_PACKAGE_WRP_C
    select BR2_PACKAGE_WDMP_C
    select BR2_PACKAGE_CJSON
    select BR2_PACKAGE_CJWT
    select BR2_PACKAGE_LIBCURL
    help
       parodus client library

if BR2_PACKAGE_PARODUS
config BR2_PACKAGE_PARODUS_SERVICE_APP
    bool "Create Parodus Service App"
    default n
    help
       This option allows to create parodus service app,
       default is parodus service library
endif
```

## package/parodus2ccsp/Config.in
```kconfig
config BR2_PACKAGE_PARODUS2CCSP
    bool "parodus2ccsp"
    select BR2_PACKAGE_LIBPARODUS
    select BR2_PACKAGE_CCSPCOMMONLIBRARY
    select BR2_PACKAGE_CCSPCR
    select BR2_PACKAGE_UTOPIA
    default n
    help
       parodus to ccsp library

if BR2_PACKAGE_PARODUS2CCSP
config BR2_PACKAGE_PARODUS2CCSP_APP
    bool "Create Parodus to CCSP App"
    default n
    help
       This option allows to create parodus2ccsp app,
       default is parodus2ccp library
endif
```

## package/parsec-tool/Config.in
```kconfig
config BR2_PACKAGE_PARSEC_TOOL
	bool "parsec-tool"
	depends on BR2_PACKAGE_HOST_RUSTC_TARGET_ARCH_SUPPORTS
	select BR2_PACKAGE_HOST_RUSTC
	help
	  The Parsec Command Line Interface
	  This tool can be used to communicate with the PARSEC service.

	  https://github.com/parallaxsecond/parsec-tool.git
```
