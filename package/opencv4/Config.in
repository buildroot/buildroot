## package/openssl/Config.in
```kconfig
config BR2_PACKAGE_LIBRESSL_ARCH_SUPPORTS
	bool
	# see include/CMakeLists.txt
	default y if BR2_aarch64 || BR2_aarch64_be
	default y if BR2_arm || BR2_armeb
	default y if BR2_i386 || BR2_x86_64
	default y if BR2_mips || BR2_mipsel || BR2_mips64 || BR2_mips64el
	default y if BR2_powerpc || BR2_powerpc64 || BR2_powerpc64le
	default y if BR2_RISCV_64
	default y if BR2_sparc64

config BR2_PACKAGE_OPENSSL_FORCE_LIBOPENSSL
	bool

config BR2_PACKAGE_OPENSSL
	bool "openssl support"
	select BR2_PACKAGE_HAS_OPENSSL
	help
	  Select the desired ssl library provider.

if BR2_PACKAGE_OPENSSL

choice
	prompt "ssl library"
	help
	  Select OpenSSL or LibreSSL.

config BR2_PACKAGE_LIBOPENSSL
	bool "openssl"
	select BR2_PACKAGE_ZLIB
	help
	  A collaborative effort to develop a robust, commercial-grade,
	  fully featured, and Open Source toolkit implementing the
	  Secure Sockets Layer (SSL v2/v3) and Transport Security
	  (TLS v1) as well as a full-strength general-purpose
	  cryptography library.

	  https://openssl-library.org/

	  Note: Some helper scripts need perl.

source "package/libopenssl/Config.in"

config BR2_PACKAGE_LIBRESSL
	bool "libressl"
	depends on BR2_PACKAGE_LIBRESSL_ARCH_SUPPORTS
	depends on !BR2_PACKAGE_OPENSSL_FORCE_LIBOPENSSL
	depends on BR2_TOOLCHAIN_HAS_THREADS
	# uClibc doesn't provide __register_atfork() without NPTL
	depends on !BR2_TOOLCHAIN_USES_UCLIBC || BR2_TOOLCHAIN_HAS_THREADS_NPTL
	help
	  LibreSSL is a version of the TLS/crypto stack forked from
	  OpenSSL in 2014, with goals of modernizing the codebase,
	  improving security, and applying best practice development
	  processes.

	  http://www.libressl.org/

source "package/libressl/Config.in"

# openssl from br2-external trees, if any
source "$BR2_BASE_DIR/.br2-external.in.openssl"

endchoice

config BR2_PACKAGE_HAS_OPENSSL
	bool

config BR2_PACKAGE_PROVIDES_OPENSSL
	string
	default "libopenssl" if BR2_PACKAGE_LIBOPENSSL
	default "libressl" if BR2_PACKAGE_LIBRESSL

endif

# ensure libopenssl is used for the host variant
config BR2_PACKAGE_PROVIDES_HOST_OPENSSL
	string
	default "host-libopenssl"
```

## package/openswan/Config.in
```kconfig
config BR2_PACKAGE_OPENSWAN
	bool "openswan"
	depends on BR2_USE_MMU # iproute2
	depends on BR2_TOOLCHAIN_HEADERS_AT_LEAST_3_4 # iproute2
	select BR2_PACKAGE_GMP
	select BR2_PACKAGE_IPROUTE2
	select BR2_PACKAGE_LIBXCRYPT if BR2_TOOLCHAIN_USES_GLIBC
	help
	  Openswan is an implementation of IPsec for Linux

	  http://www.openswan.org

comment "openswan needs a toolchain w/ headers >= 3.4"
	depends on BR2_USE_MMU
	depends on !BR2_TOOLCHAIN_HEADERS_AT_LEAST_3_4
```

## package/openvmtools/Config.in
```kconfig
config BR2_PACKAGE_OPENVMTOOLS_ARCH_SUPPORTS
	bool
	default y if BR2_i386
	default y if BR2_x86_64
	default y if BR2_aarch64

config BR2_PACKAGE_OPENVMTOOLS
	bool "openvmtools"
	depends on BR2_PACKAGE_OPENVMTOOLS_ARCH_SUPPORTS
	depends on BR2_USE_MMU # libglib2
	depends on BR2_USE_WCHAR # libglib2
	depends on BR2_TOOLCHAIN_HAS_THREADS # libglib2
	depends on BR2_ENABLE_LOCALE
	depends on !BR2_STATIC_LIBS
	depends on !BR2_TOOLCHAIN_USES_UCLIBC
	select BR2_PACKAGE_LIBGLIB2
	select BR2_PACKAGE_LIBDNET
	select BR2_PACKAGE_LIBTIRPC if !BR2_TOOLCHAIN_HAS_NATIVE_RPC
	help
	  Open Virtual Machine Tools for VMware guest OS

	  https://github.com/vmware/open-vm-tools

	  ICU locales, Xerces, and X11 tools are currently not
	  supported.

	  NOTE: Support for vmblock-fuse will be enabled in
	  openvmtools if the libfuse package is selected.

if BR2_PACKAGE_OPENVMTOOLS

config BR2_PACKAGE_OPENVMTOOLS_PAM
	bool "PAM support"
	# linux-pam needs locale, dynamic library and wchar, but we
	# already have these dependencies on the main symbol, above.
	depends on BR2_TOOLCHAIN_GCC_AT_LEAST_4_9 # linux-pam
	select BR2_PACKAGE_LINUX_PAM
	help
	  Support for PAM in openvmtools

comment "PAM support needs a toolchain w/ gcc >= 4.9"
	depends on !BR2_TOOLCHAIN_GCC_AT_LEAST_4_9

config BR2_PACKAGE_OPENVMTOOLS_RESOLUTIONKMS
	bool "resolutionkms support"
	depends on BR2_PACKAGE_HAS_UDEV
	depends on BR2_TOOLCHAIN_HAS_THREADS # libdrm
	depends on BR2_i386 || BR2_x86_64 # libdrm vmwgfx
	select BR2_PACKAGE_LIBDRM
	select BR2_PACKAGE_LIBDRM_VMWGFX
	help
	  Enable support for resolutionkms

comment "resolutionkms needs udev, a toolchain w/ threads"
	depends on BR2_i386 || BR2_x86_64
	depends on !BR2_PACKAGE_HAS_UDEV || !BR2_TOOLCHAIN_HAS_THREADS

endif

comment "openvmtools needs a glibc or musl toolchain w/ wchar, threads, locale, dynamic library"
	depends on BR2_PACKAGE_OPENVMTOOLS_ARCH_SUPPORTS
	depends on BR2_USE_MMU
	depends on !BR2_USE_WCHAR || !BR2_TOOLCHAIN_HAS_THREADS || \
		!BR2_ENABLE_LOCALE || BR2_STATIC_LIBS || \
		BR2_TOOLCHAIN_USES_UCLIBC
```

## package/openwebrtc/Config.in
```kconfig
config BR2_PACKAGE_OPENWEBRTC
	bool "openwebrtc"
	select BR2_PACKAGE_LIBNICE
	select BR2_PACKAGE_PULSEAUDIO
	select BR2_PACKAGE_GST1_OPENWEBRTC
	help
	  A flexible cross-platform WebRTC client framework based on GStreamer.

	  OpenWebRTC is built on the belief that the WebRTC standard would
	  transcend the pure browser environment and that native apps,
	  implementing the same protocols and API's, would become an important
	  part of the WebRTC ecosystem. This is especially true on mobile
	  platforms where native app distribution is often preferred over pure
	  web apps. Native OpenWebRTC apps can either talk to other native apps
	  or browsers that support WebRTC. OpenWebRTC can also provide the
	  WebRTC-backend to web browsers.

	  Having independent, interoperable, implementations is important for
	  the health of any standard, and WebRTC is no exception. The ambition
	  of OpenWebRTC is to follow the WebRTC standard closely as it continues
	  to evolve.

	  http://www.openwebrtc.io/
```

## package/opkg-utils/Config.in
```kconfig
config BR2_PACKAGE_OPKG_UTILS
	bool "opkg-utils"
	depends on BR2_PACKAGE_BUSYBOX # binutils
	depends on BR2_USE_MMU # bash, python3
	depends on BR2_USE_WCHAR # python3
	depends on BR2_TOOLCHAIN_HAS_THREADS # python3 <- libffi
	depends on !BR2_STATIC_LIBS # python3
	select BR2_PACKAGE_BINUTILS if !BR2_PACKAGE_BUSYBOX # runtime
	select BR2_PACKAGE_BINUTILS_TARGET if !BR2_PACKAGE_BUSYBOX # runtime
	select BR2_PACKAGE_COREUTILS if !BR2_PACKAGE_BUSYBOX # runtime
	select BR2_PACKAGE_DIFFUTILS if !BR2_PACKAGE_BUSYBOX # runtime
	select BR2_PACKAGE_FINDUTILS if !BR2_PACKAGE_BUSYBOX # runtime
	select BR2_PACKAGE_GREP if !BR2_PACKAGE_BUSYBOX # runtime
	select BR2_PACKAGE_GZIP if !BR2_PACKAGE_BUSYBOX # runtime
	select BR2_PACKAGE_SED if !BR2_PACKAGE_BUSYBOX # runtime
	select BR2_PACKAGE_TAR if !BR2_PACKAGE_BUSYBOX # runtime
	select BR2_PACKAGE_BUSYBOX_SHOW_OTHERS # bash
	select BR2_PACKAGE_BASH # runtime
	select BR2_PACKAGE_PYTHON3 # runtime
	help
	  Helper scripts for use with the opkg package manager.

	  https://git.yoctoproject.org/cgit/cgit.cgi/opkg-utils/

comment "opkg-utils needs a toolchain w/ wchar, threads, dynamic library"
	depends on BR2_PACKAGE_BUSYBOX
	depends on BR2_USE_MMU
	depends on !BR2_USE_WCHAR || !BR2_TOOLCHAIN_HAS_THREADS || BR2_STATIC_LIBS
```

## package/optee-benchmark/Config.in
```kconfig
config BR2_PACKAGE_OPTEE_BENCHMARK
	bool "optee-benchmark"
	depends on BR2_USE_MMU # fork()
	depends on BR2_TOOLCHAIN_HAS_THREADS # optee-client
	depends on !BR2_STATIC_LIBS # optee-client
	depends on BR2_TOOLCHAIN_HEADERS_AT_LEAST_4_3 # optee-client
	select BR2_PACKAGE_OPTEE_CLIENT
	select BR2_PACKAGE_LIBYAML
	help
	  Enable the OP-TEE benchmark package that brings facilities
	  for profiling traversal and execution timings when
	  invoking OP-TEE. OP-TEE benchmark is a component delivered
	  by the OP-TEE project.

	  http://github.com/linaro-swg/optee_benchmark

comment "optee-benchmark needs a toolchain w/ threads, dynamic library, headers >= 4.3"
	depends on BR2_USE_MMU
	depends on !BR2_TOOLCHAIN_HAS_THREADS || BR2_STATIC_LIBS || \
		!BR2_TOOLCHAIN_HEADERS_AT_LEAST_4_3
```

## package/optee-client/Config.in
```kconfig
config BR2_PACKAGE_OPTEE_CLIENT
	bool "optee-client"
	depends on BR2_TOOLCHAIN_HAS_THREADS
	depends on BR2_TOOLCHAIN_HEADERS_AT_LEAST_4_3 # MMC_IOC_MULTI_CMD
	depends on BR2_USE_MMU # fork()
	help
	  Enable the OP-TEE client package that brings non-secure
	  client application resources for OP-TEE support. OP-TEE
	  client is a component delivered by the OP-TEE project.

	  The client API library allows application to invoke trusted
	  applications hosted in the OP-TEE OS secure world.  The
	  supplicant provides services hosted by the non-secure world
	  and invoked by the secure world.

	  https://github.com/OP-TEE/optee_client

if BR2_PACKAGE_OPTEE_CLIENT

choice
	prompt "optee-client version"
	default BR2_PACKAGE_OPTEE_CLIENT_AS_OS \
				if BR2_TARGET_OPTEE_OS_CUSTOM_VERSION
	default BR2_PACKAGE_OPTEE_CLIENT_LATEST
	help
	  Select the version of optee-client you want to use

config BR2_PACKAGE_OPTEE_CLIENT_AS_OS
	bool "Same as optee-os being built"
	depends on BR2_TARGET_OPTEE_OS_CUSTOM_VERSION

config BR2_PACKAGE_OPTEE_CLIENT_LATEST
	bool "4.6.0"
	help
	  Use the latest release tag from the optee-client official Git
	  repository.

config BR2_PACKAGE_OPTEE_CLIENT_CUSTOM_TARBALL
	bool "Custom tarball"
	help
	  This option allows to specify a URL pointing to an
	  optee-client source tarball. This URL can use any protocol
	  recognized by Buildroot, like http://, ftp://, file://
	  or scp://.

	  When pointing to a local tarball using file://, you may want
	  to use a make variable like $(TOPDIR) to reference the root of
	  the Buildroot tree.

endchoice

if BR2_PACKAGE_OPTEE_CLIENT_CUSTOM_TARBALL

config BR2_PACKAGE_OPTEE_CLIENT_CUSTOM_TARBALL_LOCATION
	string "URL of custom optee-client tarball"

endif

config BR2_PACKAGE_OPTEE_CLIENT_VERSION
	string
	default BR2_TARGET_OPTEE_OS_CUSTOM_VERSION_VALUE \
				if BR2_PACKAGE_OPTEE_CLIENT_AS_OS
	default "4.6.0"		if BR2_PACKAGE_OPTEE_CLIENT_LATEST
	default "custom"	if BR2_PACKAGE_OPTEE_CLIENT_CUSTOM_TARBALL

config BR2_PACKAGE_OPTEE_CLIENT_TEE_FS_PATH
	string "Path for normal world OS secure storage"
	default "/data/tee"
	help
	  Path to storage area for secure storage based on the
	  normal world OS providing the actual storage via
	  tee-supplicant.

config BR2_PACKAGE_OPTEE_CLIENT_RPMB_EMU
	bool "Enable RPMB emulation"
	default y
	help
	  Enable RPMB device emulation in tee-supplicant.

config BR2_PACKAGE_OPTEE_CLIENT_SUPP_PLUGINS
	bool "Enable TEE supplicant plugins"
	default y
	depends on !BR2_STATIC_LIBS # dlfcn.h
	help
	  Enable TEE supplicant plugin support.

config BR2_PACKAGE_OPTEE_CLIENT_TEEACL
	bool "Enable TEE Access Control List login"
	select BR2_PACKAGE_UTIL_LINUX
	select BR2_PACKAGE_UTIL_LINUX_LIBUUID
	help
	  Enable TEE ACL login identification for OP-TEE service that
	  supports them as OP-TEE PKCS#11 services.

endif

comment "optee-client needs a toolchain w/ threads, headers >= 4.3"
	depends on BR2_USE_MMU
	depends on !BR2_TOOLCHAIN_HAS_THREADS || \
		!BR2_TOOLCHAIN_HEADERS_AT_LEAST_4_3
```

## package/optee-examples/Config.in
```kconfig
config BR2_PACKAGE_OPTEE_EXAMPLES
	bool "optee-examples"
	depends on BR2_TARGET_OPTEE_OS
	depends on BR2_TOOLCHAIN_HAS_THREADS # optee-client
	depends on !BR2_STATIC_LIBS # optee-client
	depends on BR2_TOOLCHAIN_HEADERS_AT_LEAST_4_3 # optee-client
	depends on BR2_USE_MMU # optee-client
	select BR2_PACKAGE_OPTEE_CLIENT
	select BR2_TARGET_OPTEE_OS_SDK
	help
	  Enable the OP-TEE examples package that brings examples of
	  implementation of OP-TEE non-secure client applications and
	  secure trusted applications. OP-TEE examples is a
	  component delivered by the OP-TEE project.

	  Trusted application binary files are installed in the target
	  directory /lib/optee_armtz as other trusted applications.
	  At runtime OP-TEE OS can load trusted applications from this
	  non-secure filesystem/directory into the secure world for
	  execution.

	  https://github.com/linaro-swg/optee_examples

comment "optee-examples needs a toolchain w/ threads, dynamic library, headers >= 4.3"
	depends on BR2_TARGET_OPTEE_OS
	depends on BR2_USE_MMU
	depends on !BR2_TOOLCHAIN_HAS_THREADS || BR2_STATIC_LIBS || \
		!BR2_TOOLCHAIN_HEADERS_AT_LEAST_4_3

if BR2_PACKAGE_OPTEE_EXAMPLES

choice
	prompt "optee-examples version"
	default BR2_PACKAGE_OPTEE_EXAMPLES_AS_OS \
				if BR2_TARGET_OPTEE_OS_CUSTOM_VERSION
	default BR2_PACKAGE_OPTEE_EXAMPLES_LATEST
	help
	  Select the version of optee-examples you want to use

config BR2_PACKAGE_OPTEE_EXAMPLES_AS_OS
	bool "Same as optee-os being built"
	depends on BR2_TARGET_OPTEE_OS_CUSTOM_VERSION

config BR2_PACKAGE_OPTEE_EXAMPLES_LATEST
	bool "4.6.0"
	help
	  Use the latest release tag from the optee-examples official
	  Git repository.

config BR2_PACKAGE_OPTEE_EXAMPLES_CUSTOM_TARBALL
	bool "Custom tarball"
	help
	  This option allows to specify a URL pointing to an
	  optee-examples source tarball. This URL can use any protocol
	  recognized by Buildroot, like http://, ftp://, file:// or
	  scp://.

	  When pointing to a local tarball using file://, you may want
	  to use a make variable like $(TOPDIR) to reference the root of
	  the Buildroot tree.

endchoice

if BR2_PACKAGE_OPTEE_EXAMPLES_CUSTOM_TARBALL

config BR2_PACKAGE_OPTEE_EXAMPLES_CUSTOM_TARBALL_LOCATION
	string "URL of custom optee-examples tarball"

endif

config BR2_PACKAGE_OPTEE_EXAMPLES_VERSION
	string
	default BR2_TARGET_OPTEE_OS_CUSTOM_VERSION_VALUE \
				if BR2_PACKAGE_OPTEE_EXAMPLES_AS_OS
	default "4.6.0"		if BR2_PACKAGE_OPTEE_EXAMPLES_LATEST
	default "custom"	if BR2_PACKAGE_OPTEE_EXAMPLES_CUSTOM_TARBALL

endif # BR2_PACKAGE_OPTEE_EXAMPLES
```
