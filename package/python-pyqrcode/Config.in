## package/python-pyqrcode/Config.in
```kconfig
config BR2_PACKAGE_PYTHON_PYQRCODE
	bool "python-pyqrcode"
	select BR2_PACKAGE_PYTHON3_PYEXPAT # runtime
	select BR2_PACKAGE_PYTHON3_CODECSCJK # runtime
	help
	  A QR code generator written purely in Python with SVG, EPS,
	  PNG and terminal output.

	  https://github.com/mnooner256/pyqrcode
```

## package/python-pyqt5-sip/Config.in
```kconfig
config BR2_PACKAGE_PYTHON_PYQT5_SIP
	bool "python-pyqt5-sip"
	help
	  This is the PyQt5.sip module which is needed at runtime for
	  the PyQt5 module from package python-pyqt5.

	  https://pypi.org/project/PyQt5-sip/
```

## package/python-pyroute2/Config.in
```kconfig
config BR2_PACKAGE_PYTHON_PYROUTE2
	bool "python-pyroute2"
	select BR2_PACKAGE_PYTHON3_SQLITE
	select BR2_PACKAGE_PYTHON3_SSL # runtime
	help
	  Python netlink library - Linux network / netns / wireless /
	  ipset configuration.

	  https://github.com/svinota/pyroute2
```

## package/python-pyrsistent/Config.in
```kconfig
config BR2_PACKAGE_PYTHON_PYRSISTENT
	bool "python-pyrsistent"
	help
	  Persistent/Functional/Immutable data structures.

	  http://github.com/tobgu/pyrsistent/
```

## package/python-pysensors/Config.in
```kconfig
config BR2_PACKAGE_PYTHON_PYSENSORS
	bool "python-pysensors"
	select BR2_PACKAGE_LM_SENSORS # runtime
	help
	  Python bindings for libsensors.so from the lm-sensors project
	  via ctypes. Supports API version 4, i.e. libsensors version
	  3.x.

	  https://pypi.org/project/PySensors
```

## package/python-pysftp/Config.in
```kconfig
config BR2_PACKAGE_PYTHON_PYSFTP
	bool "python-pysftp"
	depends on BR2_PACKAGE_HOST_RUSTC_TARGET_ARCH_SUPPORTS # python-paramiko -> python-cryptography
	select BR2_PACKAGE_PYTHON_PARAMIKO # runtime
	help
	  A friendly face on SFTP.

	  https://bitbucket.org/dundeemt/pysftp
```

## package/python-pysmi/Config.in
```kconfig
config BR2_PACKAGE_PYTHON_PYSMI
	bool "python-pysmi"
	select BR2_PACKAGE_PYTHON_JINJA2 # runtime
	select BR2_PACKAGE_PYTHON_PLY # runtime
	select BR2_PACKAGE_PYTHON_REQUESTS # runtime
	help
	  SNMP SMI/MIB Parser.

	  https://github.com/etingof/pysmi
```

## package/python-pysnmp/Config.in
```kconfig
config BR2_PACKAGE_PYTHON_PYSNMP
	bool "python-pysnmp"
	select BR2_PACKAGE_PYTHON_PYASN1 # runtime
	help
	  PySNMP is a cross-platform, pure-Python SNMP engine
	  implementation.

	  http://pysnmp.sf.net
```

## package/python-pysnmpcrypto/Config.in
```kconfig
config BR2_PACKAGE_PYTHON_PYSNMPCRYPTO
	bool "python-pysnmpcrypto"
	depends on BR2_PACKAGE_HOST_RUSTC_TARGET_ARCH_SUPPORTS # python-cryptography
	select BR2_PACKAGE_PYTHON_CRYPTOGRAPHY # runtime
	help
	  Strong cryptography support for PySNMP (SNMP library for
	  Python).

	  https://github.com/lextudio/pysnmpcrypto
```

## package/python-pyspnego/Config.in
```kconfig
config BR2_PACKAGE_PYTHON_PYSPNEGO
	bool "python-pyspnego"
	depends on BR2_PACKAGE_HOST_RUSTC_TARGET_ARCH_SUPPORTS # python-cryptography
	select BR2_PACKAGE_PYTHON_CRYPTOGRAPHY # runtime
	help
	  Windows Negotiate Authentication Client and Server.

	  https://github.com/jborean93/pyspnego
```

## package/python-pytablewriter/Config.in
```kconfig
config BR2_PACKAGE_PYTHON_PYTABLEWRITER
	bool "python-pytablewriter"
	select BR2_PACKAGE_PYTHON_DATAPROPERTY # runtime
	select BR2_PACKAGE_PYTHON_MBSTRDECODER # runtime
	select BR2_PACKAGE_PYTHON_PATHVALIDATE # runtime
	select BR2_PACKAGE_PYTHON_TABLEDATA # runtime
	select BR2_PACKAGE_PYTHON_TCOLORPY # runtime
	select BR2_PACKAGE_PYTHON_TYPEPY # runtime
	help
	  pytablewriter is a Python library to write a table in
	  various formats: AsciiDoc / CSV / Elasticsearch / HTML /
	  JavaScript / JSON / LaTeX / LDJSON / LTSV / Markdown /
	  MediaWiki / NumPy / Excel / Pandas / Python /
	  reStructuredText / SQLite / TOML / TSV / YAML.

	  https://github.com/thombashi/pytablewriter
```

## package/python-pytest-asyncio/Config.in
```kconfig
config BR2_PACKAGE_PYTHON_PYTEST_ASYNCIO
	bool "python-pytest-asyncio"
	select BR2_PACKAGE_PYTHON_PYTEST # runtime
	help
	  Pytest support for asyncio.

	  https://github.com/pytest-dev/pytest-asyncio
```

## package/python-pytest/Config.in
```kconfig
config BR2_PACKAGE_PYTHON_PYTEST
	bool "python-pytest"
	select BR2_PACKAGE_PYTHON_INICONFIG # runtime
	select BR2_PACKAGE_PYTHON_PACKAGING # runtime
	select BR2_PACKAGE_PYTHON_PLUGGY # runtime
	select BR2_PACKAGE_PYTHON3_PYEXPAT # runtime
	select BR2_PACKAGE_PYTHON3_ZLIB # runtime
	help
	  pytest is a framework that makes building simple and scalable
	  tests easy. Tests are expressive and readable—no boilerplate
	  code required.

	  https://docs.pytest.org/en/latest/
```

## package/python-pytrie/Config.in
```kconfig
config BR2_PACKAGE_PYTHON_PYTRIE
	bool "python-pytrie"
	depends on BR2_PACKAGE_PYTHON3
	select BR2_PACKAGE_PYTHON_SORTEDCONTAINERS # runtime
	help
	  A pure Python implementation of the trie data structure.

	  https://pypi.python.org/pypi/PyTrie
```

## package/python-pyyaml/Config.in
```kconfig
config BR2_PACKAGE_PYTHON_PYYAML
	bool "python-pyyaml"
	depends on BR2_PACKAGE_PYTHON3
	select BR2_PACKAGE_LIBYAML
	help
	  The PyYAML package contains binding to the libyaml API.

	  http://pyyaml.org/
```

## package/python-pyyaml/Config.in.host
```kconfig
config BR2_PACKAGE_HOST_PYTHON_PYYAML
	bool "host python-pyyaml"
	help
	  The host PyYAML package contains binding to the libyaml API.

	  http://pyyaml.org/
```

## package/python-qrcode/Config.in
```kconfig
config BR2_PACKAGE_PYTHON_QRCODE
	bool "python-qrcode"
	help
	  Pure python QR Code generator

	  https://github.com/lincolnloop/python-qrcode

if BR2_PACKAGE_PYTHON_QRCODE

config BR2_PACKAGE_PYTHON_QRCODE_SVG
	bool "SVG support"
	select BR2_PACKAGE_PYTHON3_PYEXPAT

config BR2_PACKAGE_PYTHON_QRCODE_PIL
	bool "PIL support"
	depends on BR2_INSTALL_LIBSTDCPP # python-pillow
	select BR2_PACKAGE_PYTHON_PILLOW

comment "PIL support needs a toolchain w/ C++"
	depends on !BR2_INSTALL_LIBSTDCPP

endif
```

## package/python-raven/Config.in
```kconfig
config BR2_PACKAGE_PYTHON_RAVEN
	bool "python-raven"
	select BR2_PACKAGE_PYTHON3_ZLIB
	select BR2_PACKAGE_PYTHON3_SSL
	select BR2_PACKAGE_PYTHON3_UNICODEDATA
	help
	  Raven is a client for Sentry (https://getsentry.com).

	  https://github.com/getsentry/raven-python
```

## package/python-redis/Config.in
```kconfig
config BR2_PACKAGE_PYTHON_REDIS
	bool "python-redis"
	help
	  Python client for Redis database and key-value store.

	  https://github.com/redis/redis-py
```

## package/python-reedsolo/Config.in
```kconfig
config BR2_PACKAGE_PYTHON_REEDSOLO
	bool "python-reedsolo"
	help
	  Pure-Python Reed Solomon encoder/decoder.

	  https://github.com/tomerfiliba/reedsolomon
```

## package/python-referencing/Config.in
```kconfig
config BR2_PACKAGE_PYTHON_REFERENCING
	bool "python-referencing"
	depends on BR2_PACKAGE_HOST_RUSTC_TARGET_ARCH_SUPPORTS # python-rpds-py
	select BR2_PACKAGE_PYTHON_ATTRS # runtime
	select BR2_PACKAGE_PYTHON_RPDS_PY # runtime
	help
	  JSON Referencing + Python.

	  https://github.com/python-jsonschema/referencing
```

## package/python-regex/Config.in
```kconfig
config BR2_PACKAGE_PYTHON_REGEX
	bool "python-regex"
	help
	  Alternative regular expression module, to replace re.

	  https://github.com/mrabarnett/mrab-regex
```

## package/python-remi/Config.in
```kconfig
config BR2_PACKAGE_PYTHON_REMI
	bool "python-remi"
	select BR2_PACKAGE_PYTHON3_SSL # runtime
	select BR2_PACKAGE_PYTHON_SETUPTOOLS # runtime
	select BR2_PACKAGE_PYTHON_LEGACY_CGI # runtime
	help
	  Remi is a GUI library for Python applications which transpiles
	  an application's interface into HTML to be rendered in a web
	  browser. This removes platform-specific dependencies and lets
	  you easily develop cross-platform applications in Python!

	  https://github.com/dddomodossola/remi/tree/master
```

## package/python-requests-oauthlib/Config.in
```kconfig
config BR2_PACKAGE_PYTHON_REQUESTS_OAUTHLIB
	bool "python-requests-oauthlib"
	depends on BR2_PACKAGE_PYTHON3 # python-requests -> python-idna
	select BR2_PACKAGE_PYTHON_OAUTHLIB # runtime
	select BR2_PACKAGE_PYTHON_REQUESTS # runtime
	help
	  OAuthlib authentication support for Requests.

	  https://github.com/requests/requests-oauthlib
```

## package/python-requests-toolbelt/Config.in
```kconfig
config BR2_PACKAGE_PYTHON_REQUESTS_TOOLBELT
	bool "python-requests-toolbelt"
	depends on BR2_PACKAGE_PYTHON3 # python-requests -> python-idna
	select BR2_PACKAGE_PYTHON_REQUESTS # runtime
	help
	  A utility belt for advanced users of python-requests.

	  https://toolbelt.readthedocs.org
```
