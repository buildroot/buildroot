## package/asio/Config.in
```kconfig
config BR2_PACKAGE_ASIO
	bool "asio"
	help
        asio is a cross-platform C++ library for network and low-level I/O programming
        that provides developers with a consistent asynchronous model using a modern C++ approach.
```

## package/assimp/Config.in
```kconfig
config BR2_PACKAGE_ASSIMP
	bool "assimp"
	depends on BR2_INSTALL_LIBSTDCPP
	depends on BR2_USE_WCHAR
	depends on !BR2_TOOLCHAIN_HAS_GCC_BUG_64735 # exception_ptr
	select BR2_PACKAGE_ZLIB
	select BR2_PACKAGE_ZLIB_FORCE_LIBZLIB
	help
	  Open Asset Import Library (assimp) is a portable Open Source
	  library to import various well-known 3D model formats in a
	  uniform manner. The most recent version also knows how to
	  export 3d files and is therefore suitable as a general-purpose
	  3D model converter.

	  http://www.assimp.org

comment "assimp needs a toolchain w/ C++, wchar"
	depends on !BR2_INSTALL_LIBSTDCPP || !BR2_USE_WCHAR

comment "assimp needs exception_ptr"
	depends on BR2_TOOLCHAIN_HAS_GCC_BUG_64735
```

## package/at-spi2-core/Config.in
```kconfig
config BR2_PACKAGE_AT_SPI2_CORE
	bool "at-spi2-core"
	depends on BR2_TOOLCHAIN_HAS_THREADS # dbus, glib2
	depends on BR2_USE_MMU # glib2
	depends on BR2_USE_WCHAR # glib2
	depends on !BR2_STATIC_LIBS # dlopen()
	select BR2_PACKAGE_DBUS
	select BR2_PACKAGE_LIBGLIB2
	select BR2_PACKAGE_LIBXML2
	select BR2_PACKAGE_XLIB_LIBXTST if BR2_PACKAGE_XORG7 # optionally for X11
	help
	  The At-Spi2 Core package is a part of the GNOME
	  Accessibility Project. It provides a Service Provider
	  Interface for the Assistive Technologies available on the
	  GNOME platform and a library against which applications
	  can be linked.

	  https://wiki.gnome.org/Accessibility

comment "at-spi2-core needs a toolchain w/ dynamic library, wchar, threads"
	depends on BR2_USE_MMU
	depends on BR2_STATIC_LIBS || !BR2_USE_WCHAR || !BR2_TOOLCHAIN_HAS_THREADS
```

## package/atkmm/Config.in
```kconfig
config BR2_PACKAGE_ATKMM
	bool "atkmm (latest)"
	depends on BR2_INSTALL_LIBSTDCPP # glibmm
	depends on BR2_TOOLCHAIN_GCC_AT_LEAST_7 # libsigc
	depends on BR2_TOOLCHAIN_HAS_THREADS # at-spi2-core/glibmm -> libglib2
	depends on BR2_USE_MMU # at-spi2-core/glibmm -> libglib2
	depends on BR2_USE_WCHAR # at-spi2-core/glibmm -> libglib2
	depends on !BR2_STATIC_LIBS # at-spi2-core
	select BR2_PACKAGE_AT_SPI2_CORE
	select BR2_PACKAGE_GLIBMM
	select BR2_PACKAGE_LIBSIGC

	help
	  The atkmm package is a set of C++ bindings for Atk.

	  http://www.gtkmm.org/

comment "atkmm needs a toolchain w/ C++, wchar, threads, gcc >= 7, dynamic library"
	depends on BR2_USE_MMU
	depends on !BR2_TOOLCHAIN_GCC_AT_LEAST_7 || !BR2_USE_WCHAR \
		|| !BR2_INSTALL_LIBSTDCPP || !BR2_TOOLCHAIN_HAS_THREADS || \
		BR2_STATIC_LIBS
```

## package/atkmm2_28/Config.in
```kconfig
config BR2_PACKAGE_ATKMM2_28
	bool "atkmm (2.28.x)"
	depends on BR2_INSTALL_LIBSTDCPP # glibmm
	depends on BR2_TOOLCHAIN_GCC_AT_LEAST_4_9 # C++11
	depends on BR2_TOOLCHAIN_HAS_THREADS # at-spi2-core/glibmm -> libglib2
	depends on BR2_USE_MMU # at-spi2-core/glibmm -> libglib2
	depends on BR2_USE_WCHAR # at-spi2-core/glibmm -> libglib2
	select BR2_PACKAGE_AT_SPI2_CORE
	select BR2_PACKAGE_GLIBMM2_66
	select BR2_PACKAGE_LIBSIGC2

	help
	  The atkmm package is a set of C++ bindings for Atk.

	  This is the last version before the API and ABI change
	  introduced in 2.36.0 which requires C++17.

	  http://www.gtkmm.org/

comment "atkmm (2.28.x) needs a toolchain w/ C++, wchar, threads, gcc >= 4.9"
	depends on BR2_USE_MMU
	depends on !BR2_TOOLCHAIN_GCC_AT_LEAST_4_9 || !BR2_USE_WCHAR \
		|| !BR2_INSTALL_LIBSTDCPP || !BR2_TOOLCHAIN_HAS_THREADS
```

## package/avahi/Config.in
```kconfig
config BR2_PACKAGE_AVAHI
	bool "avahi"
	# libdaemon uses fork()
	depends on BR2_USE_MMU
	depends on BR2_TOOLCHAIN_HAS_THREADS
	depends on !BR2_STATIC_LIBS
	help
	  Avahi is a system which facilitates service
	  discovery on a local network.

	  http://www.avahi.org/

if BR2_PACKAGE_AVAHI

config BR2_PACKAGE_AVAHI_AUTOIPD
	bool "IPv4LL network address configuration daemon"
	default y
	select BR2_PACKAGE_LIBDAEMON
	help
	  Avahi-autoipd implements IPv4LL, "Dynamic Configuration of
	  IPv4 Link-Local Addresses" (IETF RFC3927), a protocol for
	  automatic IP address configuration from the link-local
	  169.254.0.0/16 range without the need for a central server.
	  It is primarily intended to be used in ad-hoc networks which
	  lack a DHCP server.

config BR2_PACKAGE_AVAHI_DAEMON
	bool "mDNS/DNS-SD daemon"
	select BR2_PACKAGE_LIBDAEMON
	select BR2_PACKAGE_EXPAT
	help
	  The Avahi mDNS/DNS-SD daemon implementing Apple's ZeroConf
	  architecture (also known as "Rendezvous" or "Bonjour").
	  The daemon registers local IP addresses and services using
	  mDNS/DNS-SD.

# This hidden option allows packages that need the libavahi-client to
# more easily determine if it's available or not.
config BR2_PACKAGE_AVAHI_LIBAVAHI_CLIENT
	bool
	default y if BR2_PACKAGE_DBUS

config BR2_PACKAGE_AVAHI_LIBDNSSD_COMPATIBILITY
	bool "libdns_sd compatibility (Bonjour)"
	depends on BR2_PACKAGE_AVAHI_DAEMON
	select BR2_PACKAGE_DBUS
	help
	  Enable the libdns_sd (Bonjour) compatibility library support
	  for legacy applications.

config BR2_PACKAGE_AVAHI_DEFAULT_SERVICES
	bool "install default service definitions"
	depends on BR2_PACKAGE_AVAHI_DAEMON
	help
	  Install the SSH/SFTP service definitions included with the
	  Avahi daemon by default.

endif

comment "avahi needs a toolchain w/ threads"
	depends on BR2_USE_MMU
	depends on !BR2_TOOLCHAIN_HAS_THREADS
```

## package/avn-client/Config.in
```kconfig
config BR2_PACKAGE_AVN_CLIENT
    bool "avn-client"

if BR2_PACKAGE_AVN_CLIENT
config BR2_PACKAGE_AVN_CLIENT_APP
    bool "Create AVN Client App"
    default n
    help
       This option allows to create avn client app,
       default is avn client library
endif
```

## package/avocado/Config.in
```kconfig
config BR2_PACKAGE_AVOCADO
	bool "avocado"
	depends on BR2_USE_WCHAR # python3
	depends on BR2_USE_MMU # python3
	depends on BR2_TOOLCHAIN_HAS_THREADS # python3
	depends on !BR2_STATIC_LIBS # python3
	select BR2_PACKAGE_PYTHON3
	select BR2_PACKAGE_PYTHON3_BZIP2
	select BR2_PACKAGE_PYTHON3_PYEXPAT
	select BR2_PACKAGE_PYTHON3_SQLITE
	select BR2_PACKAGE_PYTHON3_XZ
	select BR2_PACKAGE_PYTHON_SETUPTOOLS # runtime, pkg_resources
	help
	  Avocado is an automated testing suite containing
	  tests for various subsystems.

	  https://avocado-framework.readthedocs.io/

comment "avocado needs a toolchain w/ wchar, threads, dynamic library"
	depends on BR2_USE_MMU
	depends on !BR2_USE_WCHAR || !BR2_TOOLCHAIN_HAS_THREADS || BR2_STATIC_LIBS
```

## package/avrdude/Config.in
```kconfig
config BR2_PACKAGE_AVRDUDE
	bool "avrdude"
	depends on BR2_TOOLCHAIN_HAS_THREADS
	depends on BR2_USE_WCHAR # elfutils
	depends on !BR2_STATIC_LIBS # elfutils
	depends on BR2_TOOLCHAIN_GCC_AT_LEAST_4_9 # libusb
	select BR2_PACKAGE_ELFUTILS
	select BR2_PACKAGE_LIBUSB
	select BR2_PACKAGE_LIBUSB_COMPAT
	select BR2_PACKAGE_NCURSES
	help
	  avrdude is a programmer for Atmel AVR microcontrollers
	  this package provides a version with new linuxspi driver

	  https://github.com/kcuzner/avrdude

if BR2_PACKAGE_AVRDUDE

config BR2_PACKAGE_AVRDUDE_SPI
	bool "SPI support"
	default y # Backward compatibility
	depends on BR2_TOOLCHAIN_HEADERS_AT_LEAST_4_8

comment "SPI support needs a toolchain w/ linux headers >= 4.8"
	depends on !BR2_TOOLCHAIN_HEADERS_AT_LEAST_4_8

endif

comment "avrdude needs a toolchain w/ threads, wchar, dynamic library, gcc >= 4.9"
	depends on !BR2_TOOLCHAIN_HAS_THREADS || !BR2_USE_WCHAR \
		|| BR2_STATIC_LIBS || !BR2_TOOLCHAIN_GCC_AT_LEAST_4_9
```

## package/axel/Config.in
```kconfig
config BR2_PACKAGE_AXEL
	bool "axel"
	depends on BR2_TOOLCHAIN_HAS_THREADS
	depends on BR2_TOOLCHAIN_GCC_AT_LEAST_4_9 # C11/stdatomic.h
	help
	  HTTP/FTP download accelerator.

	  https://github.com/axel-download-accelerator/axel/

comment "axel needs a toolchain w/ threads, gcc >= 4.9"
	depends on !BR2_TOOLCHAIN_HAS_THREADS || \
		!BR2_TOOLCHAIN_GCC_AT_LEAST_4_9
```

## package/babeld/Config.in
```kconfig
config BR2_PACKAGE_BABELD
	bool "babeld"
	depends on BR2_USE_MMU # fork()
	# uses textrel
	depends on !BR2_TOOLCHAIN_USES_MUSL
	help
	  Babel is a loop-avoiding distance-vector routing protocol for
	  IPv6 and IPv4 with fast convergence properties.

	  https://www.irif.fr/~jch/software/babel/

comment "babeld needs a uClibc or glibc toolchain"
	depends on BR2_USE_MMU
	depends on BR2_TOOLCHAIN_USES_MUSL
```

## package/bash/Config.in
```kconfig
config BR2_PACKAGE_BASH
	bool "bash"
	# uses fork()
	depends on BR2_USE_MMU
	depends on BR2_PACKAGE_BUSYBOX_SHOW_OTHERS
	select BR2_PACKAGE_NCURSES
	select BR2_PACKAGE_READLINE
	help
	  The standard GNU Bourne again shell.

	  http://tiswww.case.edu/php/chet/bash/bashtop.html

if BR2_PACKAGE_BASH

config BR2_PACKAGE_BASH_LOADABLE_EXAMPLES
	bool "loadable examples"
	depends on !BR2_STATIC_LIBS
	help
	  This option will enable the installation of the "loadable"
	  examples, which are dynamically loadable extension providing
	  additional built-ins commands to bash. There are typically
	  not needed as they are provided as regular, external
	  commands.

endif
```

## package/basu/Config.in
```kconfig
config BR2_PACKAGE_BASU
	bool "basu"
	depends on BR2_USE_MMU # dbus
	depends on BR2_USE_WCHAR # uchar.h
	depends on BR2_ENABLE_LOCALE # locale_t
	depends on BR2_TOOLCHAIN_HAS_SYNC_4 # __sync_add_and_fetch
	depends on BR2_TOOLCHAIN_HAS_THREADS
	depends on BR2_TOOLCHAIN_HEADERS_AT_LEAST_3_17 # F_ADD_SEALS
	select BR2_PACKAGE_DBUS if !BR2_PACKAGE_DBUS_BROKER # runtime
	help
	  basu is the sd-bus library, extracted from systemd.

	  Some projects rely on the sd-bus library for DBus support.
	  However not all systems have systemd or elogind installed.
	  This library provides just sd-bus (and the busctl utility).

	  https://git.sr.ht/~emersion/basu

comment "basu needs a toolchain w/ wchar, locale, threads, headers >= 3.17"
	depends on BR2_USE_MMU
	depends on BR2_TOOLCHAIN_HAS_SYNC_4
	depends on !BR2_USE_WCHAR || !BR2_ENABLE_LOCALE || \
		!BR2_TOOLCHAIN_HAS_THREADS || !BR2_TOOLCHAIN_HEADERS_AT_LEAST_3_17
```

## package/bat/Config.in
```kconfig
config BR2_PACKAGE_BAT
	bool "bat"
	depends on BR2_PACKAGE_HOST_RUSTC_TARGET_ARCH_SUPPORTS
	select BR2_PACKAGE_HOST_RUSTC
	# we need a full version of less
	select BR2_PACKAGE_BUSYBOX_SHOW_OTHERS
	select BR2_PACKAGE_LESS
	help
	  A cat(1) clone with syntax highlighting and Git integration.

	  https://github.com/sharkdp/bat
```

## package/bats-assert/Config.in
```kconfig
config BR2_PACKAGE_BATS_ASSERT
	bool "bats-assert"
	select BR2_PACKAGE_BATS_SUPPORT # runtime
	help
	  bats-assert is a helper library providing common assertions
	  for Bats.

	  In the context of this project, an assertion is a function
	  that perform a test and returns 1 on failure or 0 on success.
	  To make debugging easier, the assertion also outputs relevant
	  information on failure. The output is formatted for
	  readability. To make assertions usable outside of @test
	  blocks, the output is sent to stderr.

	  https://github.com/bats-core/bats-assert
```

## package/bats-core/Config.in
```kconfig
config BR2_PACKAGE_BATS_CORE
	bool "bats"
	depends on BR2_PACKAGE_BASH # runtime
	help
	  Bats: Bash Automated Testing System

	  Bats is a TAP-compliant testing framework for Bash. It
	  provides a simple way to verify that the UNIX programs you
	  write behave as expected.

	  https://github.com/bats-core/bats-core

if BR2_PACKAGE_BATS_CORE

source "package/bats-assert/Config.in"
source "package/bats-file/Config.in"
source "package/bats-support/Config.in"

endif
```

## package/bats-file/Config.in
```kconfig
config BR2_PACKAGE_BATS_FILE
	bool "bats-file"
	select BR2_PACKAGE_BATS_SUPPORT # runtime
	help
	  bats-file is a helper library providing common filesystem
	  related assertions and helpers for Bats.

	  Assertions are functions that perform a test and output
	  relevant information on failure to help debugging. They return
	  1 on failure and 0 otherwise. Output, formatted for
	  readability, is sent to the standard error to make assertions
	  usable outside of @test blocks too.

	  https://github.com/bats-core/bats-file
```

## package/bats-support/Config.in
```kconfig
config BR2_PACKAGE_BATS_SUPPORT
	bool "bats-support"
	help
	  bats-support is a supporting library providing common
	  functions to test helper libraries written for Bats.

	  https://github.com/bats-core/bats-support
```

## package/bcc/Config.in
```kconfig
config BR2_PACKAGE_BCC
	bool "bcc"
	depends on BR2_PACKAGE_LLVM_ARCH_SUPPORTS
	depends on BR2_USE_MMU # python3
	depends on BR2_TOOLCHAIN_USES_GLIBC # hardcode GNU tuple (x86_64-unknown-linux-gnu)
	depends on BR2_TOOLCHAIN_GCC_AT_LEAST_7 # clang
	depends on BR2_INSTALL_LIBSTDCPP # clang
	depends on BR2_HOST_GCC_AT_LEAST_7 # clang
	depends on BR2_USE_WCHAR # clang, python3
	depends on BR2_TOOLCHAIN_HAS_THREADS # clang, python3
	depends on !BR2_STATIC_LIBS # clang, python3
	select BR2_PACKAGE_CLANG
	select BR2_PACKAGE_ELFUTILS
	select BR2_PACKAGE_FLEX # needs FlexLexer.h
	select BR2_PACKAGE_HOST_ZIP
	select BR2_PACKAGE_LLVM
	select BR2_PACKAGE_LLVM_BPF
	select BR2_PACKAGE_PYTHON3
	help
	  BPF Compiler Collection (BCC)

	  BCC is a toolkit for creating efficient kernel tracing and
	  manipulation programs, and includes several useful tools and
	  examples. It makes use of extended BPF (Berkeley Packet
	  Filters), formally known as eBPF, a new feature that was
	  first added to Linux 3.15. Much of what BCC uses requires
	  Linux 4.1 and above.

	  Note: Before using bcc, you need either need to :
	  - For kernel_ver = [4.1, 5.2) : Copy kernel source code
	  to target folder /lib/module/<kernel_ver>/build.
	  - Or kernel_ver >= 5.2 : Compile kernel with CONFIG_IKHEADERS
	  and use generated headers under /sys/kernel/kheaders.tar.xz
	  to populate /lib/module/<kernel_ver>/build.

	  That's because the clang frontend build eBPF code at runtime.

	  https://github.com/iovisor/bcc
	  http://www.ebpf.io

comment "bcc needs a glibc toolchain, C++, wchar, threads, dynamic libs, gcc >= 7, host gcc >= 7"
	depends on BR2_PACKAGE_LLVM_ARCH_SUPPORTS
	depends on BR2_USE_MMU
	depends on !BR2_TOOLCHAIN_USES_GLIBC \
		|| !BR2_TOOLCHAIN_GCC_AT_LEAST_7 \
		|| !BR2_INSTALL_LIBSTDCPP \
		|| !BR2_HOST_GCC_AT_LEAST_7 \
		|| !BR2_USE_WCHAR \
		|| !BR2_TOOLCHAIN_HAS_THREADS \
		|| BR2_STATIC_LIBS
```

## package/bcm-bme/Config.in
```kconfig
config BR2_PACKAGE_BCM_BME
	bool "bcm-native-mediaplayer"
	depends on BR2_PACKAGE_HAS_NEXUS
	select BR2_PACKAGE_GYP
	help
	  bcm-bme

source "package/bcm-bme/bme-amazon-backend/Config.in"
```

## package/bcm-bme/bme-amazon-backend/Config.in
```kconfig
 config BR2_PACKAGE_BME_AMAZON_BACKEND
	bool "amazon backend"
	depends on BR2_PACKAGE_BCM_BME
	help
	  amazon backend for bme player
 
```
