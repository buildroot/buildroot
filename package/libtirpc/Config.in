## package/libtirpc/Config.in
```kconfig
config BR2_PACKAGE_LIBTIRPC
	bool "libtirpc"
	depends on BR2_TOOLCHAIN_HAS_THREADS
	help
	  Libtirpc is a port of Sun's Transport-Independent RPC
	  library to Linux.

	  http://sourceforge.net/projects/libtirpc/

if BR2_PACKAGE_LIBTIRPC

config BR2_PACKAGE_LIBTIRPC_GSS
	bool "gss"
	depends on BR2_USE_MMU # libkrb5
	depends on !BR2_STATIC_LIBS # libkrb5
	select BR2_PACKAGE_LIBKRB5
	help
	  Enable GSSAPI support

comment "libtirpc gss support needs a toolchain w/ dynamic library"
	depends on BR2_USE_MMU
	depends on BR2_STATIC_LIBS

config BR2_PACKAGE_LIBTIRPC_RPCDB
	bool "rpcdb"
	help
	  Enable RPCDB support

endif

comment "libtirpc needs a toolchain w/ threads"
	depends on !BR2_TOOLCHAIN_HAS_THREADS
```

## package/libtraceevent/Config.in
```kconfig
config BR2_PACKAGE_LIBTRACEEVENT
	bool "libtraceevent"
	depends on !BR2_STATIC_LIBS # dlfcn.h
	help
	  libtraceevent is a library that interfaces with the ftrace
	  subsystem in the linux kernel.
	  It used to be bundled directly in the trace-cmd
	  tool, but it was eventually extracted so that it can be used
	  by multiple other tools and libraries, such as libtracefs and
	  rtla.

	  https://git.kernel.org/pub/scm/libs/libtrace/libtraceevent.git/

comment "libtraceevent needs a toolchain w/ dynamic library"
	depends on BR2_STATIC_LIBS
```

## package/libtracefs/Config.in
```kconfig
config BR2_PACKAGE_LIBTRACEFS
	bool "libtracefs"
	depends on BR2_TOOLCHAIN_HAS_THREADS
	depends on !BR2_STATIC_LIBS # libtraceevent
	select BR2_PACKAGE_LIBTRACEEVENT
	help
	  libtracefs is used to easily interface with the ftrace
	  interface through the tracefs virtual filesystem.

	  https://git.kernel.org/pub/scm/libs/libtrace/libtraceevent.git/

comment "libtracefs needs a toolchain w/ threads, dynamic library"
	depends on !BR2_TOOLCHAIN_HAS_THREADS || BR2_STATIC_LIBS
```

## package/libubox/Config.in
```kconfig
config BR2_PACKAGE_LIBUBOX
	bool "libubox"
	depends on !BR2_STATIC_LIBS
	depends on BR2_TOOLCHAIN_HAS_SYNC_4 # json-c
	select BR2_PACKAGE_JSON_C
	help
	  This library originates from the OpenWrt project to
	  handle the configuration file infrastructure, but can
	  also be used for the same purposes in projects other
	  than OpenWrt.

	  https://openwrt.org/docs/techref/libubox

comment "libubox needs a toolchain w/ dynamic library"
	depends on BR2_STATIC_LIBS
	depends on BR2_TOOLCHAIN_HAS_SYNC_4
```

## package/libucontext/Config.in
```kconfig
config BR2_PACKAGE_LIBUCONTEXT_ARCH_SUPPORTS
	bool
	default y if BR2_aarch64
	default y if BR2_aarch64_be
	default y if BR2_arm
	default y if BR2_armeb
	default y if BR2_m68k
	default y if BR2_mips
	default y if BR2_mipsel
	default y if BR2_mips64
	default y if BR2_mips64el
	default y if BR2_or1k
	default y if BR2_powerpc
	default y if BR2_powerpc64
	default y if BR2_powerpc64le
	default y if BR2_riscv && BR2_RISCV_32
	default y if BR2_riscv && BR2_RISCV_64
	default y if BR2_s390x
	default y if BR2_sh4
	default y if BR2_sh4eb
	default y if BR2_sh4a
	default y if BR2_sh4aeb
	default y if BR2_i386
	default y if BR2_x86_64
	depends on BR2_TOOLCHAIN_USES_MUSL

config BR2_PACKAGE_LIBUCONTEXT
	bool "libucontext"
	depends on BR2_PACKAGE_LIBUCONTEXT_ARCH_SUPPORTS
	help
	  Ucontext implementation featuring glibc-compatible ABI.

	  https://github.com/kaniini/libucontext
```

## package/libudev-zero/Config.in
```kconfig
config BR2_PACKAGE_LIBUDEV_ZERO
	bool "libudev-zero"
	depends on !BR2_STATIC_LIBS
	select BR2_PACKAGE_HAS_LIBUDEV
	help
	  Daemonless replacement for libudev

	  https://github.com/illiliti/libudev-zero

comment "libudev-zero needs a toolchain w/ dynamic library"
	depends on BR2_STATIC_LIBS

if BR2_PACKAGE_LIBUDEV_ZERO

config BR2_PACKAGE_PROVIDES_LIBUDEV
	default "libudev-zero"

endif # BR2_PACKAGE_LIBUDEV_ZERO
```

## package/libudev/Config.in
```kconfig
config BR2_PACKAGE_HAS_LIBUDEV
	bool

config BR2_PACKAGE_PROVIDES_LIBUDEV
	string
	depends on BR2_PACKAGE_HAS_LIBUDEV
```

## package/libudfread/Config.in
```kconfig
config BR2_PACKAGE_LIBUDFREAD
	bool "libudfread"
	depends on BR2_TOOLCHAIN_HAS_SYNC_4 || BR2_TOOLCHAIN_HAS_THREADS
	help
	  UDF reader

	  https://code.videolan.org/videolan/libudfread

comment "libudfread needs a toolchain w/ threads"
	depends on !BR2_TOOLCHAIN_HAS_SYNC_4 && !BR2_TOOLCHAIN_HAS_THREADS
```

## package/libuhttpd/Config.in
```kconfig
config BR2_PACKAGE_LIBUHTTPD
	bool "libuhttpd"
	depends on BR2_USE_MMU # fork()
	depends on BR2_TOOLCHAIN_GCC_AT_LEAST_4_9
	select BR2_PACKAGE_LIBEV
	select BR2_PACKAGE_WOLFSSL_ALL if BR2_PACKAGE_WOLFSSL
	help
	  A lightweight and fully asynchronous HTTP server
	  library based on libev

	  https://github.com/zhaojh329/libuhttpd

comment "libuhttpd needs a toolchain w/ gcc >= 4.9"
	depends on BR2_USE_MMU
	depends on BR2_TOOLCHAIN_GCC_AT_LEAST_4_9
```

## package/libunibreak/Config.in
```kconfig
config BR2_PACKAGE_LIBUNIBREAK
	bool "libunibreak"
	help
	  libunibreak is an implementation of the line breaking and word
	  breaking algorithms as described in Unicode Standard Annex 14
	  and Unicode Standard Annex 29.

	  https://github.com/adah1972/libunibreak
```

## package/libunpriv/Config.in
```kconfig
config BR2_PACKAGE_LIBUNPRIV
    bool "LIBUNPRIV"
    default n
    select BR2_PACKAGE_LIBCAP
    select BR2_PACKAGE_JSONCPP
    help
       LIBUNPRIV library component
```

## package/libupnpp/Config.in
```kconfig
config BR2_PACKAGE_LIBUPNPP
	bool "libupnpp"
	depends on BR2_INSTALL_LIBSTDCPP
	depends on BR2_TOOLCHAIN_HAS_THREADS # libnpupnp
	depends on BR2_TOOLCHAIN_GCC_AT_LEAST_7 # libnpupnp
	select BR2_PACKAGE_EXPAT
	select BR2_PACKAGE_LIBCURL
	select BR2_PACKAGE_LIBNPUPNP
	help
	  The libupnpp C++ library wraps libupnp for easier use by
	  upmpdcli and upplay.

	  http://www.lesbonscomptes.com/upmpdcli/

comment "libupnpp needs a toolchain w/ C++, threads, gcc >= 7"
	depends on !BR2_INSTALL_LIBSTDCPP || !BR2_TOOLCHAIN_HAS_THREADS || !BR2_TOOLCHAIN_GCC_AT_LEAST_7
```

## package/liburing/Config.in
```kconfig
config BR2_PACKAGE_LIBURING
	bool "liburing"
	depends on BR2_TOOLCHAIN_GCC_AT_LEAST_4_9 # C11/stdatomic.h
	depends on BR2_TOOLCHAIN_HEADERS_AT_LEAST_5_1
	help
	  This is the io_uring library, liburing. liburing provides
	  helpers to setup and teardown io_uring instances, and also a
	  simplified interface for applications that don't need (or
	  want) to deal with the full kernel side implementation.

	  https://git.kernel.dk/cgit/liburing

comment "liburing needs a toolchain w/ gcc >= 4.9, headers >= 5.1"
	depends on !BR2_TOOLCHAIN_GCC_AT_LEAST_4_9 || \
		!BR2_TOOLCHAIN_HEADERS_AT_LEAST_5_1
```

## package/libusrsctp/Config.in
```kconfig
config BR2_PACKAGE_LIBUSRSCTP
	bool "libusrsctp"
	help
	  Reference Implementation for SCTP - RFC4960
```

## package/libutempter/Config.in
```kconfig
config BR2_PACKAGE_LIBUTEMPTER
	bool "libutempter"
	depends on BR2_TOOLCHAIN_HEADERS_AT_LEAST_4_14
	depends on !BR2_STATIC_LIBS
	help
	  The libutempter library provides interface for terminal
	  emulators such as screen and xterm to record user
	  sessions to utmp and wtmp files.

	  http://ftp.altlinux.org/pub/people/ldv/utempter/

comment "libutempter needs a toolchain w/ headers >= 4.14, dynamic library"
	depends on !BR2_TOOLCHAIN_HEADERS_AT_LEAST_4_14 || BR2_STATIC_LIBS
```

## package/libutp/Config.in
```kconfig
config BR2_PACKAGE_LIBUTP
	bool "libutp"
	depends on BR2_INSTALL_LIBSTDCPP
	help
	  uTorrent Transport Protocol library

	  https://github.com/bittorrent/libutp

comment "libutp support needs a toolchain with C++"
	depends on !BR2_INSTALL_LIBSTDCPP
```

## package/libuv/Config.in
```kconfig
config BR2_PACKAGE_LIBUV
	bool "libuv"
	depends on BR2_TOOLCHAIN_HAS_THREADS_NPTL # pthread_barrier_*
	depends on BR2_USE_MMU # fork()
	depends on !BR2_STATIC_LIBS
	depends on BR2_TOOLCHAIN_HAS_SYNC_4
	depends on BR2_TOOLCHAIN_GCC_AT_LEAST_4_9 # C11/stdatomic.h
	help
	  libuv is a multi-platform support library with a focus
	  on asynchronous I/O.

	  https://github.com/libuv/libuv

comment "libuv needs a toolchain w/ NPTL, dynamic library, gcc >= 4.9"
	depends on !BR2_TOOLCHAIN_HAS_THREADS_NPTL || BR2_STATIC_LIBS \
		|| !BR2_TOOLCHAIN_GCC_AT_LEAST_4_9
	depends on BR2_USE_MMU
	depends on BR2_TOOLCHAIN_HAS_SYNC_4
```

## package/libuwsc/Config.in
```kconfig
config BR2_PACKAGE_LIBUWSC
	bool "libuwsc"
	select BR2_PACKAGE_LIBEV
	help
	  A Lightweight and fully asynchronous WebSocket
	  client library based on libev.

	  https://github.com/zhaojh329/libuwsc

if BR2_PACKAGE_LIBUWSC

comment "SSL support"

choice
	prompt "Selected SSL library"
	default BR2_PACKAGE_LIBUWSC_WOLFSSL

	config BR2_PACKAGE_LIBUWSC_OPENSSL
		bool "OpenSSL"
		select BR2_PACKAGE_OPENSSL

	config BR2_PACKAGE_LIBUWSC_WOLFSSL
		bool "wolfSSL"
		select BR2_PACKAGE_WOLFSSL

	config BR2_PACKAGE_LIBUWSC_MBEDTLS
		bool "mbed TLS"
		select BR2_PACKAGE_MBEDTLS

	config BR2_PACKAGE_LIBUWSC_NOSSL
		bool "No SSL support"

endchoice

endif
```

## package/libvirt/Config.in
```kconfig
config BR2_PACKAGE_LIBVIRT_ARCH_SUPPORTS
	bool
	default y if BR2_aarch64
	default y if BR2_i386
	default y if BR2_x86_64
	depends on BR2_USE_MMU # fork()

comment "libvirt needs udev /dev management, a toolchain w/ threads, dynamic library, wchar, kernel headers >= 3.12 (4.11 for AArch64)"
	depends on BR2_PACKAGE_LIBVIRT_ARCH_SUPPORTS
	depends on !BR2_PACKAGE_HAS_UDEV || BR2_STATIC_LIBS || \
		!BR2_TOOLCHAIN_HAS_THREADS || !BR2_USE_WCHAR || \
		!(BR2_TOOLCHAIN_HEADERS_AT_LEAST_3_12 && \
			(BR2_TOOLCHAIN_HEADERS_AT_LEAST_4_11 || !BR2_aarch64))

config BR2_PACKAGE_LIBVIRT
	bool "libvirt"
	depends on BR2_PACKAGE_LIBVIRT_ARCH_SUPPORTS
	depends on BR2_TOOLCHAIN_HEADERS_AT_LEAST_3_12
	depends on BR2_TOOLCHAIN_HEADERS_AT_LEAST_4_11 || !BR2_aarch64
	depends on BR2_PACKAGE_HAS_UDEV
	depends on !BR2_STATIC_LIBS
	depends on BR2_TOOLCHAIN_HAS_THREADS
	depends on BR2_USE_WCHAR
	select BR2_PACKAGE_GNUTLS
	# configure: You must install the pciaccess module to build with udev
	select BR2_PACKAGE_LIBPCIACCESS
	select BR2_PACKAGE_LIBGLIB2
	select BR2_PACKAGE_LIBTIRPC
	select BR2_PACKAGE_LIBXML2
	select BR2_PACKAGE_ZLIB
	# run-time dependencies
	select BR2_PACKAGE_CGROUPFS_MOUNT if !BR2_INIT_SYSTEMD
	help
	  Libvirt is collection of software that provides a convenient
	  way to manage virtual machines and other virtualization
	  functionality, such as storage and network interface
	  management. These software pieces include an API library, a
	  daemon (libvirtd), and a command line utility (virsh).

	  https://libvirt.org/

if BR2_PACKAGE_LIBVIRT

config BR2_PACKAGE_LIBVIRT_DAEMON
	bool "libvirtd"
	default y
	depends on BR2_INSTALL_LIBSTDCPP # nmap
	select BR2_PACKAGE_BUSYBOX_SHOW_OTHERS
	select BR2_PACKAGE_DNSMASQ
	select BR2_PACKAGE_EBTABLES
	select BR2_PACKAGE_IPTABLES
	select BR2_PACKAGE_IPROUTE2
	# These are required because there is no way to unequivocally select a modern netcat
	select BR2_PACKAGE_NMAP      if !BR2_PACKAGE_NETCAT_OPENBSD
	select BR2_PACKAGE_NMAP_NCAT if !BR2_PACKAGE_NETCAT_OPENBSD
	select BR2_PACKAGE_RADVD
	help
	  Build the libvirt daemon (libvirtd) otherwise build only the
	  utility programs.

comment "libvirtd needs a toolchain w/ C++"
	depends on !BR2_INSTALL_LIBSTDCPP

# Stateful drivers are useful only when building the daemon.
if BR2_PACKAGE_LIBVIRT_DAEMON

config BR2_PACKAGE_LIBVIRT_QEMU
	bool "qemu"
	depends on BR2_PACKAGE_LIBSECCOMP_ARCH_SUPPORTS # libseccomp
	depends on BR2_PACKAGE_QEMU_ARCH_SUPPORTS_TARGET
	depends on BR2_TOOLCHAIN_GCC_AT_LEAST_8 # qemu
	select BR2_PACKAGE_HWDATA         # libpciaccess
	select BR2_PACKAGE_HWDATA_PCI_IDS # libpciaccess
	select BR2_PACKAGE_LIBSECCOMP
	select BR2_PACKAGE_QEMU
	select BR2_PACKAGE_QEMU_SYSTEM if BR2_PACKAGE_QEMU_CUSTOM_TARGETS = ""
	select BR2_PACKAGE_YAJL
	help
	  QEMU/KVM support

comment "qemu needs a toolchain with gcc >= 8"
	depends on BR2_PACKAGE_LIBSECCOMP_ARCH_SUPPORTS
	depends on BR2_PACKAGE_QEMU_ARCH_SUPPORTS_TARGET
	depends on !BR2_TOOLCHAIN_GCC_AT_LEAST_8

config BR2_PACKAGE_LIBVIRT_LXC
	bool "lxc"
	depends on BR2_TOOLCHAIN_GCC_AT_LEAST_4_7 # lxc
	select BR2_PACKAGE_LXC
	help
	  Linux Container support

comment "lxc needs a toolchain w/ gcc >= 4.7"
	depends on !BR2_TOOLCHAIN_GCC_AT_LEAST_4_7

endif

endif
```

## package/libwebsockets/Config.in
```kconfig
config BR2_PACKAGE_LIBWEBSOCKETS
	bool "libwebsockets"
	depends on !BR2_STATIC_LIBS
	select BR2_PACKAGE_ZLIB
	help
	  Libwebsockets is a lightweight pure C library built to use
	  minimal CPU and memory resources, and provide fast throughput
	  in both directions.

	  https://libwebsockets.org/

if BR2_PACKAGE_LIBWEBSOCKETS

config BR2_PACKAGE_LIBWEBSOCKETS_EXT_POLL
	bool "enable external poll loop support"
	default y  # legacy, was previously always enabled
	help
	  Enable external poll loop support code. This was
	  unconditionally compiled in for library versions
	  prior to 3.2.0.

endif

comment "libwebsockets needs a toolchain w/ dynamic library"
	depends on BR2_STATIC_LIBS
```

## package/libwpe/Config.in
```kconfig
config BR2_PACKAGE_LIBWPE
	bool "libwpe"
	help
	  Base library for the WPE port of WebKit.
```

## package/libxcrypt/Config.in
```kconfig
config BR2_PACKAGE_LIBXCRYPT
	bool "libxcrypt"
	help
	  libxcrypt is a modern library for one-way hashing
	  of passwords. It supports a wide variety of both
	  modern and historical hashing methods:
	  yescrypt, gost-yescrypt, scrypt, bcrypt, sha512crypt,
	  sha256crypt, md5crypt, SunMD5, sha1crypt, NT,
	  bsdicrypt, bigcrypt, and descrypt.

	  https://github.com/besser82/libxcrypt
```

## package/libxkbcommon/Config.in
```kconfig
config BR2_PACKAGE_LIBXKBCOMMON
	bool "libxkbcommon"
	select BR2_PACKAGE_LIBXCB if BR2_PACKAGE_XORG7
	help
	  xkbcommon is a keymap compiler and support library which
	  processes a reduced subset of keymaps as defined by the XKB
	  specification.

	  https://xkbcommon.org

if BR2_PACKAGE_LIBXKBCOMMON

config BR2_PACKAGE_LIBXKBCOMMON_TOOLS
	bool "tools"
	select BR2_PACKAGE_WAYLAND_PROTOCOLS if BR2_PACKAGE_WAYLAND
	help
	  Tools: xkbcli, xkbcli-compile-keymap, xkbcli-how-to-type,
	  xkbcli-interactive-evdev, xkbcli-interactive-x11,
	  xkbcli-interactive-wayland

endif
```

## package/libxmlb/Config.in
```kconfig
config BR2_PACKAGE_LIBXMLB
	bool "libxmlb"
	depends on !BR2_STATIC_LIBS # glib2
	depends on BR2_TOOLCHAIN_HAS_THREADS # glib2
	depends on BR2_USE_MMU # glib2
	depends on BR2_USE_WCHAR # glib2
	select BR2_PACKAGE_LIBGLIB2
	help
	  The libxmlb library takes XML source, and converts it
	  to a structured binary representation with a deduplicated
	  string table where the strings have the NULs included.

	  https://github.com/hughsie/libxmlb

comment "libxmlb needs a toolchain w/ wchar, threads, dynamic library"
	depends on BR2_USE_MMU
	depends on !BR2_USE_WCHAR || !BR2_TOOLCHAIN_HAS_THREADS || BR2_STATIC_LIBS
```

## package/libxmlrpc/Config.in
```kconfig
config BR2_PACKAGE_LIBXMLRPC
	bool "libxmlrpc"
	depends on BR2_TOOLCHAIN_HAS_THREADS
	select BR2_PACKAGE_LIBCURL
	help
	  XML-RPC is a quick-and-easy way to make procedure calls over
	  the Internet. It converts the procedure call into an XML
	  document, sends it to a remote server using HTTP, and gets
	  back the response as XML.

	  http://xmlrpc-c.sourceforge.net/

if BR2_PACKAGE_LIBXMLRPC

config BR2_PACKAGE_LIBXMLRPC_TOOLS_XMLRPC
	bool "install cli tool"
	help
	  Command line tool xmlrpc.

endif # BR2_PACKAGE_LIBXMLRPC

comment "libxmlrpc needs a toolchain w/ threads"
	depends on !BR2_TOOLCHAIN_HAS_THREADS
```
