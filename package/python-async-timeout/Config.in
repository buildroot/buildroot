## package/python-async-timeout/Config.in
```kconfig
config BR2_PACKAGE_PYTHON_ASYNC_TIMEOUT
	bool "python-async-timeout"
	help
	  asyncio-compatible timeout context manager.

	  https://github.com/aio-libs/async-timeout
```

## package/python-asyncclick/Config.in
```kconfig
config BR2_PACKAGE_PYTHON_ASYNCCLICK
	bool "python-asyncclick"
	help
	  Composable command line interface toolkit, async version.

	  https://palletsprojects.com/p/click/
```

## package/python-asyncssh/Config.in
```kconfig
config BR2_PACKAGE_PYTHON_ASYNCSSH
	bool "python-asyncssh"
	depends on BR2_PACKAGE_HOST_RUSTC_TARGET_ARCH_SUPPORTS # python-cryptography
	select BR2_PACKAGE_PYTHON_CRYPTOGRAPHY # runtime
	select BR2_PACKAGE_PYTHON_TYPING_EXTENSIONS # runtime
	help
	  AsyncSSH: Asynchronous SSHv2 client and server library.

	  http://asyncssh.timeheart.net
```

## package/python-attrs/Config.in
```kconfig
config BR2_PACKAGE_PYTHON_ATTRS
	bool "python-attrs"
	depends on BR2_PACKAGE_PYTHON3
	help
	  attrs is the Python package that will bring back the joy of
	  writing classes by relieving you from the drudgery of
	  implementing object protocols (aka dunder methods).

	  https://attrs.readthedocs.io/
```

## package/python-augeas/Config.in
```kconfig
config BR2_PACKAGE_PYTHON_AUGEAS
	bool "python-augeas"
	depends on !BR2_arc
	depends on BR2_USE_WCHAR
	select BR2_PACKAGE_AUGEAS
	select BR2_PACKAGE_PYTHON_CFFI # runtime
	help
	  Pure python bindings for Augeas.

	  https://github.com/hercules-team/python-augeas

comment "python-augeas needs a toolchain w/ wchar"
	depends on !BR2_arc
	depends on !BR2_USE_WCHAR
```

## package/python-autobahn/Config.in
```kconfig
config BR2_PACKAGE_PYTHON_AUTOBAHN
	bool "python-autobahn"
	depends on BR2_PACKAGE_HOST_RUSTC_TARGET_ARCH_SUPPORTS # python-cryptography
	select BR2_PACKAGE_PYTHON_CFFI # runtime
	select BR2_PACKAGE_PYTHON_CRYPTOGRAPHY # runtime
	select BR2_PACKAGE_PYTHON_HYPERLINK # runtime
	select BR2_PACKAGE_PYTHON_TXAIO # runtime
	help
	  WebSocket client and server library, WAMP real-time
	  framework.

	  https://pypi.python.org/pypi/autobahn

if BR2_PACKAGE_PYTHON_AUTOBAHN

config BR2_PACKAGE_PYTHON_AUTOBAHN_ACCELERATE
	bool "C-based WebSocket acceleration"
	select BR2_PACKAGE_PYTHON_WSACCEL # runtime

config BR2_PACKAGE_PYTHON_AUTOBAHN_COMPRESS
	bool "Non-standard WebSocket compression support"
	depends on BR2_INSTALL_LIBSTDCPP # python-snappy -> snappy
	select BR2_PACKAGE_PYTHON_SNAPPY # runtime

comment "Non-standard WebSocket compression needs a toolchain w/ C++"
	depends on !BR2_INSTALL_LIBSTDCPP

config BR2_PACKAGE_PYTHON_AUTOBAHN_ENCRYPTION
	bool "TLS and WAMP-cryptosign encryption/authentication support"
	depends on BR2_PACKAGE_HOST_RUSTC_TARGET_ARCH_SUPPORTS # python-pyopenssl -> python-cryptography
	select BR2_PACKAGE_PYTHON_PYNACL # runtime
	select BR2_PACKAGE_PYTHON_PYOPENSSL # runtime
	select BR2_PACKAGE_PYTHON_QRCODE # runtime
	select BR2_PACKAGE_PYTHON_QRCODE_SVG # runtime
	select BR2_PACKAGE_PYTHON_PYTRIE # runtime
	select BR2_PACKAGE_PYTHON_SERVICE_IDENTITY # runtime

config BR2_PACKAGE_PYTHON_AUTOBAHN_SCRAM
	bool "WAMP-SCRAM authentication support"
	select BR2_PACKAGE_PYTHON_ARGON2_CFFI # runtime
	select BR2_PACKAGE_PYTHON_PASSLIB # runtime

config BR2_PACKAGE_PYTHON_AUTOBAHN_SERIALIZATION
	bool "Accelerated JSON, MessagePack, CBOR, UBJSON, and FlatBuffers serialization support"
	depends on BR2_INSTALL_LIBSTDCPP # python-ujson
	select BR2_PACKAGE_PYTHON_CBOR2 # runtime
	select BR2_PACKAGE_PYTHON_FLATBUFFERS # runtime
	select BR2_PACKAGE_PYTHON_MSGPACK # runtime
	select BR2_PACKAGE_PYTHON_UBJSON # runtime
	select BR2_PACKAGE_PYTHON_UJSON # runtime

comment "Accelerated JSON, MessagePack, CBOR, UBJSON, and FlatBuffers serialization needs a toolchain w/ C++"
	depends on !BR2_INSTALL_LIBSTDCPP

config BR2_PACKAGE_PYTHON_AUTOBAHN_TWISTED
	bool "Twisted support"
	select BR2_PACKAGE_PYTHON_ATTRS # runtime
	select BR2_PACKAGE_PYTHON_TWISTED # runtime
	select BR2_PACKAGE_PYTHON_ZOPE_INTERFACE # runtime

endif
```

## package/python-autocommand/Config.in
```kconfig
config BR2_PACKAGE_PYTHON_AUTOCOMMAND
	bool "python-autocommand"
	help
	  A library to create a command-line program from a function.

	  https://github.com/Lucretiel/autocommand
```

## package/python-automat/Config.in
```kconfig
config BR2_PACKAGE_PYTHON_AUTOMAT
	bool "python-automat"
	help
	  Self-service finite-state machines for the programmer on the
	  go.

	  https://github.com/glyph/Automat
```

## package/python-babel/Config.in
```kconfig
config BR2_PACKAGE_PYTHON_BABEL
	bool "python-babel"
	help
	  A collection of tools for internationalizing Python
	  applications.

	  http://babel.pocoo.org/en/latest/
```

## package/python-base58/Config.in
```kconfig
config BR2_PACKAGE_PYTHON_BASE58
	bool "python-base58"
	help
	  Base58 and Base58Check implementation.

	  https://github.com/keis/base58
```

## package/python-bcrypt/Config.in
```kconfig
config BR2_PACKAGE_PYTHON_BCRYPT
	bool "python-bcrypt"
	depends on BR2_PACKAGE_HOST_RUSTC_TARGET_ARCH_SUPPORTS
	help
	  Modern password hashing for your software and your servers.

	  https://github.com/pyca/bcrypt/
```

## package/python-betterproto/Config.in
```kconfig
config BR2_PACKAGE_PYTHON_BETTERPROTO
	bool "python-betterproto"
	select BR2_PACKAGE_PYTHON_DATEUTIL # runtime
	select BR2_PACKAGE_PYTHON_GRPCLIB # runtime
	select BR2_PACKAGE_PYTHON_TYPING_EXTENSIONS # runtime
	help
	  A better Protobuf / gRPC generator & library.

	  http://github.com/danielgtaylor/python-betterproto
```

## package/python-bidict/Config.in
```kconfig
config BR2_PACKAGE_PYTHON_BIDICT
	bool "python-bidict"
	help
	  The bidirectional mapping library for Python.

	  https://bidict.readthedocs.io
```

## package/python-bitarray/Config.in
```kconfig
config BR2_PACKAGE_PYTHON_BITARRAY
	bool "python-bitarray"
	help
	  efficient arrays of booleans -- C extension.

	  https://github.com/ilanschnell/bitarray
```

## package/python-bitstring/Config.in
```kconfig
config BR2_PACKAGE_PYTHON_BITSTRING
	bool "python-bitstring"
	select BR2_PACKAGE_PYTHON_BITARRAY # runtime
	select BR2_PACKAGE_PYTHON3_ZLIB # runtime
	help
	  Simple construction, analysis and modification of binary data.

	  https://github.com/scott-griffiths/bitstring
```

## package/python-bleak/Config.in
```kconfig
config BR2_PACKAGE_PYTHON_BLEAK
	bool "python-bleak"
	select BR2_PACKAGE_PYTHON_DBUS_FAST # runtime
	help
	  Bluetooth Low Energy platform Agnostic Klient.

	  https://github.com/hbldh/bleak
```

## package/python-blinker/Config.in
```kconfig
config BR2_PACKAGE_PYTHON_BLINKER
	bool "python-blinker"
	help
	  Fast, simple object-to-object and broadcast signaling.

	  https://blinker.readthedocs.io
```

## package/python-bluezero/Config.in
```kconfig
config BR2_PACKAGE_PYTHON_BLUEZERO
	bool "python-bluezero"
	depends on BR2_PACKAGE_GOBJECT_INTROSPECTION_ARCH_SUPPORTS # python-gobject -> gobject-introspection
	depends on BR2_TOOLCHAIN_GCC_AT_LEAST_4_9 # python-gobject -> gobject-introspection
	depends on BR2_HOST_GCC_AT_LEAST_8 # python-gobject -> gobject-introspection -> host-qemu
	depends on BR2_TOOLCHAIN_USES_GLIBC # python-gobject -> gobject-introspection
	depends on BR2_PACKAGE_PYTHON3
	select BR2_PACKAGE_DBUS # runtime
	select BR2_PACKAGE_DBUS_PYTHON # runtime
	select BR2_PACKAGE_PYTHON_GOBJECT # runtime
	help
	  Python library for Bluetooth Low Energy (BLE) on Linux.

	  https://github.com/ukBaz/python-bluezero

comment "python-bluezero needs a glibc toolchain, gcc >= 4.9, host gcc >= 8"
	depends on BR2_PACKAGE_PYTHON3
	depends on BR2_PACKAGE_GOBJECT_INTROSPECTION_ARCH_SUPPORTS
	depends on !BR2_TOOLCHAIN_USES_GLIBC || \
		!BR2_TOOLCHAIN_GCC_AT_LEAST_4_9 || \
		!BR2_HOST_GCC_AT_LEAST_8
```

## package/python-botocore/Config.in
```kconfig
config BR2_PACKAGE_PYTHON_BOTOCORE
	bool "python-botocore"
	depends on BR2_PACKAGE_PYTHON3
	select BR2_PACKAGE_PYTHON_DATEUTIL # runtime
	select BR2_PACKAGE_PYTHON_JMESPATH # runtime
	select BR2_PACKAGE_PYTHON_URLLIB3 # runtime
	select BR2_PACKAGE_PYTHON3_PYEXPAT # runtime
	select BR2_PACKAGE_PYTHON3_SSL # runtime
	help
	  Low-level, data-driven core of boto 3.

	  https://github.com/boto/botocore
```

## package/python-brotli/Config.in
```kconfig
config BR2_PACKAGE_PYTHON_BROTLI
	bool "python-brotli"
	help
	  Python bindings for the Brotli compression library.

	  https://github.com/google/brotli
```

## package/python-bsdiff4/Config.in
```kconfig
config BR2_PACKAGE_PYTHON_BSDIFF4
	bool "python-bsdiff4"
	select BR2_PACKAGE_PYTHON3_BZIP2 # runtime
	help
	  binary diff and patch using the BSDIFF4-format.

	  https://github.com/ilanschnell/bsdiff4
```

## package/python-cachelib/Config.in
```kconfig
config BR2_PACKAGE_PYTHON_CACHELIB
	bool "python-cachelib"
	help
	  A collection of cache libraries in the same API interface.

	  https://github.com/pallets-eco/cachelib/
```

## package/python-cachetools/Config.in
```kconfig
config BR2_PACKAGE_PYTHON_CACHETOOLS
	bool "python-cachetools"
	help
	  Extensible memoizing collections and decorators.

	  https://github.com/tkem/cachetools/
```

## package/python-can/Config.in
```kconfig
config BR2_PACKAGE_PYTHON_CAN
	bool "python-can"
	select BR2_PACKAGE_PYTHON3_SQLITE # runtime
	select BR2_PACKAGE_PYTHON3_ZLIB # runtime
	select BR2_PACKAGE_PYTHON_MSGPACK # runtime
	select BR2_PACKAGE_PYTHON_PACKAGING # runtime
	select BR2_PACKAGE_PYTHON_TYPING_EXTENSIONS # runtime
	select BR2_PACKAGE_PYTHON_WRAPT # runtime
	help
	  This module provides controller area network support for
	  Python.

	  https://github.com/hardbyte/python-can

if BR2_PACKAGE_PYTHON_CAN

config BR2_PACKAGE_PYTHON_CAN_VIEWER
	bool "python-can-viewer"
	select BR2_PACKAGE_PYTHON3_CURSES # runtime
	help
	  Also install the viewer tool (requires ncurses).

endif
```

## package/python-changelog-chug/Config.in
```kconfig
config BR2_PACKAGE_PYTHON_CHANGELOG_CHUG
	bool "python-changelog-chug"
	help
	  changelog-chug is a parser for project Change Log documents.

	  https://pypi.org/project/changelog-chug
```
