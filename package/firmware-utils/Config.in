## package/firmware-utils/Config.in
```kconfig
config BR2_PACKAGE_FIRMWARE_UTILS
	bool "firmware-utils"
	depends on !BR2_STATIC_LIBS
	select BR2_PACKAGE_OPENSSL
	select BR2_PACKAGE_LIBOPENSSL_ENABLE_DES if BR2_PACKAGE_LIBOPENSSL
	select BR2_PACKAGE_ZLIB
	help
	  Firmware utils are tools that can be used for managing
	  platform / device / vendor specific firmware images. Depending
	  on a specific tool it may be possible to read information,
	  extract data, modify or build an image from a scratch.

	  A common target usage of firmware utils is to upgrade kernel
	  and / or rootfs. Depending on device it may be required to
	  extract a part of firmware image and flash it.

	  https://git.openwrt.org/?p=project/firmware-utils.git;a=summary

comment "firmware-utils needs a toolchain w/ dynamic library"
	depends on BR2_STATIC_LIBS
```

## package/firmware-utils/Config.in.host
```kconfig
config BR2_PACKAGE_HOST_FIRMWARE_UTILS
	bool "host firmware-utils"
	help
	  Firmware utils are tools that can be used for managing
	  platform / device / vendor specific firmware images. Depending
	  on a specific tool it may be possible to read information,
	  extract data, modify or build an image from a scratch.

	  A common host usage of firmware utils is to build a bootloader
	  supported image.

	  https://git.openwrt.org/?p=project/firmware-utils.git;a=summary
```

## package/flac/Config.in
```kconfig
config BR2_PACKAGE_FLAC
	bool "flac"
	depends on BR2_USE_WCHAR
	help
	  FLAC is an Open Source lossless audio codec.

	  https://xiph.org/flac/

comment "flac needs a toolchain w/ wchar"
	depends on !BR2_USE_WCHAR
```

## package/flann/Config.in
```kconfig
config BR2_PACKAGE_FLANN
	bool "flann"
	depends on BR2_INSTALL_LIBSTDCPP
	depends on !BR2_STATIC_LIBS
	depends on BR2_TOOLCHAIN_GCC_AT_LEAST_4_7 # C++11
	select BR2_PACKAGE_LZ4
	help
	  FLANN is a library for performing fast approximate nearest
	  neighbor searches in high dimensional spaces. It contains a
	  collection of algorithms we found to work best for nearest
	  neighbor search and a system for automatically choosing the
	  best algorithm and optimum parameters depending on the
	  dataset.

	  http://www.cs.ubc.ca/research/flann/

if BR2_PACKAGE_FLANN

config BR2_PACKAGE_FLANN_EXAMPLES
	bool "flann examples"
	help
	  Build and install flann example applications.

endif

comment "flann needs a toolchain w/ C++, dynamic library, gcc >= 4.7"
	depends on !BR2_INSTALL_LIBSTDCPP || BR2_STATIC_LIBS || \
		!BR2_TOOLCHAIN_GCC_AT_LEAST_4_7
```

## package/fluent-bit/Config.in
```kconfig
config BR2_PACKAGE_FLUENT_BIT
	bool "fluent-bit"
	depends on BR2_TOOLCHAIN_HAS_THREADS
	depends on BR2_TOOLCHAIN_HAS_SYNC_4
	depends on !BR2_STATIC_LIBS # dlfcn.h
	select BR2_PACKAGE_MUSL_FTS if !BR2_TOOLCHAIN_USES_GLIBC
	select BR2_PACKAGE_OPENSSL
	select BR2_PACKAGE_LIBYAML
	help
	  Fast and Lightweight Logs and Metrics processor.

	  https://github.com/fluent/fluent-bit

if BR2_PACKAGE_FLUENT_BIT

config BR2_PACKAGE_FLUENT_BIT_WASM_ARCH
	string
	default "AARCH64"    if BR2_aarch64 || BR2_aarch64_be
	default "ARC"        if BR2_arcle || BR2_arceb
	default "ARM"        if BR2_arm || BR2_armeb
	default "MIPS"       if BR2_mips || BR2_mipsel || BR2_mips64 || BR2_mips64el
	default "RISCV32"    if BR2_riscv && BR2_RISCV_32
	default "RISCV64"    if BR2_riscv && BR2_RISCV_64
	default "X86_32"     if BR2_i386
	default "X86_64"     if BR2_x86_64
	default "XTENSA"     if BR2_xtensa

config BR2_PACKAGE_FLUENT_BIT_WASM_ARCH_SUPPORTS
	bool
	default y if BR2_PACKAGE_FLUENT_BIT_WASM_ARCH != ""

config BR2_PACKAGE_FLUENT_BIT_WASM
	bool "wasm runtime support"
	depends on BR2_INSTALL_LIBSTDCPP
	depends on BR2_PACKAGE_FLUENT_BIT_WASM_ARCH_SUPPORTS
	help
	  Support for WASM-based plugins.

comment "wasm runtime support needs a toolchain w/ C++"
	depends on BR2_PACKAGE_FLUENT_BIT_WASM_ARCH_SUPPORTS
	depends on !BR2_INSTALL_LIBSTDCPP

endif

comment "fluent-bit needs a toolchain w/ threads, dynamic library"
	depends on BR2_TOOLCHAIN_HAS_SYNC_4
	depends on !BR2_TOOLCHAIN_HAS_THREADS || BR2_STATIC_LIBS
```

## package/flutter-engine/Config.in
```kconfig
# Flutter includes a vendor copy of clang which is mandatory to use for
# compiling. These are the supported architectures.
config BR2_PACKAGE_FLUTTER_ENGINE_ARCH_SUPPORTS
	bool
	default y if BR2_aarch64
	default y if BR2_arm && !BR2_ARM_CPU_ARMV4 && !BR2_ARM_CPU_ARMV5
	default y if BR2_x86_64

config BR2_PACKAGE_FLUTTER_ENGINE
	bool "flutter-engine"
	depends on BR2_PACKAGE_FLUTTER_ENGINE_ARCH_SUPPORTS
	depends on BR2_TOOLCHAIN_USES_GLIBC
	depends on BR2_TOOLCHAIN_GCC_AT_LEAST_5
	depends on BR2_INSTALL_LIBSTDCPP
	depends on !BR2_TOOLCHAIN_HAS_GCC_BUG_64735 # std::shared_future
	depends on !BR2_STATIC_LIBS
	depends on BR2_USE_WCHAR # std::wstring
	depends on BR2_HOST_GCC_AT_LEAST_5
	depends on BR2_PACKAGE_HAS_LIBGL || BR2_PACKAGE_HAS_LIBGLES
	select BR2_PACKAGE_FREETYPE
	select BR2_PACKAGE_HOST_DEPOT_TOOLS
	select BR2_PACKAGE_ZLIB
	help
	  Flutter is Google's SDK for crafting beautiful, fast user
	  experience for mobile, web, and desktop from a single
	  codebase. Flutter works with existing code, is used by
	  developers and organizations around the world, and is
	  free and open source.

	  The Flutter Engine is a portable runtime for hosting
	  Flutter applications. It implements Flutter's core
	  libraries, including animation and graphics, file and
	  network I/O, accessibility support, plugin architecture,
	  and a Dart runtime and compile toolchain. Most developers
	  will interact with Flutter via the Flutter Framework,
	  which provides a modern, reactive framework, and a rich
	  set of platform, layout and foundation widgets.

	  https://github.com/flutter/engine

if BR2_PACKAGE_FLUTTER_ENGINE

config FLUTTER_ENGINE_RUNTIME_MODE_PROFILE
	bool "enable profiling"
	help
	  Some debugging ability is maintained—enough to profile your
	  apps performance. Profile mode is disabled on the emulator
	  and simulator, because their behavior is not representative
	  of real performance. Profile mode is similar to release mode,
	  with the following differences:

	  - Some service extensions, such as the one that enables the
	    performance overlay, are enabled.

	  - Tracing is enabled, and tools supporting source-level
	    debugging (such as DevTools) can connect to the process.

	  If this option is left unselected, the global option
	  BR2_ENABLE_RUNTIME_DEBUG determines whether to build Flutter
	  in release or debug mode.

	  https://docs.flutter.dev/testing/build-modes#profile

endif

comment "flutter-engine needs an OpenGL or OpenGLES backend"
	depends on BR2_PACKAGE_FLUTTER_ENGINE_ARCH_SUPPORTS
	depends on !BR2_PACKAGE_HAS_LIBGL && !BR2_PACKAGE_HAS_LIBGLES

comment "flutter-engine needs a glibc toolchain w/ wchar, C++, gcc >= 5, dynamic library, host gcc >= 5"
	depends on BR2_PACKAGE_FLUTTER_ENGINE_ARCH_SUPPORTS
	depends on !BR2_TOOLCHAIN_USES_GLIBC || !BR2_INSTALL_LIBSTDCPP \
		|| !BR2_TOOLCHAIN_GCC_AT_LEAST_5 || BR2_STATIC_LIBS \
		|| !BR2_USE_WCHAR || !BR2_HOST_GCC_AT_LEAST_5

comment "flutter-engine needs a toolchain not affected by GCC bug 64735"
	depends on BR2_PACKAGE_FLUTTER_ENGINE_ARCH_SUPPORTS
	depends on BR2_TOOLCHAIN_HAS_GCC_BUG_64735
```

## package/flutter-gallery/Config.in
```kconfig
config BR2_PACKAGE_FLUTTER_GALLERY
	bool "flutter-gallery"
	depends on BR2_PACKAGE_HOST_FLUTTER_SDK_BIN_ARCH_SUPPORTS
	depends on BR2_PACKAGE_FLUTTER_ENGINE
	select BR2_PACKAGE_HOST_FLUTTER_SDK_BIN
	help
	  Flutter Gallery is a resource to help developers evaluate
	  and use Flutter. It is a collection of Material Design &
	  Cupertino widgets, behaviors, and vignettes implemented
	  with Flutter.

	  https://github.com/flutter/gallery

comment "flutter-gallery needs flutter-engine"
	depends on BR2_PACKAGE_HOST_FLUTTER_SDK_BIN_ARCH_SUPPORTS
	depends on !BR2_PACKAGE_FLUTTER_ENGINE
```

## package/flutter-packages/Config.in
```kconfig
menuconfig BR2_PACKAGE_FLUTTER_PACKAGES
	bool "flutter packages"
	depends on BR2_PACKAGE_HOST_FLUTTER_SDK_BIN_ARCH_SUPPORTS
	depends on BR2_PACKAGE_FLUTTER_ENGINE
	select BR2_PACKAGE_HOST_FLUTTER_SDK_BIN
	help
	  First-party Flutter package examples.

if BR2_PACKAGE_FLUTTER_PACKAGES
source "package/flutter-packages/flutter-adaptive-scaffold-example/Config.in"
source "package/flutter-packages/flutter-animations-example/Config.in"
source "package/flutter-packages/flutter-go-router-example/Config.in"
source "package/flutter-packages/flutter-image-example/Config.in"
source "package/flutter-packages/flutter-markdown-example/Config.in"
source "package/flutter-packages/flutter-rfw-local-example/Config.in"
endif

comment "flutter packages need flutter-engine"
	depends on BR2_PACKAGE_HOST_FLUTTER_SDK_BIN_ARCH_SUPPORTS
	depends on !BR2_PACKAGE_FLUTTER_ENGINE
```

## package/flutter-packages/flutter-adaptive-scaffold-example/Config.in
```kconfig
config BR2_PACKAGE_FLUTTER_ADAPTIVE_SCAFFOLD_EXAMPLE
	bool "flutter adaptive scaffold example"
	help
	  Adaptive Scaffold reacts to input from users, devices and
	  screen elements and renders your Flutter application
	  according to the Material 3 guidelines.

	  https://github.com/flutter/packages/tree/main/packages/flutter_adaptive_scaffold/example
```

## package/flutter-packages/flutter-animations-example/Config.in
```kconfig
config BR2_PACKAGE_FLUTTER_ANIMATIONS_EXAMPLE
	bool "flutter animations example"
	help
	  High quality pre-built Animations for Flutter

	  https://github.com/flutter/packages/tree/main/packages/animations/example
```

## package/flutter-packages/flutter-dynamic-layouts-example/Config.in
```kconfig
config BR2_PACKAGE_FLUTTER_DYNAMIC_LAYOUTS_EXAMPLE
	bool "flutter dynamic layouts example"
	help
	  This package provides support for multi sized tiles and
	  different layouts. Currently the layouts that are implemented
	  in this package are Stagger and Wrap.

	  https://github.com/flutter/packages/tree/main/packages/dynamic_layouts/example
```

## package/flutter-packages/flutter-go-router-example/Config.in
```kconfig
config BR2_PACKAGE_FLUTTER_GO_ROUTER_EXAMPLE
	bool "flutter go router example"
	help
	  A Flutter plugin that manages files and interactions
	  with file dialogs.

	  https://github.com/flutter/packages/tree/main/packages/go_router/example
```

## package/flutter-packages/flutter-image-example/Config.in
```kconfig
config BR2_PACKAGE_FLUTTER_IMAGE_EXAMPLE
	bool "flutter image example"
	select BR2_PACKAGE_CA_CERTIFICATES # runtime
	help
	  Use NetworkImageWithRetry instead of Image.network to
	  load images from the network with a retry mechanism.

	  https://github.com/flutter/packages/tree/main/packages/flutter_image/example
```

## package/flutter-packages/flutter-markdown-example/Config.in
```kconfig
config BR2_PACKAGE_FLUTTER_MARKDOWN_EXAMPLE
	bool "flutter markdown example"
	help
	  A markdown renderer for Flutter. It supports the original
	  format, but no inline HTML.

	  https://github.com/flutter/packages/tree/main/packages/flutter_markdown
```

## package/flutter-packages/flutter-rfw-local-example/Config.in
```kconfig
config BR2_PACKAGE_FLUTTER_RFW_LOCAL_EXAMPLE
	bool "remote flutter widgets example"
	help
	  This example shows how one can create custom widgets in an RFW
	  client, for use by remote widgets.

	  https://github.com/flutter/packages/tree/main/packages/rfw/example/local
```

## package/flutter-pi/Config.in
```kconfig
menuconfig BR2_PACKAGE_FLUTTER_PI
	bool "flutter-pi"
	depends on BR2_PACKAGE_HOST_FLUTTER_SDK_BIN_ARCH_SUPPORTS
	depends on BR2_PACKAGE_FLUTTER_ENGINE_ARCH_SUPPORTS
	depends on BR2_HOST_GCC_AT_LEAST_5 # flutter-engine
	depends on BR2_TOOLCHAIN_GCC_AT_LEAST_5 # flutter-engine
	depends on !BR2_TOOLCHAIN_HAS_GCC_BUG_64735 # flutter-engine
	depends on BR2_TOOLCHAIN_USES_GLIBC # flutter-engine
	depends on BR2_INSTALL_LIBSTDCPP # flutter-engine
	depends on !BR2_STATIC_LIBS # flutter-engine, wayland
	depends on BR2_USE_WCHAR # flutter-engine
	depends on BR2_PACKAGE_HAS_LIBGL || BR2_PACKAGE_HAS_LIBGLES # flutter-engine
	depends on BR2_PACKAGE_HAS_LIBGBM
	depends on BR2_PACKAGE_SYSTEMD # Event loop and dbus support
	depends on BR2_PACKAGE_HAS_UDEV # libinput
	select BR2_PACKAGE_HOST_FLUTTER_SDK_BIN
	select BR2_PACKAGE_FLUTTER_ENGINE
	select BR2_PACKAGE_LIBDRM
	select BR2_PACKAGE_LIBINPUT
	select BR2_PACKAGE_LIBXKBCOMMON
	help
	  A light-weight Flutter Engine Embedder. Flutter-pi also
	  runs without X11, so you don't need to boot into a
	  Desktop & have X11 or Wayland load up; just boot into the
	  command-line.

	  Although flutter-pi is only tested on a Raspberry Pi 4
	  2GB, it should work fine on other linux platforms supported
	  by Flutter so long as there is support for KMS and DRI.

	  https://github.com/ardera/flutter-pi

if BR2_PACKAGE_FLUTTER_PI

comment "plugins"

config BR2_PACKAGE_FLUTTER_PI_CHARSET_CONVERTER_PLUGIN
	bool "charset converter"
	help
	  Adds platform-side implementation of charset_converter plugin.

	  Encode and decode charsets using platform built-in converter.
	  This plugin saves app package size as you don't need external
	  charset maps or whole libraries like iconv.

	  https://pub.dev/packages/charset_converter

config BR2_PACKAGE_FLUTTER_PI_GSTREAMER_AUDIO_PLAYER_PLUGIN
	bool "gstreamer audio player"
	select BR2_PACKAGE_GSTREAMER1
	select BR2_PACKAGE_GST1_PLUGINS_BASE
	select BR2_PACKAGE_GST1_PLUGINS_BASE_PLUGIN_ALSA
	select BR2_PACKAGE_GST1_PLUGINS_BASE_PLUGIN_AUDIOCONVERT
	select BR2_PACKAGE_GST1_PLUGINS_BASE_PLUGIN_AUDIORESAMPLE
	select BR2_PACKAGE_GST1_PLUGINS_BASE_PLUGIN_VOLUME
	help
	  Include the gstreamer based audio plugins in the finished
	  binary.

config BR2_PACKAGE_FLUTTER_PI_GSTREAMER_VIDEO_PLAYER_PLUGIN
	bool "gstreamer video player"
	depends on BR2_PACKAGE_HAS_LIBGLES
	select BR2_PACKAGE_GSTREAMER1
	select BR2_PACKAGE_GST1_PLUGINS_BASE
	select BR2_PACKAGE_GST1_PLUGINS_BASE_LIB_OPENGL
	select BR2_PACKAGE_GST1_PLUGINS_BASE_LIB_OPENGL_GLES2
	select BR2_PACKAGE_GST1_PLUGINS_BASE_PLUGIN_VIDEOCONVERTSCALE
	help
	  Include the gstreamer based video plugins in the finished
	  binary. Allows for more stable, hardware accelerated
	  video playback in flutter using gstreamer.

comment "gstreamer video player plugin needs an OpenGL ES backend"
	depends on !BR2_PACKAGE_HAS_LIBGLES

config BR2_PACKAGE_FLUTTER_PI_RAW_KEYBOARD_PLUGIN
	bool "raw keyboard"
	help
	  Include the raw keyboard plugin in the finished binary.
	  Enables raw keycode listening in flutter via the flutter
	  RawKeyboard interface.

config BR2_PACKAGE_FLUTTER_PI_TEXT_INPUT_PLUGIN
	bool "text input"
	help
	  Include the text input plugin in the finished binary.
	  Enables text input (to flutter text fields, for example)
	  via attached keyboards.

endif

comment "flutter-pi needs a glibc toolchain w/ wchar, C++, gcc >= 5, dynamic library, host gcc >= 5"
	depends on BR2_PACKAGE_HOST_FLUTTER_SDK_BIN_ARCH_SUPPORTS
	depends on BR2_PACKAGE_FLUTTER_ENGINE_ARCH_SUPPORTS
	depends on !BR2_TOOLCHAIN_USES_GLIBC || !BR2_INSTALL_LIBSTDCPP \
		|| !BR2_TOOLCHAIN_GCC_AT_LEAST_5 || BR2_STATIC_LIBS \
		|| !BR2_USE_WCHAR || !BR2_HOST_GCC_AT_LEAST_5

comment "flutter-pi needs a toolchain not affected by GCC bug 64735"
	depends on BR2_PACKAGE_HOST_FLUTTER_SDK_BIN_ARCH_SUPPORTS
	depends on BR2_PACKAGE_FLUTTER_ENGINE_ARCH_SUPPORTS
	depends on BR2_TOOLCHAIN_HAS_GCC_BUG_64735

comment "flutter-pi needs an OpenGL or OpenGLES backend"
	depends on BR2_PACKAGE_HOST_FLUTTER_SDK_BIN_ARCH_SUPPORTS
	depends on BR2_PACKAGE_FLUTTER_ENGINE_ARCH_SUPPORTS
	depends on !BR2_PACKAGE_HAS_LIBGL && !BR2_PACKAGE_HAS_LIBGLES

comment "flutter-pi needs GBM, systemd, and udev"
	depends on !BR2_PACKAGE_HAS_LIBGBM || \
		!BR2_PACKAGE_SYSTEMD || \
		!BR2_PACKAGE_HAS_UDEV
```
