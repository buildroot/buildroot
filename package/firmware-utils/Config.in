## package/flutter-sdk-bin/Config.in.host
```kconfig
config BR2_PACKAGE_HOST_FLUTTER_SDK_BIN_ARCH_SUPPORTS
	bool
	default y if BR2_HOSTARCH = "x86_64"

config BR2_PACKAGE_HOST_FLUTTER_SDK_BIN
	bool "host flutter-sdk-bin"
	depends on BR2_PACKAGE_HOST_FLUTTER_SDK_BIN_ARCH_SUPPORTS
	help
	  Flutter is Google's SDK for crafting beautiful, fast user
	  experiences for mobile, web, and desktop from a single
	  codebase. Flutter works with existing code, is used by
	  developers and organizations around the world, and is
	  free and open source.

	  https://flutter.dev/
```

## package/fmc/Config.in
```kconfig
comment "fmc needs a toolchain w/ C++"
	depends on BR2_powerpc_e500mc || BR2_powerpc_e6500
	depends on !BR2_INSTALL_LIBSTDCPP

comment "fmc needs a Linux kernel to be built"
	depends on BR2_powerpc_e500mc || BR2_powerpc_e6500
	depends on !BR2_LINUX_KERNEL

config BR2_PACKAGE_FMC
	bool "fmc"
	depends on BR2_powerpc_e500mc || BR2_powerpc_e6500
	depends on BR2_INSTALL_LIBSTDCPP
	depends on BR2_LINUX_KERNEL # fmlib
	select BR2_PACKAGE_TCLAP
	select BR2_PACKAGE_LIBXML2
	select BR2_PACKAGE_FMLIB
	help
	  The Frame Manager Configuration tool is Freescale PowerPC
	  platform software package whose primary purpose is converting
	  Parse-Classify-Police-Distribute (PCD) descriptions of network
	  packets flow into hardware configuration. The tool provides an
	  abstraction layer between the end customer's vision of the PCD
	  task definition and real hardware implementation.
	  See application note:
	  https://www.nxp.com/docs/en/application-note/AN4760.pdf

	  https://github.com/nxp-qoriq/fmc
```

## package/fmt/Config.in
```kconfig
config BR2_PACKAGE_FMT
	bool "fmt"

	help
		fmt is an open-source formatting library for C++. It can be used
		as a safe alternative to printf or as a fast alternative to IOStreams.
```

## package/font-awesome/Config.in
```kconfig
config BR2_PACKAGE_FONT_AWESOME
	bool "font-awesome"
	help
	  Font Awesome is a full suite of thousands of pictographic
	  icons for easy scalable vector graphics on websites.

	  https://github.com/FortAwesome/Font-Awesome
```

## package/foot/Config.in
```kconfig
config BR2_PACKAGE_FOOT
	bool "foot"
	depends on BR2_TOOLCHAIN_USES_GLIBC || BR2_TOOLCHAIN_USES_MUSL # fcft
	depends on !BR2_STATIC_LIBS # wayland
	select BR2_PACKAGE_FCFT
	select BR2_PACKAGE_FONTCONFIG
	select BR2_PACKAGE_FREETYPE
	select BR2_PACKAGE_LIBXKBCOMMON
	select BR2_PACKAGE_PIXMAN
	select BR2_PACKAGE_TLLIST
	select BR2_PACKAGE_WAYLAND
	select BR2_PACKAGE_WAYLAND_PROTOCOLS
	help
	  A fast, lightweight and minimalistic Wayland terminal
	  emulator.
	  NOTE: foot needs a working UTF-8 locale (BR2_GENERATE_LOCALE)

	  https://codeberg.org/dnkl/foot

if BR2_PACKAGE_FOOT

config BR2_PACKAGE_FOOT_GRAPHEME_CLUSTERING
	bool "grapheme-clustering"
	select BR2_PACKAGE_UTF8PROC
	help
	  Enables grapheme clustering.

config BR2_PACKAGE_FOOT_THEMES
	bool "themes"
	help
	  Install themes (predefined color schemes)

endif # BR2_PACKAGE_FOOT

comment "foot needs a glibc or musl toolchain w/ dynamic library"
	depends on !(BR2_TOOLCHAIN_USES_GLIBC || BR2_TOOLCHAIN_USES_MUSL) || \
		BR2_STATIC_LIBS
```

## package/forge/Config.in
```kconfig
config BR2_PACKAGE_FORGE
	bool "forge"
	help
	  A native implementation of TLS (and various other
	  cryptographic tools) in JavaScript.

	  https://github.com/digitalbazaar/forge
```

## package/fp16/Config.in
```kconfig
config BR2_PACKAGE_FP16
	bool "fp16"
	select BR2_PACKAGE_PSIMD
	help
	  Header-only library for conversion to/from half-precision
	  floating point formats.

	  https://github.com/Maratyszcza/FP16
```

## package/freeipmi/Config.in
```kconfig
config BR2_PACKAGE_FREEIPMI
	bool "freeipmi"
	depends on BR2_USE_MMU # fork()
	depends on BR2_TOOLCHAIN_HAS_THREADS
	select BR2_PACKAGE_ARGP_STANDALONE if BR2_TOOLCHAIN_USES_UCLIBC || BR2_TOOLCHAIN_USES_MUSL
	help
	  FreeIPMI provides in-band and out-of-band IPMI software based
	  on the IPMI v1.5/2.0 specification.

	  The IPMI specification defines a set of interfaces for
	  platform management and is implemented by a number vendors
	  for system management. The features of IPMI that most users
	  will be interested in are sensor monitoring, system event
	  monitoring, power control, and serial-over-LAN (SOL).

	  https://www.gnu.org/software/freeipmi/

comment "freeipmi needs a toolchain w/ threads"
	depends on BR2_USE_MMU
	depends on !BR2_TOOLCHAIN_HAS_THREADS
```

## package/freeradius-client/Config.in
```kconfig
config BR2_PACKAGE_FREERADIUS_CLIENT
	bool "freeradius-client"
	select BR2_PACKAGE_LIBXCRYPT if BR2_TOOLCHAIN_USES_GLIBC
	help
	  FreeRADIUS Client is a framework and library for
	  writing RADIUS Clients.

	  http://wiki.freeradius.org/project/Radiusclient
```
