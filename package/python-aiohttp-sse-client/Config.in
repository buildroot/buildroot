## package/python-aiohttp-sse-client/Config.in
```kconfig
config BR2_PACKAGE_PYTHON_AIOHTTP_SSE_CLIENT
	bool "python-aiohttp-sse-client"
	select BR2_PACKAGE_PYTHON_AIOHTTP # runtime
	select BR2_PACKAGE_PYTHON_ATTRS # runtime
	select BR2_PACKAGE_PYTHON_MULTIDICT # runtime
	select BR2_PACKAGE_PYTHON_YARL # runtime
	help
	  Server-sent events client support for aiohttp.

	  https://github.com/rtfol/aiohttp-sse-client
```

## package/python-aiohttp-sse/Config.in
```kconfig
config BR2_PACKAGE_PYTHON_AIOHTTP_SSE
	bool "python-aiohttp-sse"
	select BR2_PACKAGE_PYTHON_AIOHTTP # runtime
	help
	  Server-sent events support for aiohttp.

	  https://github.com/aio-libs/aiohttp_sse/
```

## package/python-aiohttp/Config.in
```kconfig
config BR2_PACKAGE_PYTHON_AIOHTTP
	bool "python-aiohttp"
	select BR2_PACKAGE_PYTHON_AIODNS # runtime
	select BR2_PACKAGE_PYTHON_AIOSIGNAL # runtime
	select BR2_PACKAGE_PYTHON_ASYNC_TIMEOUT # runtime
	select BR2_PACKAGE_PYTHON_ATTRS # runtime
	select BR2_PACKAGE_PYTHON_BROTLI # runtime
	select BR2_PACKAGE_PYTHON_FROZENLIST # runtime
	select BR2_PACKAGE_PYTHON_MULTIDICT # runtime
	select BR2_PACKAGE_PYTHON_YARL # runtime
	select BR2_PACKAGE_PYTHON3_ZLIB # runtime
	help
	  Async http client/server framework (asyncio).

	  https://github.com/aio-libs/aiohttp
```

## package/python-aiojobs/Config.in
```kconfig
config BR2_PACKAGE_PYTHON_AIOJOBS
	bool "python-aiojobs"
	help
	  Jobs scheduler for managing background task (asyncio).

	  https://github.com/aio-libs/aiojobs
```

## package/python-aiomonitor/Config.in
```kconfig
config BR2_PACKAGE_PYTHON_AIOMONITOR
	bool "python-aiomonitor"
	select BR2_PACKAGE_PYTHON_AIOCONSOLE # runtime
	select BR2_PACKAGE_PYTHON_AIOHTTP # runtime
	select BR2_PACKAGE_PYTHON_ATTRS # runtime
	select BR2_PACKAGE_PYTHON_CLICK # runtime
	select BR2_PACKAGE_PYTHON_JANUS # runtime
	select BR2_PACKAGE_PYTHON_JINJA2 # runtime
	select BR2_PACKAGE_PYTHON_PROMPT_TOOLKIT # runtime
	select BR2_PACKAGE_PYTHON_TERMINALTABLES # runtime
	select BR2_PACKAGE_PYTHON_TRAFARET # runtime
	select BR2_PACKAGE_PYTHON_TYPING_EXTENSIONS # runtime
	help
	  aiomonitor adds monitor and python REPL capabilities for
	  asyncio application.

	  https://github.com/aio-libs/aiomonitor
```

## package/python-aiomqtt/Config.in
```kconfig
config BR2_PACKAGE_PYTHON_AIOMQTT
	bool "python-aiomqtt"
	select BR2_PACKAGE_PYTHON_PAHO_MQTT # runtime
	select BR2_PACKAGE_PYTHON3_SSL # runtime
	help
	  The idiomatic asyncio MQTT client, wrapped around paho-mqtt.

	  https://github.com/empicano/aiomqtt
```

## package/python-aioprocessing/Config.in
```kconfig
config BR2_PACKAGE_PYTHON_AIOPROCESSING
	bool "python-aioprocessing"
	help
	  A Python 3.5+ library that integrates the multiprocessing
	  module with asyncio.

	  https://github.com/dano/aioprocessing
```

## package/python-aiorwlock/Config.in
```kconfig
config BR2_PACKAGE_PYTHON_AIORWLOCK
	bool "python-aiorwlock"
	help
	  Read write lock for asyncio.

	  https://github.com/aio-libs/aiorwlock
```

## package/python-aiosignal/Config.in
```kconfig
config BR2_PACKAGE_PYTHON_AIOSIGNAL
	bool "python-aiosignal"
	select BR2_PACKAGE_PYTHON_FROZENLIST # runtime
	help
	  aiosignal: a list of registered asynchronous callbacks.

	  https://github.com/aio-libs/aiosignal
```

## package/python-aiosqlite/Config.in
```kconfig
config BR2_PACKAGE_PYTHON_AIOSQLITE
	bool "python-aiosqlite"
	select BR2_PACKAGE_PYTHON3_SQLITE # runtime
	help
	  aiosqlite provides a friendly, async interface to sqlite
	  databases.

	  https://aiosqlite.omnilib.dev
```

## package/python-alembic/Config.in
```kconfig
config BR2_PACKAGE_PYTHON_ALEMBIC
	bool "python-alembic"
	select BR2_PACKAGE_PYTHON_MAKO # runtime
	select BR2_PACKAGE_PYTHON_SQLALCHEMY # runtime
	select BR2_PACKAGE_PYTHON_TYPING_EXTENSIONS # runtime
	help
	  Alembic is a database migrations tool written by the author
	  of SQLAlchemy.

	  https://alembic.sqlalchemy.org
```

## package/python-aniso8601/Config.in
```kconfig
config BR2_PACKAGE_PYTHON_ANISO8601
	bool "python-aniso8601"
	help
	  A library for parsing ISO 8601 strings.

	  https://codeberg.org/nielsenb-jf/aniso8601
```

## package/python-annotated-doc/Config.in
```kconfig
config BR2_PACKAGE_PYTHON_ANNOTATED_DOC
	bool "python-annotated-doc"
	help
	  Document parameters, class attributes, return types, and
	  variables inline, with Annotated.

	  https://github.com/fastapi/annotated-doc
```

## package/python-annotated-types/Config.in
```kconfig
config BR2_PACKAGE_PYTHON_ANNOTATED_TYPES
	bool "python-annotated-types"
	help
	  Reusable constraint types to use with typing.Annotated.

	  https://github.com/annotated-types/annotated-types
```

## package/python-anyio/Config.in
```kconfig
config BR2_PACKAGE_PYTHON_ANYIO
	bool "python-anyio"
	select BR2_PACKAGE_PYTHON_IDNA # runtime
	select BR2_PACKAGE_PYTHON_SNIFFIO # runtime
	select BR2_PACKAGE_PYTHON_TYPING_EXTENSIONS # runtime
	help
	  High level compatibility layer for multiple asynchronous
	  event loop implementations.

	  https://github.com/agronholm/anyio
```

## package/python-apispec/Config.in
```kconfig
config BR2_PACKAGE_PYTHON_APISPEC
	bool "python-apispec"
	select BR2_PACKAGE_PYTHON_PACKAGING # runtime
	help
	  A pluggable API specification generator. Currently supports
	  the OpenAPI Specification (f.k.a. the Swagger
	  specification).

	  https://github.com/marshmallow-code/apispec
```

## package/python-appdirs/Config.in
```kconfig
config BR2_PACKAGE_PYTHON_APPDIRS
	bool "python-appdirs"
	help
	  A small Python module for determining appropriate platform-
	  specific dirs, e.g. a "user data dir".

	  http://github.com/ActiveState/appdirs
```

## package/python-apscheduler/Config.in
```kconfig
config BR2_PACKAGE_PYTHON_APSCHEDULER
	bool "python-apscheduler"
	select BR2_PACKAGE_PYTHON_TZLOCAL # runtime
	help
	  Task scheduling library for Python.

	  https://apscheduler.readthedocs.io
```

## package/python-argcomplete/Config.in
```kconfig
config BR2_PACKAGE_PYTHON_ARGCOMPLETE
	bool "python-argcomplete"
	help
	  Bash tab completion for argparse.

	  https://github.com/kislyuk/argcomplete
```

## package/python-argon2-cffi-bindings/Config.in
```kconfig
config BR2_PACKAGE_PYTHON_ARGON2_CFFI_BINDINGS
	bool "python-argon2-cffi-bindings"
	depends on BR2_USE_MMU # libargon2
	depends on !BR2_STATIC_LIBS # libargon2
	select BR2_PACKAGE_PYTHON_CFFI # runtime
	select BR2_PACKAGE_LIBARGON2
	help
	  Low-level CFFI bindings for Argon2.

	  https://github.com/hynek/argon2-cffi-bindings
```

## package/python-argon2-cffi/Config.in
```kconfig
config BR2_PACKAGE_PYTHON_ARGON2_CFFI
	bool "python-argon2-cffi"
	depends on BR2_USE_MMU # python-argon2-cffi-bindings
	depends on !BR2_STATIC_LIBS # python-argon2-cffi-bindings
	select BR2_PACKAGE_PYTHON_ARGON2_CFFI_BINDINGS # runtime
	help
	  The secure Argon2 password hashing algorithm.

	  https://argon2-cffi.readthedocs.io/
```

## package/python-arrow/Config.in
```kconfig
config BR2_PACKAGE_PYTHON_ARROW
	bool "python-arrow"
	depends on BR2_PACKAGE_PYTHON3
	select BR2_PACKAGE_PYTHON_DATEUTIL # runtime
	help
	  Better dates and times for Python.

	  https://github.com/crsmithdev/arrow/
```

## package/python-asttokens/Config.in
```kconfig
config BR2_PACKAGE_PYTHON_ASTTOKENS
	bool "python-asttokens"
	help
	  Annotate AST trees with source code positions.

	  https://github.com/gristlabs/asttokens
```

## package/python-async-generator/Config.in
```kconfig
config BR2_PACKAGE_PYTHON_ASYNC_GENERATOR
	bool "python-async-generator"
	help
	  Async generators and context managers for Python 3.5+.

	  https://github.com/python-trio/async_generator
```

## package/python-async-lru/Config.in
```kconfig
config BR2_PACKAGE_PYTHON_ASYNC_LRU
	bool "python-async-lru"
	help
	  Simple lru_cache for asyncio.

	  https://github.com/aio-libs/async_lru
```
