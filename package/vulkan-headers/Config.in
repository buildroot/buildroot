## package/webbridge/plugins/ResourceCenter/Config.in
```kconfig
choice
	prompt "Implementation"
	default BR2_PACKAGE_WEBBRIDGE_PLUGIN_RESOURCECENTER_STUB
	default BR2_PACKAGE_WEBBRIDGE_PLUGIN_RESOURCECENTER_NEXUS		if BR2_PACKAGE_BCM_REFSW
	help
	  Select the implementaion of ResourceCenter you wish to use.
	  
	config BR2_PACKAGE_WEBBRIDGE_PLUGIN_RESOURCECENTER_NEXUS
		bool "Nexus"
		depends on BR2_PACKAGE_BCM_REFSW
		help
		  Needed if using a Nexus based platfom
		  
	config BR2_PACKAGE_WEBBRIDGE_PLUGIN_RESOURCECENTER_STUB
		bool "Stub"
		help
		  Stubed implementation for resource center. 
endchoice

config BR2_PACKAGE_WEBBRIDGE_PLUGIN_RESOURCECENTER_IMPLEMENTATION
	string
	default "Stub"	    if BR2_PACKAGE_WEBBRIDGE_PLUGIN_RESOURCECENTER_STUB
	default "Nexus"		if BR2_PACKAGE_WEBBRIDGE_PLUGIN_RESOURCECENTER_NEXUS

if BR2_PACKAGE_WEBBRIDGE_PLUGIN_RESOURCECENTER_NEXUS
choice
	prompt "Nexus server"
	default BR2_PACKAGE_WEBBRIDGE_PLUGIN_RESOURCECENTER_SERVICE_EXTERNAL
	help
	  Choose this if the system has a allready a resource server running like nxserver.
	  
	config BR2_PACKAGE_WEBBRIDGE_PLUGIN_RESOURCECENTER_SERVICE_EXTERNAL
		bool "external" 
		
	config BR2_PACKAGE_WEBBRIDGE_PLUGIN_RESOURCECENTER_SERVICE_INTERNAL
		bool "internal"
endchoice
endif

config BR2_PACKAGE_WEBBRIDGE_PLUGIN_RESOURCECENTER_SERVICE
	string
	default "external"	    if BR2_PACKAGE_WEBBRIDGE_PLUGIN_RESOURCECENTER_SERVICE_EXTERNAL
	default "internal"		if BR2_PACKAGE_WEBBRIDGE_PLUGIN_RESOURCECENTER_SERVICE_INTERNAL

config BR2_PACKAGE_WEBBRIDGE_PLUGIN_RESOURCECENTER_OUTOFPROCESS
	bool "Out of process"
	help
	  Select this to run this plugin in its own process. 

config BR2_PACKAGE_WEBBRIDGE_PLUGIN_RESOURCECENTER_AUTOTRACE
	bool "Automatically enable tracing"
	help
	  Enables the pluging to start tracing from the start.

config BR2_PACKAGE_WEBBRIDGE_PLUGIN_RESOURCECENTER_HARDWAREREADY
	string "Manual overrule of the time it takes to initialisize all hardware (ms)"
	default 0

config BR2_PACKAGE_WEBBRIDGE_PLUGIN_RESOURCECENTER_SYSTEM
	string "Callsign to report information."
	default Controller
```

## package/webdriver/Config.in
```kconfig
config BR2_PACKAGE_WEBDRIVER
        select BR2_PACKAGE_JSON_C
        select BR2_PACKAGE_LIBCURL
        bool "webdriver"
        help
           This is a tool for automating web application testing,
	   and in particular to verify that they work as expected.
	   It aims to provide a friendly API that's easy to explore and understand,
	   easier to use than the Selenium-RC (1.0) API, 
	   which will help to make your tests easier to read and maintain.
```

## package/webrtc-audio-processing/Config.in
```kconfig
config BR2_PACKAGE_WEBRTC_AUDIO_PROCESSING_ARCH_SUPPORTS
	bool
	default y if BR2_aarch64 || BR2_arm || BR2_i386 || BR2_x86_64

config BR2_PACKAGE_WEBRTC_AUDIO_PROCESSING
	bool "webrtc-audio-processing"
	depends on BR2_PACKAGE_WEBRTC_AUDIO_PROCESSING_ARCH_SUPPORTS
	depends on BR2_PACKAGE_LIBABSEIL_CPP_ARCH_SUPPORTS
	depends on BR2_INSTALL_LIBSTDCPP
	depends on BR2_TOOLCHAIN_GCC_AT_LEAST_8 # libabseil-cpp
	# pthread_condattr_setclock
	depends on BR2_TOOLCHAIN_HAS_THREADS_NPTL
	depends on !BR2_STATIC_LIBS # libabseil-cpp
	select BR2_PACKAGE_LIBABSEIL_CPP
	help
	  AudioProcessing library based on Google's implementation of
	  WebRTC.

	  http://freedesktop.org/software/pulseaudio/webrtc-audio-processing/

comment "webrtc-audio-processing needs a toolchain w/ C++, NPTL, dynamic library, gcc >= 8"
	depends on BR2_PACKAGE_WEBRTC_AUDIO_PROCESSING_ARCH_SUPPORTS
	depends on BR2_PACKAGE_LIBABSEIL_CPP_ARCH_SUPPORTS
	depends on !BR2_INSTALL_LIBSTDCPP || !BR2_TOOLCHAIN_HAS_THREADS_NPTL \
		|| BR2_STATIC_LIBS || !BR2_TOOLCHAIN_GCC_AT_LEAST_8
```

## package/websocketd/Config.in
```kconfig
config BR2_PACKAGE_WEBSOCKETD
	bool "websocketd"
	help
	  Turn any program that uses STDIN/STDOUT into
	  a WebSocket server.

	  http://websocketd.com/
```

## package/websocketpp/Config.in
```kconfig
config BR2_PACKAGE_WEBSOCKETPP
    bool "websocketpp"
    help
        C++ websocket client/server library http://www.zaphoyd.com/websocketpp
```

## package/westeros-dispmanx/Config.in
```kconfig
config BR2_PACKAGE_WESTEROS_DISPMANX
	bool "westeros-dispmanx"
	depends on BR2_PACKAGE_WESTEROS_SOC_RPI
	help
	  http://wayland.freedesktop.org/
```

## package/westeros-simplebuffer/Config.in
```kconfig
config BR2_PACKAGE_WESTEROS_SIMPLEBUFFER
	bool "westeros-simplebuffer"
	select BR2_PACKAGE_WAYLAND
	select BR2_PACKAGE_WAYLAND_PROTOCOLS
	help
          http://wayland.freedesktop.org/
```

## package/westeros-simpleshell/Config.in
```kconfig
config BR2_PACKAGE_WESTEROS_SIMPLESHELL
	bool "westeros-simpleshell"
	select BR2_PACKAGE_WAYLAND
	select BR2_PACKAGE_WAYLAND_PROTOCOLS
	select BR2_PACKAGE_LIBXKBCOMMON
	help
          http://wayland.freedesktop.org/
```

## package/westeros-soc/Config.in
```kconfig
config BR2_PACKAGE_WESTEROS_SOC
	bool "westeros-soc"
	select BR2_PACKAGE_WAYLAND
	select BR2_PACKAGE_WAYLAND_PROTOCOLS
	select BR2_PACKAGE_WAYLAND_EGL_BNXS if BR2_PACKAGE_HAS_NEXUS
	help
	  http://wayland.freedesktop.org/
```

## package/westeros/Config.in
```kconfig
config BR2_PACKAGE_WESTEROS
	bool "westeros"
	select BR2_PACKAGE_WAYLAND
	select BR2_PACKAGE_WAYLAND_PROTOCOLS
	select BR2_PACKAGE_LIBXKBCOMMON
	select BR2_PACKAGE_XKEYBOARD_CONFIG
	select BR2_PACKAGE_WESTEROS_SIMPLEBUFFER
	select BR2_PACKAGE_WESTEROS_SIMPLESHELL
	select BR2_PACKAGE_WESTEROS_SOC
	select BR2_PACKAGE_WESTEROS_SINK
	select BR2_PACKAGE_WESTEROS_ESSOS
	help

	  Westeros is an open source Wayland compositor library that allows
          applications to create Wayland displays including embedded
          Wayland displays
          http://wayland.freedesktop.org/

if BR2_PACKAGE_WESTEROS
	config BR2_PACKAGE_WESTEROS_ESSOS
	bool "westeros essos support"
	help
	 Enable essos in westeros

	source "package/westeros-simpleshell/Config.in"	
	source "package/westeros-simplebuffer/Config.in"
	source "package/westeros-soc/Config.in"
	source "package/westeros-sink/Config.in"
endif #BR2_PACKAGE_WESTEROS
```

## package/weston/Config.in
```kconfig
comment "weston needs udev and a toolchain w/ locale, threads, dynamic library, headers >= 3.0"
	depends on !BR2_PACKAGE_HAS_UDEV || !BR2_TOOLCHAIN_HAS_THREADS || \
		!BR2_TOOLCHAIN_HEADERS_AT_LEAST_3_0 || BR2_STATIC_LIBS || \
		!BR2_ENABLE_LOCALE

config BR2_PACKAGE_WESTON
	bool "weston"
	depends on BR2_PACKAGE_HAS_UDEV
	depends on !BR2_STATIC_LIBS # wayland
	depends on BR2_TOOLCHAIN_HAS_THREADS # wayland
	depends on BR2_TOOLCHAIN_HEADERS_AT_LEAST_3_0
	select BR2_PACKAGE_WAYLAND
	select BR2_PACKAGE_WAYLAND_PROTOCOLS
	select BR2_PACKAGE_LIBXKBCOMMON
	select BR2_PACKAGE_CAIRO
	select BR2_PACKAGE_CAIRO_PNG
	select BR2_PACKAGE_LIBPNG
	select BR2_PACKAGE_JPEG
	select BR2_PACKAGE_LIBINPUT
	select BR2_PACKAGE_LIBDRM
	# Runtime dependency
	select BR2_PACKAGE_XKEYBOARD_CONFIG
	select BR2_PACKAGE_WESTON_SHELL_DESKTOP if !BR2_PACKAGE_WESTON_HAS_SHELL
	help
	  Weston is the reference implementation of a Wayland
	  compositor, and a useful compositor in its own right.
	  Weston has various backends that lets it run on Linux kernel
	  modesetting and evdev input as well as under X11.

	  http://wayland.freedesktop.org/

if BR2_PACKAGE_WESTON

choice
	prompt "default compositor"

config BR2_PACKAGE_WESTON_DEFAULT_DRM
	bool "drm"
	select BR2_PACKAGE_WESTON_DRM

config BR2_PACKAGE_WESTON_DEFAULT_HEADLESS
	bool "headless"
	select BR2_PACKAGE_WESTON_HEADLESS

config BR2_PACKAGE_WESTON_DEFAULT_WAYLAND
	bool "wayland (nested)"
	select BR2_PACKAGE_WESTON_WAYLAND

config BR2_PACKAGE_WESTON_DEFAULT_X11
	bool "X11 (nested)"
	depends on BR2_PACKAGE_XORG7
	select BR2_PACKAGE_WESTON_X11

comment "X11 (nested) backend needs X.org"
	depends on !BR2_PACKAGE_XORG7

endchoice

config BR2_PACKAGE_WESTON_DEFAULT_COMPOSITOR
	string
	default "drm"      if BR2_PACKAGE_WESTON_DEFAULT_DRM
	default "headless" if BR2_PACKAGE_WESTON_DEFAULT_HEADLESS
	default "wayland"  if BR2_PACKAGE_WESTON_DEFAULT_WAYLAND
	default "x11"      if BR2_PACKAGE_WESTON_DEFAULT_X11

config BR2_PACKAGE_WESTON_DRM
	bool "DRM compositor"

# FreeRDP needs threads and !static, already the case for weston
config BR2_PACKAGE_WESTON_RDP
	bool "RDP compositor"
	depends on BR2_USE_MMU # freerdp, libglib2
	depends on BR2_TOOLCHAIN_HAS_SYNC_4
	depends on BR2_USE_WCHAR # freerdp
	depends on BR2_INSTALL_LIBSTDCPP # freerdp
	select BR2_PACKAGE_FREERDP
	help
	  This enables the RDP backend, which allows accessing weston
	  through the network with any RDP-compliant client.

	  Please note that one must pass those options to weston for RDP
	  to be functional:
	    --rdp-tls-cert=/path/to/server.crt
	    --rdp-tls-key=/path/to/server.key

	  By default, Buildroot installs such files in
	  /etc/freerdp/server/ so you may want to change them in a
	  post-build script or a rootfs overlay.

comment "RDP compositor needs a toolchain w/ wchar, C++"
	depends on BR2_USE_MMU
	depends on BR2_TOOLCHAIN_HAS_SYNC_4
	depends on !BR2_USE_WCHAR || !BR2_INSTALL_LIBSTDCPP

config BR2_PACKAGE_WESTON_HEADLESS
	bool "headless (testing) compositor"

config BR2_PACKAGE_WESTON_WAYLAND
	bool "Wayland (nested) compositor"

config BR2_PACKAGE_WESTON_X11
	bool "X11 (nested) compositor"
	depends on BR2_PACKAGE_XORG7
	select BR2_PACKAGE_LIBXCB
	select BR2_PACKAGE_XLIB_LIBX11

comment "X11 (nested) compositor needs X.org enabled"
	depends on !BR2_PACKAGE_XORG7

config BR2_PACKAGE_WESTON_XWAYLAND
	bool "XWayland support"
	depends on BR2_PACKAGE_XORG7
	depends on BR2_PACKAGE_LIBEPOXY
	select BR2_PACKAGE_CAIRO
	select BR2_PACKAGE_LIBXCB
	select BR2_PACKAGE_XLIB_LIBX11
	select BR2_PACKAGE_XLIB_LIBXCURSOR

comment "XWayland support needs libepoxy and X.org enabled"
	depends on !BR2_PACKAGE_XORG7 || !BR2_PACKAGE_LIBEPOXY

# Weston needs at least one shell; this can be one of the bundled ones,
# below, of from a third-party package, which should then select this.
config BR2_PACKAGE_WESTON_HAS_SHELL
	bool

config BR2_PACKAGE_WESTON_SHELL_DESKTOP
	bool "desktop shell"
	default y

config BR2_PACKAGE_WESTON_SHELL_FULLSCREEN
	bool "fullscreen shell"
	default y
	select BR2_PACKAGE_WESTON_HAS_SHELL

config BR2_PACKAGE_WESTON_SHELL_IVI
	bool "ivi shell"
	default y
	select BR2_PACKAGE_WESTON_HAS_SHELL

config BR2_PACKAGE_WESTON_SHELL_KIOSK
	bool "kiosk shell"
	default y
	select BR2_PACKAGE_WESTON_HAS_SHELL

config BR2_PACKAGE_WESTON_DEMO_CLIENTS
	bool "demo clients"
	depends on BR2_USE_MMU # pango
	depends on BR2_TOOLCHAIN_HAS_SYNC_4 # pango
	depends on BR2_TOOLCHAIN_GCC_AT_LEAST_4_9 # pango
	depends on BR2_INSTALL_LIBSTDCPP # pango
	depends on BR2_TOOLCHAIN_HAS_THREADS # pango
	depends on BR2_USE_WCHAR # pango
	depends on BR2_PACKAGE_HAS_LIBGLES
	depends on BR2_PACKAGE_HAS_LIBEGL_WAYLAND
	select BR2_PACKAGE_PANGO
	help
	  This enables the installation of Weston's demo clients.

comment "demo clients needs an OpenGL ES provider, an OpenEGL-capable Wayland backend and a toolchain w/ wchar, threads, C++, gcc >= 4.9"
	depends on BR2_USE_MMU
	depends on BR2_TOOLCHAIN_HAS_SYNC_4
	depends on !BR2_INSTALL_LIBSTDCPP || !BR2_TOOLCHAIN_HAS_THREADS || \
		!BR2_USE_WCHAR || !BR2_PACKAGE_HAS_LIBGLES || \
		!BR2_PACKAGE_HAS_LIBEGL_WAYLAND || !BR2_TOOLCHAIN_GCC_AT_LEAST_4_9

endif
```

## package/wget/Config.in
```kconfig
config BR2_PACKAGE_WGET
	bool "wget"
	# fork()
	depends on BR2_USE_MMU
	depends on BR2_USE_WCHAR
	depends on BR2_PACKAGE_BUSYBOX_SHOW_OTHERS
	select BR2_PACKAGE_LIBOPENSSL_ENABLE_DES if BR2_PACKAGE_LIBOPENSSL
	select BR2_PACKAGE_LIBOPENSSL_ENABLE_MD4 if BR2_PACKAGE_LIBOPENSSL
	help
	  Network utility to retrieve files from http, https and ftp.

	  http://www.gnu.org/software/wget/

comment "wget needs a toolchain w/ wchar"
	depends on BR2_USE_MMU
	depends on !BR2_USE_WCHAR
	depends on BR2_PACKAGE_BUSYBOX_SHOW_OTHERS
```

## package/wget2/Config.in
```kconfig
config BR2_PACKAGE_WGET2
	bool "wget2"
	depends on BR2_USE_MMU # fork()
	depends on BR2_USE_WCHAR
	select BR2_PACKAGE_OPENSSL if !BR2_PACKAGE_GNUTLS
	select BR2_PACKAGE_LIBOPENSSL_ENABLE_RMD160 if BR2_PACKAGE_LIBOPENSSL
	help
	  GNU Wget2 is the successor of GNU Wget, a file and recursive
	  website downloader.

	  https://gitlab.com/gnuwget/wget2

comment "wget2 needs a toolchain w/ wchar"
	depends on BR2_USE_MMU
	depends on !BR2_USE_WCHAR
```

## package/whois/Config.in
```kconfig
config BR2_PACKAGE_WHOIS
	bool "whois"
	depends on BR2_PACKAGE_BUSYBOX_SHOW_OTHERS
	select BR2_PACKAGE_LIBXCRYPT if BR2_TOOLCHAIN_USES_GLIBC
	help
	  Improved whois client.

	  https://github.com/rfc1036/whois
```

## package/widevine/Config.in
```kconfig
config BR2_PACKAGE_WIDEVINE
    depends on BR2_PACKAGE_WPEFRAMEWORK_CDMI_WIDEVINE
	select BR2_PACKAGE_HAS_WIDEVINE
	select BR2_PACKAGE_WIDEVINE_SOC_WPE
	select BR2_PACKAGE_PROTOBUF
	select BR2_PACKAGE_WPEFRAMEWORK_CLIENTLIBRARIES
	select BR2_PACKAGE_WPEFRAMEWORK_PROVISIONING
	select BR2_PACKAGE_WPEFRAMEWORK_PROVISIONING_WIDEVINE
        bool "Widevine"
        help
           Widevine DRM solution provides the capability to license, securely distribute and protect
           playback of content on any consumer device.

if BR2_PACKAGE_WIDEVINE
config BR2_PACKAGE_WIDEVINE_INSTALL_UT
    bool "Unit tests"
    help
     Install a unit test binary "widevine_ce_cdm_unittest" on the target device.

config BR2_ENABLE_PROVISIONING_APP
    bool "Provioning App"
    select BR2_PACKAGE_LIBCURL
    help
     Install a widevine provisioning app on the target device.

choice BR2_PACKAGE_WIDEVINE_BUILD_TYPE
    prompt "Build type"
    default BR2_PACKAGE_WIDEVINE_BUILD_TYPE_RELEASE
    help
      Select the type of build you want to use.

config BR2_PACKAGE_WIDEVINE_BUILD_TYPE_DEBUG
    bool "Debug"

config BR2_PACKAGE_WIDEVINE_BUILD_TYPE_RELEASE
    bool "Release"

endchoice

endif

config BR2_PACKAGE_HAS_WIDEVINE
        bool

config BR2_PACKAGE_WIDEVINE_SOC_WPE
	bool
```
