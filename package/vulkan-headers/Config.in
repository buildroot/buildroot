## package/vulkan-headers/Config.in
```kconfig
config BR2_PACKAGE_VULKAN_HEADERS
	bool "vulkan-headers"
	depends on BR2_INSTALL_LIBSTDCPP
	help
	  The Khronos official Vulkan header files and API
	  registry.

	  https://github.com/KhronosGroup/Vulkan-Headers

comment "vulkan-headers needs a toolchain w/ C++"
	depends on !BR2_INSTALL_LIBSTDCPP
```

## package/vulkan-loader/Config.in
```kconfig
config BR2_PACKAGE_VULKAN_LOADER
	bool "vulkan-loader"
	depends on BR2_INSTALL_LIBSTDCPP
	depends on !BR2_STATIC_LIBS # dlfcn.h
	depends on BR2_TOOLCHAIN_HAS_THREADS
	select BR2_PACKAGE_VULKAN_HEADERS
	help
	  The Khronos official Vulkan ICD desktop loader.

	  https://github.com/KhronosGroup/Vulkan-Loader

comment "vulkan-loader needs a toolchain w/ C++, dynamic library, threads"
	depends on !BR2_INSTALL_LIBSTDCPP || BR2_STATIC_LIBS || \
		!BR2_TOOLCHAIN_HAS_THREADS
```

## package/vulkan-sdk/Config.in
```kconfig
config BR2_PACKAGE_VULKAN_SDK
	bool "vulkan-sdk"
	depends on !BR2_STATIC_LIBS # dlfcn.h
	depends on BR2_INSTALL_LIBSTDCPP # C++
	select BR2_PACKAGE_VULKAN_HEADERS
	help
	  The Vulkan meta-loader

	  https://github.com/zeux/volk

comment "Vulkan-SDK needs toolchain w/ C++, dynamic library"
	depends on !BR2_INSTALL_LIBSTDCPP || BR2_STATIC_LIBS
```

## package/vulkan-tools/Config.in
```kconfig
config BR2_PACKAGE_VULKAN_TOOLS
	bool "vulkan-tools"
	depends on BR2_INSTALL_LIBSTDCPP # vulkan-loader
	depends on !BR2_STATIC_LIBS # vullan-loader
	depends on BR2_TOOLCHAIN_GCC_AT_LEAST_4_9 # C++11
	depends on BR2_TOOLCHAIN_HAS_THREADS # vulkan-loader
	select BR2_PACKAGE_VULKAN_HEADERS
	select BR2_PACKAGE_VULKAN_LOADER

	help
	  The Khronos official Vulkan Tools and Utilities.

	  https://github.com/KhronosGroup/Vulkan-Tools

comment "vulkan-tools needs a toolchain w/ C++, dynamic library, threads, gcc >= 4.9"
	depends on !BR2_INSTALL_LIBSTDCPP || BR2_STATIC_LIBS || \
		!BR2_TOOLCHAIN_HAS_THREADS || !BR2_TOOLCHAIN_GCC_AT_LEAST_4_9
```

## package/watchdogd/Config.in
```kconfig
config BR2_PACKAGE_WATCHDOGD
	bool "watchdogd"
	depends on BR2_USE_MMU # fork()
	select BR2_PACKAGE_LIBCONFUSE
	select BR2_PACKAGE_LIBITE
	select BR2_PACKAGE_LIBUEV
	help
	  Extended version of uClinux-dist watchdogd.  Monitors loadavg,
	  file descriptors and memory leaks, and capable of supervising
	  your processes main loop using an instrumentation API.

	  A reset reason is saved for power loss, CPU overload, or any
	  of the monitored conditions (above).	The full capabilities
	  are limited by the kernel watchdog driver, but even the basic
	  "softdog" driver is supported.  See /etc/watchdogd.conf for
	  details, and try watchdogctl for system status and available
	  commands.

	  https://github.com/troglobit/watchdogd/

if BR2_PACKAGE_WATCHDOGD

config BR2_PACKAGE_WATCHDOGD_TEST_SUITE
	bool "Enable watchdogctl test cases"
	help
	  The watchdogctl program comes with a suite of tests built-in.
	  They can be used to verify correct operation of watchdogd and
	  the kernel watchdog driver.

config BR2_PACKAGE_WATCHDOGD_GENERIC
	bool "Generic script monitor"
	default y if BR2_PACKAGE_WATCHDOGD_GENERIC_POLL_WRAP # legacy 2024.02
	help
	  Enable generic script monitor.

config BR2_PACKAGE_WATCHDOGD_LOADAVG
	bool "CPU load average monitor"
	default y if BR2_PACKAGE_WATCHDOGD_LOADAVG_POLL_WRAP # legacy 2024.02
	help
	  Enable CPU load average monitor.

config BR2_PACKAGE_WATCHDOGD_FILENR
	bool "File descriptor leak monitor"
	default y if BR2_PACKAGE_WATCHDOGD_FILENR_POLL_WRAP # legacy 2024.02
	help
	  Enable file descriptor leak monitor.

config BR2_PACKAGE_WATCHDOGD_MEMINFO
	bool "Memory leak monitor"
	default y if BR2_PACKAGE_WATCHDOGD_MEMINFO_POLL_WRAP # legacy 2024.02
	help
	  Enable memory leak monitor.

config BR2_PACKAGE_WATCHDOGD_FSMON
	bool "File system monitor"
	help
	  Enable file system monitor.

config BR2_PACKAGE_WATCHDOGD_TEMPMON
	bool "Temperature monitor"
	help
	  Enable temperature monitor.

endif
```

## package/wavemon/Config.in
```kconfig
config BR2_PACKAGE_WAVEMON
	bool "wavemon"
	depends on BR2_TOOLCHAIN_HAS_THREADS
	depends on !BR2_STATIC_LIBS # libnl tools
	select BR2_PACKAGE_NCURSES
	select BR2_PACKAGE_LIBNL
	select BR2_PACKAGE_LIBNL_TOOLS
	help
	  wavemon is a wireless device monitoring application that
	  allows you to watch signal and noise levels, packet
	  statistics, device configuration and network parameters of
	  your wireless network hardware.

	  Note that you need a Linux Kernel configuration with
	  wireless extensions or with wireless extensions
	  compatibility enabled.

	  https://github.com/uoaerg/wavemon

comment "wavemon needs a toolchain w/ threads, dynamic library"
	depends on !BR2_TOOLCHAIN_HAS_THREADS || BR2_STATIC_LIBS
```

## package/wayland-egl-bnxs/Config.in
```kconfig
config BR2_PACKAGE_WAYLAND_EGL_BNXS
	bool "wayland-egl-bnxs"
	depends on BR2_PACKAGE_BCM_REFSW
	select BR2_PACKAGE_WAYLAND
	select BR2_PACKAGE_WAYLAND_PROTOCOLS
	help

	  Broadcom wayland EGL for refsw 15.x,16.x
```

## package/wayland-utils/Config.in
```kconfig
config BR2_PACKAGE_WAYLAND_UTILS
	bool "wayland-utils"
	depends on BR2_PACKAGE_WAYLAND # wayland-client, wayland-server
	help
	  Wayland utils (wayland-info).

	  https://gitlab.freedesktop.org/ofourdan/wayland-utils
```

## package/wdmp-c/Config.in
```kconfig
config BR2_PACKAGE_WDMP_C
    bool "wdmp-c"
    default n
    help
     C library for WebPA Data Model Parser (WDMP)
```

## package/webbridge/Config.in
```kconfig
config BR2_PACKAGE_WEBBRIDGE
	bool "webbridge"
	select BR2_PACKAGE_CPPSDK
	select BR2_PACKAGE_CPPSDK_WEBSOCKET
	select BR2_PACKAGE_CPPSDK_TRACING
	select BR2_PACKAGE_CPPSDK_RPC
	help
	  This application allows plugins to be hosted in a process that 
	  handles webrequest and websockets. 

	  The webrequest and websocket serialization and deserialization
	  are part of the WebBridge. The plugin will receive objects and
	  can send back the objects over a socket connection.

if BR2_PACKAGE_WEBBRIDGE

menu "Options"

config BR2_PACKAGE_WEBBRIDGE_PORT
	string "port"
	default "80"

config BR2_PACKAGE_WEBBRIDGE_BIND
	string "bind"
	default "0.0.0.0"

config BR2_PACKAGE_WEBBRIDGE_INTERFACE
	string "interface"
	default ""

config BR2_PACKAGE_WEBBRIDGE_IDLE_TIME
	string "idle-time"
	default "180"

config BR2_PACKAGE_WEBBRIDGE_PERSISTENT_PATH
	string "persistent path"
	default "/root"

config BR2_PACKAGE_WEBBRIDGE_DATA_PATH
	string "data path"
	default "/usr/share/webbridge"

config BR2_PACKAGE_WEBBRIDGE_SYSTEM_PATH
	string "system path"
	default "/usr/lib/webbridge"

config BR2_PACKAGE_WEBBRIDGE_PROXYSTUB_PATH
	string "proxystub path"
	default "/usr/lib/webbridge/proxystubs"

config BR2_PACKAGE_WEBBRIDGE_NO_WEBUI
	bool "no web interface"

endmenu

config BR2_PACKAGE_WEBBRIDGE_PLUGIN_NXRESOURCECENTER
	bool "nxresourcecenter"
	depends on BR2_PACKAGE_BCM_REFSW
	help
	  Nexus resource center for bcm platfoms.

comment "nxresource centre depends on package bcm-refsw package."
	depends on !BR2_PACKAGE_WEBBRIDGE_PLUGIN_NXRESOURCECENTER

config BR2_PACKAGE_WEBBRIDGE_PLUGIN_TRACECONTROL
	bool "tracecontrol"
	help
	  A plugin that exposes the tracing api over the web interface.
	  Clients can use this interface to enable (and disable) at run-
	  time traces in the process currently running

	  NOTE: Tracing does NOT replace logging but is a tool for 
	  developpers to analyse there code. 

config BR2_PACKAGE_WEBBRIDGE_PLUGIN_MONITOR
	bool "monitor"
	help
	  A plugin that allows for a monitoring plugins with respect to 
	  memory usage. Hard limits can be set on the maximum memory usage 
	  and in case the limits are violated, the plugin can be restarted.

config BR2_PACKAGE_WEBBRIDGE_PLUGIN_DICTIONARY
	bool "dictionary"
	help
	  A plugin that allows for a persistent storage of data (key, value)
		  that can be accessed as a system-wide singleton and allows for 
		  notification on change by any instance in any process.

config BR2_PACKAGE_WEBBRIDGE_PLUGIN_COMMANDER
        bool "commander"
        help
          A plugin that allows to ingest a sequence of commands to be executed by the webbridge

config BR2_PACKAGE_WEBBRIDGE_PLUGIN_BACKOFFICE
	bool "backofffice"
	select BR2_PACKAGE_CPPSDK_PROFILER
	help
	  A plugin that acts as a gateway between the webbridge and a back
		  office system living in the cloud.

menuconfig BR2_PACKAGE_WEBBRIDGE_PLUGIN_PROVISIONING
	bool "provisioning"
	depends on BR2_PACKAGE_LIBPROVISION
	help
	  A component to allow external provisioning of devices with the 
	  proper credentials. Currently focused on provisioning from the
	  Metrological Back Office.

if BR2_PACKAGE_WEBBRIDGE_PLUGIN_PROVISIONING

config BR2_PACKAGE_WEBBRIDGE_PLUGIN_PROVISIONING_AUTOPROVISION
	depends on BR2_PACKAGE_WEBBRIDGE_PLUGIN_PROVISIONING
	bool "autoprovision"
	default y

endif

comment "provisioning needs the package libprovision in external mode."
	depends on !BR2_PACKAGE_LIBPROVISION

config BR2_PACKAGE_WEBBRIDGE_PLUGIN_WEBPROXY
	bool "webproxy"
	help
	  Provide functionality to proxy WebSockets (initiative) to tcp connections. 

config BR2_PACKAGE_WEBBRIDGE_PLUGIN_REMOTECONTROL
	bool "remotecontrol"
	help
	  A remote control implementation that translates keys coming in from a 
	  different source into the linux key system. 

	  Current implementations supports:
	  - GreeenPeak RF4CE chip (510) with RF4CE remotes.

comment "remotecontrol requires the GreenPeak GP501 or GP711 to be selected and userland lib to be build."
	depends on !BR2_PACKAGE_GREENPEAK || !BR2_PACKAGE_GREENPEAK_USERLANDLIB || (!BR2_PACKAGE_GREENPEAK_GP501 && !BR2_PACKAGE_GREENPEAK_GP711)

config BR2_PACKAGE_WEBBRIDGE_PLUGIN_VOICECONTROL
	bool "voicecontrol"
	help
	  A voice control implementation that captures audio fragments and send them tru a websocket.

	  Current implementations supports:
	  - GreeenPeak RF4CE chip (501) with RF4CE remotes.

comment "voicecontrol requires the GreenPeak GP501 or GP711 to be selected and userland lib to be build."
	depends on !BR2_PACKAGE_GREENPEAK || !BR2_PACKAGE_GREENPEAK_USERLANDLIB || (!BR2_PACKAGE_GREENPEAK_GP501 && !BR2_PACKAGE_GREENPEAK_GP711)


config BR2_PACKAGE_WEBBRIDGE_PLUGIN_DEVICEINFO
	bool "deviceinfo"
	help
	  A plugin displaying information on system resources

config BR2_PACKAGE_WEBBRIDGE_PLUGIN_BROWSER
	bool "browser"
	depends on BR2_PACKAGE_QT5WEBKIT
	help
	  A plugin that has browser functionality (QtWebKit)

menuconfig BR2_PACKAGE_WEBBRIDGE_PLUGIN_NETFLIX
	bool "netflix"
	select BR2_PACKAGE_CPPSDK_PROCESS
	depends on BR2_PACKAGE_NETFLIX_LIB
	help
	  A wrapper around the netflix app to start it as a
	  webbridge plugin.

if BR2_PACKAGE_WEBBRIDGE_PLUGIN_NETFLIX

config BR2_PACKAGE_WEBBRIDGE_PLUGIN_NETFLIX_AUTOSTART
	depends on BR2_PACKAGE_WEBBRIDGE_PLUGIN_NETFLIX
	bool "autostart"
	default n

config BR2_PACKAGE_WEBBRIDGE_PLUGIN_NETFLIX_STARTSUSPENDED
	depends on BR2_PACKAGE_WEBBRIDGE_PLUGIN_NETFLIX
	bool "startsuspended"
	default n

config BR2_PACKAGE_WEBBRIDGE_PLUGIN_NETFLIX_MODEL
	depends on BR2_PACKAGE_WEBBRIDGE_PLUGIN_NETFLIX
	string "model"
	default "Metrological Reference DPI Implementation"

endif

comment "netflix is dependent on the netflix package compiled as library"
	depends on !BR2_PACKAGE_NETFLIX_LIB

menuconfig BR2_PACKAGE_WEBBRIDGE_PLUGIN_WEBKITBROWSER
	bool "webkitbrowser"
	select BR2_PACKAGE_CPPSDK_PROCESS
	depends on BR2_PACKAGE_WPE
	help
	  A plugin that manages the webkit browser functionality

if BR2_PACKAGE_WEBBRIDGE_PLUGIN_WEBKITBROWSER

config BR2_PACKAGE_WEBBRIDGE_PLUGIN_WEBKITBROWSER_AUTOSTART
	depends on BR2_PACKAGE_WEBBRIDGE_PLUGIN_WEBKITBROWSER
	bool "autostart"
	default y

config BR2_PACKAGE_WEBBRIDGE_PLUGIN_WEBKITBROWSER_STARTURL
	depends on BR2_PACKAGE_WEBBRIDGE_PLUGIN_WEBKITBROWSER
	string "start-url"
	default "about:blank"

config BR2_PACKAGE_WEBBRIDGE_PLUGIN_WEBKITBROWSER_USERAGENT
	depends on BR2_PACKAGE_WEBBRIDGE_PLUGIN_WEBKITBROWSER
	string "useragent"
	default "Mozilla/5.0 (Macintosh, Intel Mac OS X 10_11_4) AppleWebKit/602.1.28+ (KHTML, like Gecko) Version/9.1 Safari/601.5.17"

config BR2_PACKAGE_WEBBRIDGE_PLUGIN_WEBKITBROWSER_MEMORYPROFILE
	depends on BR2_PACKAGE_WEBBRIDGE_PLUGIN_WEBKITBROWSER
	string "memory-profile"
	default "128m"

config BR2_PACKAGE_WEBBRIDGE_PLUGIN_WEBKITBROWSER_MEMORYPRESSURE
	depends on BR2_PACKAGE_WEBBRIDGE_PLUGIN_WEBKITBROWSER
	string "memory-pressure"
	default "databaseprocess:50m,networkprocess:100m,webprocess:300m,rpcprocess:50m"

config BR2_PACKAGE_WEBBRIDGE_PLUGIN_WEBKITBROWSER_MEDIADISKCACHE
	depends on BR2_PACKAGE_WEBBRIDGE_PLUGIN_WEBKITBROWSER
	bool "media-disk-cache"
	default n

config BR2_PACKAGE_WEBBRIDGE_PLUGIN_WEBKITBROWSER_DISKCACHE
	depends on BR2_PACKAGE_WEBBRIDGE_PLUGIN_WEBKITBROWSER
	string "disk-cache"
	default "0"

config BR2_PACKAGE_WEBBRIDGE_PLUGIN_WEBKITBROWSER_XHRCACHE
	depends on BR2_PACKAGE_WEBBRIDGE_PLUGIN_WEBKITBROWSER
	bool "xhr-cache"
	default false

config BR2_PACKAGE_WEBBRIDGE_PLUGIN_YOUTUBE
	bool "youtube"
	depends on BR2_PACKAGE_WEBBRIDGE_PLUGIN_WEBKITBROWSER
	help
	  A wrapper around the youtube app to start it as a
	  webbridge plugin.

endif

menuconfig BR2_PACKAGE_WEBBRIDGE_PLUGIN_WEBDRIVER
	bool "webdriver"
	select BR2_PACKAGE_CPPSDK_PROCESS
	depends on BR2_PACKAGE_WEBDRIVER
	help
	  A wrapper around the webdriver app to start it as a
	  webbridge plugin.

if BR2_PACKAGE_WEBBRIDGE_PLUGIN_WEBDRIVER

config BR2_PACKAGE_WEBBRIDGE_PLUGIN_WEBDRIVER_AUTOSTART
	depends on BR2_PACKAGE_WEBBRIDGE_PLUGIN_WEBDRIVER
	bool "autostart"
	help
	  WebDriver for WPE WebKit.
endif

comment "webkitbrowser requires the package wpe"
	depends on !BR2_PACKAGE_WPE

config BR2_PACKAGE_WEBBRIDGE_PLUGIN_QUEUECOMMUNICATOR
	bool "queuecommunicator"
	select BR2_PACKAGE_CPPSDK_MQC
	help
	  A plugin that receives and sends messages into a queue to interact
		  with specific middleware.


menuconfig BR2_PACKAGE_WEBBRIDGE_PLUGIN_DIALSERVER
	bool "dialserver"
	help
	  A plugin that implements DIscovery And Launch protocol specification


if BR2_PACKAGE_WEBBRIDGE_PLUGIN_DIALSERVER

config BR2_PACKAGE_WEBBRIDGE_PLUGIN_DIALSERVER_NAME
	depends on BR2_PACKAGE_WEBBRIDGE_PLUGIN_DIALSERVER
	string "name"
	default "[TV] WebBridge"

endif

menuconfig BR2_PACKAGE_WEBBRIDGE_PLUGIN_WEBSERVER
	bool "webserver"
	help
	  A plugin that implements a WebServer with Proxy functionality. Used to serve
          webpages and proxy web requests.

if BR2_PACKAGE_WEBBRIDGE_PLUGIN_WEBSERVER

config BR2_PACKAGE_WEBBRIDGE_PLUGIN_WEBSERVER_AUTOSTART
	depends on BR2_PACKAGE_WEBBRIDGE_PLUGIN_WEBSERVER
	bool "autostart"
	default y

config BR2_PACKAGE_WEBBRIDGE_PLUGIN_WEBSERVER_PORT
	depends on BR2_PACKAGE_WEBBRIDGE_PLUGIN_WEBSERVER
	string "port"
	default "8080"

config BR2_PACKAGE_WEBBRIDGE_PLUGIN_WEBSERVER_BIND
	depends on BR2_PACKAGE_WEBBRIDGE_PLUGIN_WEBSERVER
	string "bind"
	default "0.0.0.0"

config BR2_PACKAGE_WEBBRIDGE_PLUGIN_WEBSERVER_INTERFACE
	depends on BR2_PACKAGE_WEBBRIDGE_PLUGIN_WEBSERVER
	string "interface"
	default ""

config BR2_PACKAGE_WEBBRIDGE_PLUGIN_WEBSERVER_IDLE_TIME
	depends on BR2_PACKAGE_WEBBRIDGE_PLUGIN_WEBSERVER
	string "idle-time"
	default "180"

config BR2_PACKAGE_WEBBRIDGE_PLUGIN_WEBSERVER_WEBPATH
	depends on BR2_PACKAGE_WEBBRIDGE_PLUGIN_WEBSERVER
	string "persistent path"
	default "www"

endif	

config BR2_PACKAGE_WEBBRIDGE_PLUGIN_SNAPSHOT
	bool "snapshot"
	depends on BR2_PACKAGE_RPI_USERLAND
	help
	  A plugin that exposes a screenshot API

endif
```
