## package/qt6/qt6shadertools/Config.in
```kconfig
config BR2_PACKAGE_QT6SHADERTOOLS
	bool "qt6shadertools"
	# We need host-qt6base with Gui support when building
	# host-qt6shadertools (itself a dependency of target
	# qt6shadertools), otherwise the build is skipped and no qsb
	# host tool is generated.
	select BR2_PACKAGE_HOST_QT6BASE_GUI
	select BR2_PACKAGE_QT6BASE_GUI
	help
	  Qt is a cross-platform application and UI framework for
	  developers using C++.

	  The Qt Shader Tools module builds on the SPIR-V Open
	  Source Ecosystem as described at the Khronos SPIR-V web
	  site.

	  https://doc.qt.io/qt-6/qtshadertools-index.html
```

## package/qt6/qt6svg/Config.in
```kconfig
config BR2_PACKAGE_QT6SVG
	bool "qt6svg"
	select BR2_PACKAGE_QT6BASE_GUI
	help
	  Qt is a cross-platform application and UI framework for
	  developers using C++.

	  Qt SVG provides classes for rendering and displaying SVG
	  drawings in widgets and on other paint devices.

	  https://doc.qt.io/qt-6/qtsvg-index.html
```

## package/qt6/qt6tools/Config.in
```kconfig
config BR2_PACKAGE_QT6TOOLS
	bool "qt6tools"
	# The Qt Network module is required
	select BR2_PACKAGE_QT6BASE_NETWORK
	select BR2_PACKAGE_HOST_QT6TOOLS
	help
	  Qt is a cross-platform application and UI framework for
	  developers using C++.

	  Qt Tools provides tools facilitate the development
	  and design of applications.

	  https://github.com/qt/qttools
```

## package/qt6/qt6tools/Config.in.host
```kconfig
config BR2_PACKAGE_HOST_QT6TOOLS
	bool "host qt6tools"
	# The Qt Qt Network module is required
	select BR2_PACKAGE_HOST_QT6BASE_NETWORK
	help
	  Qt is a cross-platform application and UI framework for
	  developers using C++.

	  Qt Tools provides tools facilitate the development
	  and design of applications.

	  https://github.com/qt/qttools

if BR2_PACKAGE_HOST_QT6TOOLS

config BR2_PACKAGE_HOST_QT6TOOLS_LINGUIST_TOOLS
	bool "host linguist tools"
	help
	  Translate Qt C++ and Qt Quick applications into local
	  languages.

endif
```

## package/qt6/qt6virtualkeyboard/Config.in
```kconfig
config BR2_PACKAGE_QT6VIRTUALKEYBOARD
	bool "qt6virtualkeyboard"
	select BR2_PACKAGE_QT6DECLARATIVE
	select BR2_PACKAGE_QT6SVG
	help
	  Qt is a cross-platform application and UI framework for
	  developers using C++.

	  This package corresponds to the qt6virtualkeyboard module.

	  https://doc.qt.io/qt-6/qtvirtualkeyboard-index.html
```

## package/qt6/qt6wayland/Config.in
```kconfig
comment "qt6wayland needs an OpenGL-capable backend"
	depends on !BR2_PACKAGE_QT6_GL_SUPPORTS

config BR2_PACKAGE_QT6WAYLAND
	bool "qt6wayland"
	depends on BR2_PACKAGE_QT6_GL_SUPPORTS
	select BR2_PACKAGE_WAYLAND
	select BR2_PACKAGE_QT6BASE_GUI
	# needed because we build host-qt6wayland
	select BR2_PACKAGE_HOST_QT6BASE_GUI
	help
	  Qt is a cross-platform application and UI framework for
	  developers using C++.

	  This package corresponds to the qt6wayland module.

	  https://doc.qt.io/qt-6/qtwayland-index.html

if BR2_PACKAGE_QT6WAYLAND

config BR2_PACKAGE_QT6WAYLAND_COMPOSITOR
	bool "Enable compositor (experimental)"
	select BR2_PACKAGE_LIBXKBCOMMON
	help
	  The compositor API is still experimental, and not built by
	  default.

endif
```

## package/qt6/qt6websockets/Config.in
```kconfig
config BR2_PACKAGE_QT6WEBSOCKETS
	bool "qt6websockets"
	select BR2_PACKAGE_QT6BASE_NETWORK
	help
	  Qt is a cross-platform application and UI framework for
	  developers using C++.

	  This package corresponds to the qt6websockets module.

	  https://doc.qt.io/qt-6/qtwebsockets-index.html
```

## package/quazip/Config.in
```kconfig
config BR2_PACKAGE_QUAZIP
	bool "quazip"
	depends on BR2_PACKAGE_QT5 || BR2_PACKAGE_QT6
	select BR2_PACKAGE_ZLIB
	select BR2_PACKAGE_ZLIB_FORCE_LIBZLIB
	select BR2_PACKAGE_QT6CORE5COMPAT if BR2_PACKAGE_QT6
	help
	  QuaZIP is a simple C++ wrapper over Gilles Vollant's
	  ZIP/UNZIP package that can be used to access ZIP
	  archives. It uses the Qt toolkit.

	  http://quazip.sourceforge.net

if BR2_PACKAGE_QUAZIP

config BR2_PACKAGE_QUAZIP_INSTALL_TESTS
	bool "Build tests"
	select BR2_PACKAGE_QT6BASE_TEST if BR2_PACKAGE_QT6
	select BR2_PACKAGE_QT6BASE_NETWORK if BR2_PACKAGE_QT6
	help
	  Build and install unit test binaries

endif
```
