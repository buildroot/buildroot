## package/qt6/qt6base/Config.in
```kconfig
config BR2_PACKAGE_QT6BASE
	bool "qt6base"
	select BR2_PACKAGE_DOUBLE_CONVERSION
	select BR2_PACKAGE_LIBB2
	select BR2_PACKAGE_PCRE2
	select BR2_PACKAGE_PCRE2_16
	select BR2_PACKAGE_ZLIB
	help
	  Qt is a cross-platform application and UI framework for
	  developers using C++.

	  This package corresponds to the qt6base module, which
	  contains the base Qt libraries: QtCore, QtNetwork, QtGui,
	  QtWidgets, etc.

	  http://qt.io

if BR2_PACKAGE_QT6BASE

config BR2_PACKAGE_QT6BASE_CONCURRENT
	bool "concurrent module"
	help
	  This options enables the Qt6Concurrent library.

config BR2_PACKAGE_QT6BASE_DBUS
	bool "DBus module"
	depends on BR2_TOOLCHAIN_HAS_THREADS
	depends on BR2_USE_MMU
	select BR2_PACKAGE_DBUS
	help
	  This option enables the D-Bus module.

config BR2_PACKAGE_QT6BASE_GUI
	bool "gui module"
	select BR2_PACKAGE_FREETYPE
	# At least one graphic backend must be enabled, so enable
	# linuxfb if nothing is enabled.
	select BR2_PACKAGE_QT6BASE_LINUXFB if \
	       !BR2_PACKAGE_QT6BASE_XCB && \
	       !BR2_PACKAGE_QT6BASE_EGLFS
	help
	  This option enables the Qt6Gui library.

if BR2_PACKAGE_QT6BASE_GUI

config BR2_PACKAGE_QT6BASE_LINUXFB
	bool "linuxfb support"

config BR2_PACKAGE_QT6BASE_XCB
	bool "X.org XCB support"
	depends on BR2_PACKAGE_XORG7
	select BR2_PACKAGE_XLIB_LIBX11
	select BR2_PACKAGE_LIBXCB
	select BR2_PACKAGE_XCB_UTIL_IMAGE
	select BR2_PACKAGE_XCB_UTIL_KEYSYMS
	select BR2_PACKAGE_XCB_UTIL_RENDERUTIL
	select BR2_PACKAGE_XCB_UTIL_WM
	select BR2_PACKAGE_LIBXKBCOMMON

comment "X.org XCB backend available if X.org is enabled"
	depends on !BR2_PACKAGE_XORG7

config BR2_PACKAGE_QT6BASE_EGLFS
	bool "eglfs support"
	depends on BR2_PACKAGE_HAS_LIBEGL
	depends on BR2_PACKAGE_HAS_LIBGBM
	depends on BR2_PACKAGE_QT6_GL_SUPPORTS
	select BR2_PACKAGE_QT6BASE_OPENGL

config BR2_PACKAGE_QT6BASE_DEFAULT_QPA
	string "Default graphical platform"
	help
	  Choose the default platform abstraction to use for graphical
	  applications (e.g xcb, linuxfb, eglfs, ...). If this is
	  empty, the default for your architecture will be used
	  (usually this is eglfs).

	  You can get a list of supported platforms by running a Qt
	  application with the option "-platform help" on your
	  target. You can choose a different platform at runtime with
	  the -platform option.

config BR2_PACKAGE_QT6BASE_OPENGL
	bool "OpenGL support"
	depends on BR2_PACKAGE_QT6_GL_SUPPORTS
	help
	  This option enables OpenGL support.

comment "OpenGL support needs an OpenGL-capable backend"
	depends on !BR2_PACKAGE_QT6_GL_SUPPORTS

if BR2_PACKAGE_QT6BASE_OPENGL

choice
	prompt "OpenGL API"
	help
	  Select OpenGL API.

config BR2_PACKAGE_QT6BASE_OPENGL_DESKTOP
	bool "Desktop OpenGL"
	depends on BR2_PACKAGE_HAS_LIBGL
	help
	  Use desktop OpenGL.

config BR2_PACKAGE_QT6BASE_OPENGL_ES2
	bool "OpenGL ES 2.0+"
	depends on BR2_PACKAGE_HAS_LIBGLES
	help
	  Use OpenGL ES 2.0 and later versions.

endchoice

endif

config BR2_PACKAGE_QT6BASE_FONTCONFIG
	bool "fontconfig support"
	select BR2_PACKAGE_FONTCONFIG
	help
	  This option enables Fontconfig support using the system
	  fontconfig library.

config BR2_PACKAGE_QT6BASE_HARFBUZZ
	bool "harfbuzz support"
	select BR2_PACKAGE_HARFBUZZ if \
		BR2_TOOLCHAIN_HAS_SYNC_4 && \
		BR2_TOOLCHAIN_GCC_AT_LEAST_4_8
	help
	  This option enables HarfBuzz support (either system harfbuzz
	  if the toolchain supports __sync for 4 bytes, or the qt
	  provided one which avoids this dependency by using QAtomic).

config BR2_PACKAGE_QT6BASE_GIF
	bool "GIF support"
	help
	  This compiles and installs the plugin for GIF reading support.

config BR2_PACKAGE_QT6BASE_JPEG
	bool "JPEG support"
	select BR2_PACKAGE_JPEG
	help
	  This option enables JPEG support using the system libjpeg
	  library.

config BR2_PACKAGE_QT6BASE_PNG
	bool "PNG support"
	select BR2_PACKAGE_LIBPNG
	help
	  This option enables PNG support using the system libpng
	  library.

config BR2_PACKAGE_QT6BASE_WIDGETS
	bool "widgets module"
	help
	  This option enables the Qt6Widgets library.

endif

config BR2_PACKAGE_QT6BASE_NETWORK
	bool "network module"
	help
	  This options enables the Qt6Network library.

config BR2_PACKAGE_QT6BASE_SQL
	bool "sql module"
	help
	  This options enables the Qt6Sql library.

if BR2_PACKAGE_QT6BASE_SQL
config BR2_PACKAGE_QT6BASE_MYSQL
	bool "MySQL Plugin"
	depends on BR2_INSTALL_LIBSTDCPP
	depends on BR2_USE_MMU
	depends on BR2_TOOLCHAIN_HAS_THREADS
	select BR2_PACKAGE_MYSQL
	help
	  Build MySQL plugin

comment "MySQL plugin needs a toolchain w/ C++, threads"
	depends on BR2_USE_MMU
	depends on !BR2_INSTALL_LIBSTDCPP || !BR2_TOOLCHAIN_HAS_THREADS

config BR2_PACKAGE_QT6BASE_PSQL
	bool "PostgreSQL Plugin"
	depends on BR2_USE_MMU
	depends on !BR2_STATIC_LIBS
	depends on BR2_USE_WCHAR
	depends on !BR2_OPTIMIZE_FAST
	select BR2_PACKAGE_POSTGRESQL
	help
	  Build PostgreSQL plugin

comment "PostgreSQL plugin needs a toolchain w/ wchar, dynamic library"
	depends on BR2_USE_MMU
	depends on BR2_STATIC_LIBS || !BR2_USE_WCHAR

comment "PostgreSQL plugin can't be built with optimize for fast"
	depends on BR2_USE_MMU
	depends on BR2_OPTIMIZE_FAST

config BR2_PACKAGE_QT6BASE_SQLITE
	bool "SQLite plugin"
	select BR2_PACKAGE_SQLITE
	select BR2_PACKAGE_SQLITE_ENABLE_COLUMN_METADATA
	help
	  Build SQLite plugin

endif

config BR2_PACKAGE_QT6BASE_SYSLOG
	bool "syslog support"
	help
	  Logs to the standard UNIX logging mechanism.

config BR2_PACKAGE_QT6BASE_TEST
	bool "test module"
	help
	  This options enables the Qt6Test library.

config BR2_PACKAGE_QT6BASE_TSLIB
	bool "Enable Tslib support"
	select BR2_PACKAGE_TSLIB
	help
	  This options enables the Tslib plugin

config BR2_PACKAGE_QT6BASE_XML
	bool "XML module"
	help
	  This options enables the Qt6Xml library.

endif
```

## package/qt6/qt6base/Config.in.host
```kconfig
config BR2_PACKAGE_HOST_QT6BASE_CONCURRENT
	bool

# Select this if you need host qt6 tools that require the Qt::Gui module (e.g.
# Qt Shader Baker(qsb)).
config BR2_PACKAGE_HOST_QT6BASE_GUI
	bool

# Select this if you need host qt6 tools that require the Qt::Network module
# (e.g. Qt Tools).
config BR2_PACKAGE_HOST_QT6BASE_NETWORK
	bool

# Select this if you need host qt6 tools that require the Qt::Test module
# (e.g. qmltestrunner).
config BR2_PACKAGE_HOST_QT6BASE_TEST
	bool

config BR2_PACKAGE_HOST_QT6BASE_WIDGETS
	bool
```

## package/qt6/qt6charts/Config.in
```kconfig
config BR2_PACKAGE_QT6CHARTS
	bool "qt6charts"
	select BR2_PACKAGE_QT6BASE_GUI
	select BR2_PACKAGE_QT6BASE_WIDGETS
	help
	  This package corresponds the Qt Charts module:

	  https://doc.qt.io/qt-6/qtcharts-index.html
```

## package/qt6/qt6core5compat/Config.in
```kconfig
config BR2_PACKAGE_QT6CORE5COMPAT
	bool "qt6core5compat"
	select BR2_PACKAGE_QT6BASE_XML
	help
	  Qt is a cross-platform application and UI framework for
	  developers using C++.

	  The Qt 5 Core Compat module contains the Qt 5 Core APIs that
	  were removed in Qt 6. The module facilitates the transition
	  to Qt 6.

	  https://doc.qt.io/qt-6/qtcore5-index.html
```

## package/qt6/qt6declarative/Config.in
```kconfig
config BR2_PACKAGE_QT6DECLARATIVE
	bool "qt6declarative"
	# Enable host test module to ensure that qmltestrunner is built
	help
	  Qt is a cross-platform application and UI framework for
	  developers using C++.

	  This package corresponds to the qt6declarative module.

	  https://doc.qt.io/qt-6/qtdeclarative-index.html

if BR2_PACKAGE_QT6DECLARATIVE

config BR2_PACKAGE_QT6DECLARATIVE_QUICK
	bool "quick module"
	select BR2_PACKAGE_HOST_QT6BASE_TEST if BR2_PACKAGE_QT6BASE_TEST # qmltestrunner
	select BR2_PACKAGE_HOST_QT6BASE_NETWORK if BR2_PACKAGE_QT6BASE_NETWORK # qmlprofiler
	select BR2_PACKAGE_QT6BASE_GUI
	select BR2_PACKAGE_QT6BASE_OPENGL if BR2_PACKAGE_QT6_GL_SUPPORTS
	select BR2_PACKAGE_QT6SHADERTOOLS

endif
```

## package/qt6/qt6graphs/Config.in
```kconfig
config BR2_PACKAGE_QT6GRAPHS
	bool "qt6graphs"
	select BR2_PACKAGE_QT6DECLARATIVE
	select BR2_PACKAGE_QT6QUICK3D
	help
	  This package corresponds to the Qt Graphs module:

	  https://doc.qt.io/qt-6/qtgraphs-index.html
```

## package/qt6/qt6grpc/Config.in
```kconfig
config BR2_PACKAGE_QT6GRPC
	bool "qt6grpc"
	help
	  This package provides the Qt GRPC and Protobuf modules:

	  https://doc.qt.io/qt-6/qtgrpc-index.html
	  https://code.qt.io/cgit/qt/qtgrpc.git/
```

## package/qt6/qt6languageserver/Config.in
```kconfig
config BR2_PACKAGE_QT6LANGUAGESERVER
	bool "qt6languageserver"
	help
	  Qt is a cross-platform application and UI framework for
	  developers using C++.

	  This package corresponds to the qt6languageserver module.

	  https://github.com/qt/qtlanguageserver
```

## package/qt6/qt6mqtt/Config.in
```kconfig
config BR2_PACKAGE_QT6MQTT
	bool "qt6mqtt"
	select BR2_PACKAGE_QT6BASE_NETWORK
	help
	  Qt is a cross-platform application and UI framework for
	  developers using C++.

	  This package corresponds to the qt6mqtt module.

	  https://doc.qt.io/qt-6/qtmqtt-index.html
```

## package/qt6/qt6multimedia/Config.in
```kconfig
config BR2_PACKAGE_QT6MULTIMEDIA
	bool "qt6multimedia"
	select BR2_PACKAGE_QT6BASE_GUI
	select BR2_PACKAGE_QT6BASE_NETWORK
	select BR2_PACKAGE_QT6SHADERTOOLS
	help
	  This package provides Qt6 Multimedia:

	  https://doc.qt.io/qt-6/qtmultimedia-index.html
	  https://code.qt.io/cgit/qt/qtmultimedia.git

if BR2_PACKAGE_QT6MULTIMEDIA

comment "alsa support requires disabling pulseaudio"
	depends on BR2_PACKAGE_QT6MULTIMEDIA_PULSEAUDIO

config BR2_PACKAGE_QT6MULTIMEDIA_ALSA
	bool "alsa support"
	# qt6-multimedia audio backend requires selection
	# of either PulseAudio or ALSA.
	depends on !BR2_PACKAGE_QT6MULTIMEDIA_PULSEAUDIO
	select BR2_PACKAGE_ALSA_LIB
	help
	  This option selects Alsa as audio backend.

config BR2_PACKAGE_QT6MULTIMEDIA_EXAMPLES
	bool "examples"
	help
	  This option enables the Qt6 Multimedia examples.

comment "ffmpeg plugin needs kernel headers >= 5.2"
	depends on BR2_PACKAGE_FFMPEG_ARCH_SUPPORTS
	depends on BR2_PACKAGE_PULSEAUDIO_HAS_ATOMIC
	depends on !BR2_TOOLCHAIN_HEADERS_AT_LEAST_5_2

config BR2_PACKAGE_QT6MULTIMEDIA_FFMPEG
	bool "ffmpeg plugin"
	depends on BR2_PACKAGE_FFMPEG_ARCH_SUPPORTS
	depends on BR2_PACKAGE_PULSEAUDIO_HAS_ATOMIC
	# V4L2_PIX_FMT_BGRA32
	depends on BR2_TOOLCHAIN_HEADERS_AT_LEAST_5_2
	# qt6-multimedia ffmpeg plugin needs
	# qt6base-concurrent, PulseAudio and ffmpeg-swcale.
	select BR2_PACKAGE_FFMPEG
	select BR2_PACKAGE_FFMPEG_SWSCALE
	select BR2_PACKAGE_QT6BASE_CONCURRENT
	select BR2_PACKAGE_QT6MULTIMEDIA_PULSEAUDIO
	# libxext/libxrandr are needed for ffmpeg plugin to build with
	# X11 support:
	# https://code.qt.io/cgit/qt/qtmultimedia.git/tree/src/plugins/multimedia/ffmpeg/CMakeLists.txt?h=6.8.1#n198
	select BR2_PACKAGE_XLIB_LIBXEXT if BR2_PACKAGE_XORG7
	select BR2_PACKAGE_XLIB_LIBXRANDR if BR2_PACKAGE_XORG7
	help
	  This option enables ffmpeg media backend.

if BR2_PACKAGE_QT6MULTIMEDIA_FFMPEG

comment "VAAPI support needs OpenGL, EGL, libgbm with dma-buf"
	depends on !BR2_PACKAGE_QT6_GL_SUPPORTS || \
		!BR2_PACKAGE_HAS_LIBEGL || \
		!BR2_PACKAGE_LIBGBM_HAS_FEATURE_DMA_BUF

config BR2_PACKAGE_QT6MULTIMEDIA_VAAPI
	bool "vaapi support"
	depends on BR2_PACKAGE_QT6_GL_SUPPORTS
	depends on BR2_PACKAGE_HAS_LIBEGL
	depends on BR2_PACKAGE_LIBGBM_HAS_FEATURE_DMA_BUF
	select BR2_PACKAGE_LIBVA
	# ffmpeg-vaapi support needs qt6base-opengl
	select BR2_PACKAGE_QT6BASE_OPENGL
	select BR2_PACKAGE_QT6MULTIMEDIA_LINUX_DMA_BUF
	help
	  This option enables the vaapi support.
endif

config BR2_PACKAGE_QT6MULTIMEDIA_GSTREAMER
	bool "gstreamer plugin"
	# gstreamer 1.x and gst-plugins-base-app are required
	# for gstreamer support in qt6-multimedia
	select BR2_PACKAGE_GST1_PLUGINS_BASE
	select BR2_PACKAGE_GST1_PLUGINS_BASE_PLUGIN_APP
	select BR2_PACKAGE_GSTREAMER1
	help
	  This option enables gstreamer media backend.

if BR2_PACKAGE_QT6MULTIMEDIA_GSTREAMER

config BR2_PACKAGE_QT6MULTIMEDIA_GST1_PLUGINS_PHOTOGRAPHY
	bool "photography support"
	select BR2_PACKAGE_GST1_PLUGINS_BAD
	help
	  This option enables gstreamer-photography support.

endif

comment "dma-buf support needs EGM, libgbm with dma-buf"
	depends on !BR2_PACKAGE_HAS_LIBEGL || \
		!BR2_PACKAGE_LIBGBM_HAS_FEATURE_DMA_BUF

config BR2_PACKAGE_QT6MULTIMEDIA_LINUX_DMA_BUF
	bool "linux dma buffer support"
	# qt6 configure script needs EGL to check for linux dma buffer
	# support
	depends on BR2_PACKAGE_HAS_LIBEGL
	depends on BR2_PACKAGE_LIBGBM_HAS_FEATURE_DMA_BUF
	help
	  This option enables the linux dma buffer support.

config BR2_PACKAGE_QT6MULTIMEDIA_PULSEAUDIO
	bool "pulseaudio support"
	depends on BR2_PACKAGE_PULSEAUDIO_HAS_ATOMIC
	select BR2_PACKAGE_PULSEAUDIO
	help
	  This option selects PulseAudio as audio backend.

config BR2_PACKAGE_QT6MULTIMEDIA_SPATIALAUDIO
	bool "spatial audio module"
	help
	  This option enables the Qt6 Spatial Audio module.

	  https://doc.qt.io/qt-6/qtspatialaudio-index.html

endif
```

## package/qt6/qt6opcua/Config.in
```kconfig
config BR2_PACKAGE_QT6OPCUA
	bool "qt6opcua"
	select BR2_PACKAGE_QT6BASE_NETWORK
	# qt6opcua needs host-qt6opcua, and host-qt6opcua needs
	# network support in qt6base.
	select BR2_PACKAGE_HOST_QT6BASE_NETWORK

	help
	  Qt is a cross-platform application and UI framework for
	  developers using C++.

	  This package corresponds to the qt6opcua module.

	  https://doc.qt.io/qt-6/qtopcua-index.html
```

## package/qt6/qt6positioning/Config.in
```kconfig
config BR2_PACKAGE_QT6POSITIONING
	bool "qt6positioning"
	help
	  This package provides Qt6 Positioning:

	  https://doc.qt.io/qt-6/qtpositioning-index.html
	  https://code.qt.io/cgit/qt/qtpositioning.git
```

## package/qt6/qt6quick3d/Config.in
```kconfig
config BR2_PACKAGE_QT6QUICK3D
	bool "qt6quick3d"
	select BR2_PACKAGE_HOST_QT6BASE_CONCURRENT # Host Quick3DRuntimeRender
	select BR2_PACKAGE_HOST_QT6BASE_GUI
	select BR2_PACKAGE_HOST_QT6BASE_WIDGETS
	select BR2_PACKAGE_QT6DECLARATIVE
	select BR2_PACKAGE_QT6DECLARATIVE_QUICK
	help
	  This package corresponds to the Qt Quick 3D module:

	  https://doc.qt.io/qt-6/qtquick3d-index.html
```

## package/qt6/qt6quicktimeline/Config.in
```kconfig
config BR2_PACKAGE_QT6QUICKTIMELINE
	bool "qt6quicktimeline"
	select BR2_PACKAGE_QT6DECLARATIVE
	select BR2_PACKAGE_QT6DECLARATIVE_QUICK
	help
	  This package corresponds to the Qt Quick Timeline module:

	  https://doc.qt.io/qt-6/qtquicktimeline-index.html
```

## package/qt6/qt6scxml/Config.in
```kconfig
config BR2_PACKAGE_QT6SCXML
	bool "qt6scxml"
	help
	  Qt is a cross-platform application and UI framework for
	  developers using C++.

	  This package provides two related state machine modules:

	  * StateMachine: provides classes for creating and executing
	    state graphs.

	    https://doc.qt.io/qt-6/qtstatemachine-index.html

	  * Scxml: provides functionality to create state machines
	    from SCXML files.

	    https://doc.qt.io/qt-6/qtscxml-index.html
```

## package/qt6/qt6serialbus/Config.in
```kconfig
config BR2_PACKAGE_QT6SERIALBUS
	bool "qt6serialbus"
	depends on BR2_TOOLCHAIN_HEADERS_AT_LEAST_3_6 # CAN FD
	select BR2_PACKAGE_QT6SERIALPORT
	select BR2_PACKAGE_QT6BASE_NETWORK
	help
	  Qt is a cross-platform application and UI framework for
	  developers using C++.

	  This package corresponds to the qt6serialbus module.

	  https://doc.qt.io/qt-6/qtserialbus-index.html

comment "qt6serialbus needs headers >= 3.6"
	depends on !BR2_TOOLCHAIN_HEADERS_AT_LEAST_3_6
```

## package/qt6/qt6serialport/Config.in
```kconfig
config BR2_PACKAGE_QT6SERIALPORT
	bool "qt6serialport"
	help
	  Qt is a cross-platform application and UI framework for
	  developers using C++.

	  Qt Serial Port provides the basic functionality, which
	  includes configuring, I/O operations, getting and setting
	  the control signals of the RS-232 pinouts.

	  https://doc.qt.io/qt-6/qserialport.html
```
