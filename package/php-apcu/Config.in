## package/podman/Config.in
```kconfig
config BR2_PACKAGE_PODMAN
	bool "podman"
	depends on BR2_USE_MMU  # fork()
	depends on BR2_PACKAGE_HOST_GO_TARGET_ARCH_SUPPORTS  # host-go
	depends on BR2_PACKAGE_HOST_RUSTC_TARGET_ARCH_SUPPORTS  # netavark
	depends on BR2_PACKAGE_LIBGPG_ERROR_ARCH_SUPPORTS  # libgpgme
	depends on BR2_PACKAGE_LIBSECCOMP_ARCH_SUPPORTS  # libseccomp
	depends on BR2_TOOLCHAIN_HEADERS_AT_LEAST_4_14  # shadow
	depends on BR2_TOOLCHAIN_HAS_THREADS  # conmon
	depends on BR2_USE_WCHAR  # conmon
	select BR2_PACKAGE_HOST_GO
	select BR2_PACKAGE_CA_CERTIFICATES  # runtime
	select BR2_PACKAGE_CGROUPFS_V2_MOUNT if !BR2_PACKAGE_CGROUPFS_MOUNT && !BR2_INIT_SYSTEMD  # runtime
	select BR2_PACKAGE_CONMON  # runtime
	select BR2_PACKAGE_LIBGPGME
	select BR2_PACKAGE_LIBSECCOMP
	select BR2_PACKAGE_NETAVARK  # runtime
	# podman officially only supports crun, but compatible runtimes are
	# also accepted. So we do the select the other way around, to match
	# docker-engine's own select and thus avoid circular dependency
	# issues.
	select BR2_PACKAGE_RUNC if !BR2_PACKAGE_CRUN  # runtime
	select BR2_PACKAGE_SHADOW
	select BR2_PACKAGE_SHADOW_SUBORDINATE_IDS
	help
	  The best free & open source container tools

	  Manage containers, pods, and images with Podman. Seamlessly
	  work with containers and Kubernetes from your local
	  environment.

	  https://podman.io/

if BR2_PACKAGE_PODMAN

choice
	bool "support podman-init"
	default BR2_PACKAGE_PODMAN_INIT_CATATONIT
	help
	  Support providing a minimal init process for containers.
	  Required to use "podman container run --init".

config BR2_PACKAGE_PODMAN_INIT_NONE
	bool "none"
	help
	  Do not support docker-init.

config BR2_PACKAGE_PODMAN_INIT_CATATONIT
	bool "catatonit"
	select BR2_PACKAGE_CATATONIT # runtime
	help
	  Support providing a minimal init process for containers,
	  using catatonit.

config BR2_PACKAGE_PODMAN_INIT_TINI
	bool "tini"
	select BR2_PACKAGE_TINI # runtime
	help
	  Support providing a minimal init process for containers,
	  using tini.

endchoice

config BR2_PACKAGE_PODMAN_INIT_NAME
	string
	default "tini" if BR2_PACKAGE_PODMAN_INIT_TINI
	default "catatonit" if BR2_PACKAGE_PODMAN_INIT_CATATONIT

choice
	bool "Network backend"

config BR2_PACKAGE_PODMAN_NET_PASST
	bool "passt/pasta"
	select BR2_PACKAGE_PASST  # runtime

config BR2_PACKAGE_PODMAN_NET_SLIRP4NETNS
	bool "slirp4netns"
	select BR2_PACKAGE_SLIRP4NETNS  # runtime

endchoice

endif

comment "podman needs a toolchain w/ headers >= 4.14, threads, wchar"
	depends on BR2_USE_MMU
	depends on BR2_PACKAGE_HOST_GO_TARGET_ARCH_SUPPORTS
	depends on BR2_PACKAGE_HOST_RUSTC_TARGET_ARCH_SUPPORTS
	depends on BR2_PACKAGE_LIBGPG_ERROR_ARCH_SUPPORTS
	depends on BR2_PACKAGE_LIBSECCOMP_ARCH_SUPPORTS
	depends on !BR2_TOOLCHAIN_HEADERS_AT_LEAST_4_14 \
		|| !BR2_TOOLCHAIN_HAS_THREADS \
		|| !BR2_USE_WCHAR
```

## package/poke/Config.in
```kconfig
config BR2_PACKAGE_POKE
	bool "poke"
	depends on BR2_PACKAGE_LIBATOMIC_OPS_ARCH_SUPPORTS # bdwgc
	depends on BR2_USE_WCHAR # needs wctomb
	depends on BR2_TOOLCHAIN_HAS_THREADS_NPTL
	depends on BR2_TOOLCHAIN_USES_GLIBC || BR2_TOOLCHAIN_USES_MUSL # gnulib
	select BR2_PACKAGE_BUSYBOX_SHOW_OTHERS # less
	select BR2_PACKAGE_BDWGC
	select BR2_PACKAGE_LESS # runtime
	select BR2_PACKAGE_READLINE
	help
	  GNU poke is a new interactive editor for binary data. Not
	  limited to editing basic entities such as bits and bytes,
	  it provides a full-fledged procedural, interactive
	  programming language designed to describe data structures
	  and to operate on them. Once a user has defined a structure
	  for binary data (usually matching some file format) she can
	  search, inspect, create, shuffle and modify abstract entities
	  such as ELF relocations, MP3 tags, DWARF expressions,
	  partition table entries, and so on, with primitives
	  resembling simple editing of bits and bytes. The program
	  comes with a library of already written descriptions (or
	  "pickles" in poke parlance) for many binary formats.

	  https://www.gnu.org/software/poke/

comment "poke needs a glibc or musl toolchain w/ NPTL, wchar"
	depends on BR2_PACKAGE_LIBATOMIC_OPS_ARCH_SUPPORTS
	depends on !(BR2_TOOLCHAIN_USES_GLIBC || BR2_TOOLCHAIN_USES_MUSL) \
		||!BR2_TOOLCHAIN_HAS_THREADS_NPTL || !BR2_USE_WCHAR
```

## package/polkit/Config.in
```kconfig
config BR2_PACKAGE_POLKIT
	bool "polkit"
	depends on BR2_TOOLCHAIN_GCC_AT_LEAST_7 # C++17
	depends on BR2_TOOLCHAIN_HAS_THREADS # libglib2, dbus
	depends on BR2_USE_MMU # libglib2, dbus
	depends on BR2_USE_WCHAR # libglib2
	depends on !BR2_STATIC_LIBS # duktape
	depends on !BR2_OPTIMIZE_FAST # duktape
	select BR2_PACKAGE_DBUS # runtime
	select BR2_PACKAGE_DUKTAPE
	select BR2_PACKAGE_EXPAT
	select BR2_PACKAGE_LIBGLIB2
	help
	  PolicyKit is a toolkit for defining and handling
	  authorizations. It is used for allowing unprivileged
	  processes to speak to privileged processes.

	  http://www.freedesktop.org/wiki/Software/polkit

comment "polkit needs a toolchain with dynamic library, wchar, threads, gcc >= 7"
	depends on BR2_USE_MMU
	depends on !BR2_USE_WCHAR || !BR2_TOOLCHAIN_GCC_AT_LEAST_7 || \
		BR2_STATIC_LIBS || !BR2_TOOLCHAIN_HAS_THREADS

comment "polkit can't be built with Optimize for fast"
	depends on BR2_OPTIMIZE_FAST
```

## package/postgis/Config.in
```kconfig
config BR2_PACKAGE_POSTGIS
	bool "postgis"
	depends on BR2_PACKAGE_POSTGRESQL_FULL
	depends on BR2_INSTALL_LIBSTDCPP # libgeos, proj
	depends on BR2_TOOLCHAIN_GCC_AT_LEAST_4_9 # libgeos
	depends on BR2_TOOLCHAIN_HAS_THREADS_NPTL # proj
	depends on BR2_USE_WCHAR # libgeos, proj
	select BR2_PACKAGE_LIBGEOS
	select BR2_PACKAGE_PROJ
	select BR2_PACKAGE_LIBXML2
	select BR2_PACKAGE_LIBICONV if !BR2_ENABLE_LOCALE
	help
	  PostGIS is a spatial database extender for PostgreSQL
	  object-relational database. It adds support for
	  geographic objects allowing location queries
	  to be run in SQL.

	  https://postgis.net/

comment "postgis needs a toolchain w/ C++, NPTL, wchar, gcc >= 4.9"
	depends on !BR2_INSTALL_LIBSTDCPP || !BR2_TOOLCHAIN_GCC_AT_LEAST_4_9 || \
		!BR2_TOOLCHAIN_HAS_THREADS_NPTL || !BR2_USE_WCHAR
```

## package/pound/Config.in
```kconfig
config BR2_PACKAGE_POUND
	bool "pound"
	depends on !BR2_STATIC_LIBS
	depends on BR2_TOOLCHAIN_HAS_THREADS
	depends on BR2_USE_MMU # fork()
	select BR2_PACKAGE_OPENSSL
	select BR2_PACKAGE_OPENSSL_FORCE_LIBOPENSSL
	help
	  The Pound program is a reverse proxy, load balancer and HTTPS
	  front-end for Web server(s). Pound was developed to enable
	  distributing the load among several Web-servers and to allow
	  for a convenient SSL wrapper for those Web servers that do not
	  offer it natively.

	  https://github.com/graygnuorg/pound

comment "pound needs a toolchain w/ dynamic library, threads"
	depends on BR2_STATIC_LIBS || !BR2_TOOLCHAIN_HAS_THREADS
	depends on BR2_USE_MMU
```

## package/powertop/Config.in
```kconfig
config BR2_PACKAGE_POWERTOP
	bool "powertop"
	depends on BR2_INSTALL_LIBSTDCPP
	depends on BR2_TOOLCHAIN_HAS_THREADS # libnl
	depends on BR2_USE_WCHAR
	select BR2_PACKAGE_NCURSES
	select BR2_PACKAGE_LIBNL
	help
	  A tool to diagnose issues with power consumption and power
	  management

	  https://github.com/fenrus75/powertop/

comment "powertop needs a toolchain w/ C++, threads, wchar"
	depends on !BR2_INSTALL_LIBSTDCPP || !BR2_TOOLCHAIN_HAS_THREADS || \
		!BR2_USE_WCHAR
```

## package/pppd/Config.in
```kconfig
config BR2_PACKAGE_PPPD
	bool "pppd"
	depends on !BR2_STATIC_LIBS
	depends on BR2_USE_MMU
	select BR2_PACKAGE_OPENSSL if BR2_TOOLCHAIN_USES_GLIBC
	select BR2_PACKAGE_LIBOPENSSL_ENABLE_DES if BR2_PACKAGE_LIBOPENSSL
	help
	  An implementation of the Point-to-point protocol.

	  http://www.samba.org/ppp/

if BR2_PACKAGE_PPPD

config BR2_PACKAGE_PPPD_FILTER
	bool "filtering"
	select BR2_PACKAGE_LIBPCAP
	help
	  Packet filtering abilities for pppd. If enabled,
	  the pppd active-filter and pass-filter options
	  are available.

endif

comment "pppd needs a toolchain w/ dynamic library"
	depends on BR2_STATIC_LIBS
	depends on BR2_USE_MMU
```

## package/procdump-for-linux/Config.in
```kconfig
config BR2_PACKAGE_PROCDUMP_FOR_LINUX
	bool "procdump-for-linux"
	help
        ProcDump is a Linux reimagining of the classic ProcDump tool 
        from the Sysinternals suite of tools for Windows. ProcDump provides 
        a convenient way for Linux developers to create core dumps of their 
        application based on performance triggers.


        https://github.com/microsoft/procdump-for-linux
```
