## package/php-apcu/Config.in
```kconfig
config BR2_PACKAGE_PHP_APCU
	bool "php-apcu"
	depends on BR2_TOOLCHAIN_HAS_THREADS
	help
	  APCu is an in-memory key-value store for PHP.

	  https://pecl.php.net/package/APCu

comment "php-apcu needs a toolchain w/ threads"
	depends on !BR2_TOOLCHAIN_HAS_THREADS
```

## package/php-lua/Config.in
```kconfig
config BR2_PACKAGE_PHP_LUA
	bool "php-lua"
	depends on BR2_PACKAGE_HAS_LUAINTERPRETER
	help
	  This extension embeds the lua interpreter and offers an
	  OO-API to lua variables and functions.

	  https://pecl.php.net/package/lua
```

## package/php-pam/Config.in
```kconfig
config BR2_PACKAGE_PHP_PAM
	bool "php-pam"
	depends on BR2_ENABLE_LOCALE # linux-pam
	depends on BR2_USE_WCHAR # linux-pam
	depends on BR2_USE_MMU # linux-pam
	depends on !BR2_STATIC_LIBS # linux-pam
	depends on BR2_TOOLCHAIN_GCC_AT_LEAST_4_9 # linux-pam
	select BR2_PACKAGE_LINUX_PAM
	help
	  PHP PAM (Pluggable Authentication Modules) integration

	  https://pecl.php.net/package/PAM

comment "php-pam needs a toolchain w/ wchar, locale, dynamic library, gcc >= 4.9"
	depends on BR2_USE_MMU
	depends on !BR2_ENABLE_LOCALE || !BR2_USE_WCHAR \
		|| BR2_STATIC_LIBS || !BR2_TOOLCHAIN_GCC_AT_LEAST_4_9
```

## package/php-pecl-dbus/Config.in
```kconfig
config BR2_PACKAGE_PHP_PECL_DBUS
	bool "php-pecl-dbus"
	depends on BR2_TOOLCHAIN_HAS_THREADS # dbus
	depends on BR2_USE_MMU # dbus
	select BR2_PACKAGE_DBUS
	select BR2_PACKAGE_LIBXML2
	select BR2_PACKAGE_PHP_EXT_LIBXML2 # Runtime dependency
	help
	  PHP extension for interaction with D-Bus busses.

	  https://github.com/derickr/pecl-dbus

comment "php-pecl-dbus needs a toolchain w/ threads"
	depends on BR2_USE_MMU
	depends on !BR2_TOOLCHAIN_HAS_THREADS
```

## package/php/Config.in
```kconfig
config BR2_PACKAGE_PHP_ARCH_SUPPORTS
	bool
	# see fiber_cpu in configure.ac
	default y if BR2_aarch64 || BR2_aarch64_be
	default y if BR2_arm || BR2_armeb
	default y if BR2_i386 || BR2_x86_64
	default y if BR2_mips || BR2_mipsel || BR2_mips64 || BR2_mips64el
	default y if BR2_powerpc || BR2_powerpc64 || BR2_powerpc64le
	default y if BR2_RISCV_64
	default y if BR2_s390x
	default y if BR2_TOOLCHAIN_HAS_UCONTEXT

config BR2_PACKAGE_PHP
	bool "php"
	depends on BR2_PACKAGE_PHP_ARCH_SUPPORTS
	# PHP uses -export-dynamic, which breaks with elf2flt with a
	# message like "ld.real: section .junk LMA [...,...] overlaps
	# section .text LMA [...,...]"
	depends on !BR2_BINFMT_FLAT
	depends on BR2_USE_WCHAR
	select BR2_PACKAGE_PHP_SAPI_CGI if \
	       !BR2_PACKAGE_PHP_SAPI_APACHE && \
	       !BR2_PACKAGE_PHP_SAPI_CLI && \
	       !BR2_PACKAGE_PHP_SAPI_FPM &&  \
	       BR2_USE_MMU
	select BR2_PACKAGE_PHP_SAPI_CLI if !BR2_USE_MMU
	select BR2_PACKAGE_PCRE2
	help
	  PHP  is a widely-used general-purpose scripting
	  language that is especially suited for Web development
	  and can be embedded into HTML.

	  http://www.php.net

if BR2_PACKAGE_PHP

config BR2_PACKAGE_PHP_SAPI_APACHE
	bool "Apache interface"
	depends on BR2_PACKAGE_APACHE
	help
	  Apache module

config BR2_PACKAGE_PHP_SAPI_CGI
	bool "CGI interface"
	# CGI uses fork()
	depends on BR2_USE_MMU
	help
	  Common Gateway Interface

config BR2_PACKAGE_PHP_SAPI_CLI
	bool "CLI interface"
	help
	  Command Line Interface

config BR2_PACKAGE_PHP_SAPI_FPM
	bool "FPM interface"
	depends on BR2_USE_MMU
	# "Sparc v8 and predecessors are not and will not be supported"
	depends on !BR2_sparc
	help
	  PHP-FPM (FastCGI Process Manager)

source "package/php/Config.ext"

endif

comment "php needs a toolchain w/ wchar"
	depends on BR2_PACKAGE_PHP_ARCH_SUPPORTS
	depends on !BR2_BINFMT_FLAT
	depends on !BR2_USE_WCHAR
```

## package/pico-sdk/Config.in
```kconfig
config BR2_PACKAGE_PICO_SDK
	bool "pico-sdk"
	help
	  Raspberry Pi Pico SDK. Provides the headers, libraries
	  and build system necessary to write programs for the
	  RP2040-based devices such as the Raspberry Pi Pico in
	  C, C++ or assembly language.

	  https://github.com/raspberrypi/pico-sdk
```

## package/picotool/Config.in
```kconfig
comment "picotool needs a toolchain w/ C++, threads, gcc >= 4.9"
	depends on !BR2_INSTALL_LIBSTDCPP || \
		!BR2_TOOLCHAIN_HAS_THREADS || \
		!BR2_TOOLCHAIN_GCC_AT_LEAST_4_9

config BR2_PACKAGE_PICOTOOL
	bool "picotool"
	depends on BR2_INSTALL_LIBSTDCPP
	depends on BR2_TOOLCHAIN_HAS_THREADS # libusb
	depends on BR2_TOOLCHAIN_GCC_AT_LEAST_4_9 # libusb
	select BR2_PACKAGE_LIBUSB
	select BR2_PACKAGE_PICO_SDK
	help
	  picotool is a tool for inspecting rp2040 binaries and
	  interacting with rp2040 devices when they are in bootsel
	  mode or devices USBstdio support from the Raspberry Pi Pico
	  SDK.

	  https://github.com/raspberrypi/picotool
```

## package/piglit/Config.in
```kconfig
config BR2_PACKAGE_PIGLIT
	bool "piglit"
	depends on BR2_PACKAGE_PYTHON3 # python3 only script
	depends on BR2_PACKAGE_PYTHON_NUMPY_ARCH_SUPPORTS
	depends on BR2_PACKAGE_WAFFLE_SUPPORTS_GLX || \
		BR2_PACKAGE_WAFFLE_SUPPORTS_WAYLAND || \
		BR2_PACKAGE_WAFFLE_SUPPORTS_X11_EGL || \
		BR2_PACKAGE_WAFFLE_SUPPORTS_GBM
	depends on BR2_INSTALL_LIBSTDCPP # mesa3d-demos, python-numpy
	depends on BR2_TOOLCHAIN_USES_GLIBC || BR2_TOOLCHAIN_USES_MUSL # python-numpy
	depends on BR2_TOOLCHAIN_GCC_AT_LEAST_9 # python-numpy
	depends on BR2_HOST_GCC_AT_LEAST_9 # host-python-numpy
	select BR2_PACKAGE_LIBDRM if BR2_PACKAGE_HAS_LIBGL
	select BR2_PACKAGE_LIBPNG
	select BR2_PACKAGE_LIBXKBCOMMON if BR2_PACKAGE_WAYLAND
	select BR2_PACKAGE_MESA3D_DEMOS # glxinfo
	select BR2_PACKAGE_PYTHON_MAKO
	select BR2_PACKAGE_PYTHON_NUMPY
	select BR2_PACKAGE_PYTHON_SIX
	select BR2_PACKAGE_PYTHON3_BZIP2
	select BR2_PACKAGE_PYTHON3_PYEXPAT
	select BR2_PACKAGE_PYTHON3_XZ
	select BR2_PACKAGE_PYTHON3_ZLIB
	select BR2_PACKAGE_UTIL_LINUX # runtime
	select BR2_PACKAGE_UTIL_LINUX_BINARIES # requires real dmesg tool
	select BR2_PACKAGE_WAFFLE # wflinfo, libwaffle-1
	select BR2_PACKAGE_XLIB_LIBX11 if BR2_PACKAGE_XORG7
	select BR2_PACKAGE_XLIB_LIBXEXT if BR2_PACKAGE_XORG7
	select BR2_PACKAGE_XORGPROTO if BR2_PACKAGE_XORG7
	select BR2_PACKAGE_ZLIB
	help
	  Piglit is an open-source test suite for OpenGL
	  implementations.

	  https://piglit.freedesktop.org

comment "piglit needs a glibc or musl toolchain w/ C++, gcc >= 9, host gcc >= 9"
	depends on !BR2_INSTALL_LIBSTDCPP || \
		!BR2_TOOLCHAIN_GCC_AT_LEAST_9 || \
		!BR2_HOST_GCC_AT_LEAST_9 || \
		!(BR2_TOOLCHAIN_USES_GLIBC || BR2_TOOLCHAIN_USES_MUSL)
```

## package/pipewire-media-session/Config.in
```kconfig
config BR2_PACKAGE_PIPEWIRE_MEDIA_SESSION
	bool "pipewire media-session"
	depends on BR2_TOOLCHAIN_HAS_THREADS # alsa-lib, dbus
	depends on BR2_USE_MMU # dbus
	depends on BR2_PACKAGE_PIPEWIRE
	select BR2_PACKAGE_ALSA_LIB
	select BR2_PACKAGE_ALSA_LIB_UCM
	select BR2_PACKAGE_DBUS
	help
	  Build pipewire media-session support
```

## package/pipewire/Config.in
```kconfig
config BR2_PACKAGE_PIPEWIRE
	bool "pipewire"
	depends on !BR2_STATIC_LIBS
	depends on BR2_TOOLCHAIN_HAS_THREADS_NPTL # pthread_setname_np()
	depends on BR2_USE_MMU # fork()
	depends on BR2_TOOLCHAIN_GCC_AT_LEAST_5
	select BR2_PACKAGE_ALSA_LIB_UCM if BR2_PACKAGE_ALSA_LIB
	select BR2_PACKAGE_ALSA_LIB_SEQ if BR2_PACKAGE_ALSA_LIB
	select BR2_PACKAGE_BLUEZ5_UTILS_PLUGINS_AUDIO if BR2_PACKAGE_BLUEZ5_UTILS # runtime
	help
	  PipeWire is a server and user space API to deal with
	  multimedia pipelines.

	  https://pipewire.org/

if BR2_PACKAGE_PIPEWIRE

config BR2_PACKAGE_PIPEWIRE_COMPRESS_OFFLOAD
	bool "pipewire Compress-Offload"
	depends on !BR2_STATIC_LIBS # tinycompress
	depends on BR2_TOOLCHAIN_HEADERS_AT_LEAST_5_7
	select BR2_PACKAGE_TINYCOMPRESS
	help
	  Enable ALSA Compress-Offload support

comment "pipewire Compress-Offload needs a toolchain w/ dynamic library, headers >= 5.7"
	depends on BR2_STATIC_LIBS || \
		!BR2_TOOLCHAIN_HEADERS_AT_LEAST_5_7

config BR2_PACKAGE_PIPEWIRE_EXAMPLES
	bool "pipewire examples"
	help
	  Build pipewire examples

config BR2_PACKAGE_PIPEWIRE_GSTREAMER
	bool "pipewire gstreamer plugins"
	depends on BR2_USE_WCHAR # libglib2
	depends on BR2_TOOLCHAIN_HAS_THREADS # libglib2
	depends on BR2_USE_MMU # libglib2
	select BR2_PACKAGE_LIBGLIB2
	select BR2_PACKAGE_GSTREAMER1
	select BR2_PACKAGE_GST1_PLUGINS_BASE
	help
	  Build GStreamer plugins

comment "pipewire gstreamer support needs a toolchain w/ wchar, threads"
	depends on BR2_USE_MMU
	depends on !BR2_USE_WCHAR || !BR2_TOOLCHAIN_HAS_THREADS

config BR2_PACKAGE_PIPEWIRE_V4L2
	bool "pipewire v4l2 plugin"
	depends on BR2_PACKAGE_HAS_UDEV
	depends on BR2_TOOLCHAIN_HEADERS_AT_LEAST_3_18
	help
	  Build v4l2 plugin

comment "pipewire v4l2 support needs udev and a toolchain w/ headers >= 3.18"
	depends on !BR2_PACKAGE_HAS_UDEV || \
		!BR2_TOOLCHAIN_HEADERS_AT_LEAST_3_18

endif

comment "pipewire needs a toolchain w/ dynamic library, NTPL, gcc >= 5"
	depends on BR2_USE_MMU
	depends on BR2_STATIC_LIBS || \
		!BR2_TOOLCHAIN_HAS_THREADS_NPTL || \
		!BR2_TOOLCHAIN_GCC_AT_LEAST_5
```

## package/pistache/Config.in
```kconfig
config BR2_PACKAGE_PISTACHE
	bool "pistache"
	depends on BR2_TOOLCHAIN_GCC_AT_LEAST_7 # C++17, std::optional
	depends on BR2_USE_WCHAR
	depends on BR2_TOOLCHAIN_HAS_THREADS_NPTL
	depends on BR2_INSTALL_LIBSTDCPP
	select BR2_PACKAGE_RAPIDJSON
	help
	  Pistache is a modern and elegant HTTP and REST framework
	  for C++. It is entirely written in pure C++17 and provides
	  a clear and pleasant API.

	  https://github.com/oktal/pistache

comment "pistache needs a toolchain w/ C++, gcc >= 7, NPTL, wchar"
	depends on !BR2_INSTALL_LIBSTDCPP || \
		   !BR2_TOOLCHAIN_GCC_AT_LEAST_7 || \
		   !BR2_TOOLCHAIN_HAS_THREADS_NPTL || \
		   !BR2_USE_WCHAR
```

## package/playgiga/Config.in
```kconfig
config BR2_PACKAGE_PLAYGIGA
    bool "playgiga"
	depends on BR2_TOOLCHAIN_GCC_AT_LEAST_6
	select BR2_PACKAGE_LIBCURL
	select BR2_PACKAGE_OPUS

if BR2_PACKAGE_PLAYGIGA
config BR2_PACKAGE_PLAYGIGA_APP
    bool "Create playgiga app"
    default n
    help
       This option allows to create playgiga app,
       default is playgiga shared library
endif

comment "playgiga client source needs a toolchain gcc >= 6.0"
```

## package/playready/Config.in
```kconfig
config BR2_PACKAGE_PLAYREADY
	select BR2_PACKAGE_HAS_PLAYREADY
	depends on BR2_PACKAGE_WPEFRAMEWORK_CDMI_PLAYREADY
	bool "Playready v2.5"
	help
	  A playready v2.5 implementation port from Microsoft.

config BR2_PACKAGE_HAS_PLAYREADY
	bool

config BR2_PACKAGE_PROVIDES_PLAYREADY
	depends on BR2_PACKAGE_HAS_PLAYREADY
	string

if BR2_PACKAGE_PLAYREADY
config BR2_PACKAGE_PROVIDES_PLAYREADY
	default "playready"
endif

if BR2_PACKAGE_PLAYREADY
menu "Extra options"
config BR2_PLAYREADY_HAS_SECURECLOCK
       depends on BR2_PACKAGE_HAS_PLAYREADY
       bool "Secure AntiRollback Clock"
       help
         Enables the Antirollback clock
endmenu
endif
```

## package/playready4/Config.in
```kconfig
config BR2_PACKAGE_PLAYREADY4
        select BR2_PACKAGE_HAS_PLAYREADY
        select BR2_PACKAGE_LIBCURL
        select BR2_PACKAGE_WPEFRAMEWORK_PROVISIONING
        select BR2_PACKAGE_WPEFRAMEWORK_PROVISIONING_FILES
        depends on BR2_PACKAGE_WPEFRAMEWORK_CDMI_PLAYREADY
        bool "Playready v4.0"
        help
          A playready v4 implementation port from Microsoft.

config BR2_PACKAGE_HAS_PLAYREADY
        bool

config BR2_PACKAGE_PROVIDES_PLAYREADY
        depends on BR2_PACKAGE_HAS_PLAYREADY
        string

if BR2_PACKAGE_PLAYREADY
config BR2_PACKAGE_PROVIDES_PLAYREADY
        default "playready4"
endif
```

## package/pocketpy/Config.in
```kconfig
config BR2_PACKAGE_POCKETPY
	bool "pocketpy"
	depends on BR2_INSTALL_LIBSTDCPP
	depends on !BR2_STATIC_LIBS # dlfcn.h
	help
	  pocketpy is a portable Python 3.x interpreter,
	  written in C11.

	  https://github.com/pocketpy/pocketpy
```

## package/pocketsphinx/Config.in
```kconfig
config BR2_PACKAGE_POCKETSPHINX
        bool "pocketsphinx"
        select BR2_PACKAGE_SPHINXBASE
        help
          pocketsphnix is a speech recognizer software for English and
          other languages.

          http://cmusphinx.sourceforge.net/

#endif # BR2_PACKAGE_POCKETSPHINX
```

## package/poco/Config.in
```kconfig
config BR2_PACKAGE_POCO_ARCH_SUPPORTS
	bool
	default y
	depends on !BR2_arc
	depends on !BR2_microblaze
	depends on !BR2_mipsel
	depends on !BR2_or1k
	depends on !BR2_RISCV_32
	depends on !BR2_xtensa

config BR2_PACKAGE_POCO
	bool "poco"
	depends on BR2_INSTALL_LIBSTDCPP
	depends on BR2_USE_WCHAR
	depends on BR2_TOOLCHAIN_GCC_AT_LEAST_8 # C++17
	# pthread_condattr_setclock
	depends on BR2_TOOLCHAIN_HAS_THREADS_NPTL
	depends on !BR2_STATIC_LIBS # dlopen()
	depends on BR2_PACKAGE_POCO_ARCH_SUPPORTS
	select BR2_PACKAGE_PCRE2
	select BR2_PACKAGE_ZLIB
	help
	  The C++ Portable Components Libraries

	  http://pocoproject.org

if BR2_PACKAGE_POCO

comment "poco components"

config BR2_PACKAGE_POCO_ACTIVERECORD
	bool "ActiveRecord"
	select BR2_PACKAGE_POCO_XML

config BR2_PACKAGE_POCO_CPP_PARSER
	bool "CppParser"

config BR2_PACKAGE_POCO_CRYPTO
	bool "Crypto"
	select BR2_PACKAGE_LIBOPENSSL_ENABLE_DES if BR2_PACKAGE_LIBOPENSSL
	select BR2_PACKAGE_OPENSSL

config BR2_PACKAGE_POCO_DATA
	bool

config BR2_PACKAGE_POCO_DATA_MYSQL
	bool "Data/MySQL"
	depends on BR2_USE_MMU # mysql
	select BR2_PACKAGE_MARIADB
	select BR2_PACKAGE_POCO_DATA

config BR2_PACKAGE_POCO_DATA_PGSQL
	bool "Data/PostgreSQL"
	depends on BR2_USE_MMU # postgresql
	depends on BR2_USE_WCHAR # postgresql
	depends on BR2_ENABLE_LOCALE # postgresql
	depends on BR2_TOOLCHAIN_HAS_THREADS_NPTL # postgresql
	depends on !BR2_STATIC_LIBS # postgresql
	depends on !BR2_OPTIMIZE_FAST # postgresql
	select BR2_PACKAGE_POCO_DATA
	select BR2_PACKAGE_POSTGRESQL

comment "Data/PostgreSQL can't be built with Optimize for fast"
	depends on BR2_OPTIMIZE_FAST

config BR2_PACKAGE_POCO_DATA_SQLITE
	bool "Data/SQLite"
	select BR2_PACKAGE_POCO_DATA
	select BR2_PACKAGE_SQLITE

config BR2_PACKAGE_POCO_JSON
	bool "JSON"

config BR2_PACKAGE_POCO_JWT
	bool "JWT"
	select BR2_PACKAGE_POCO_CRYPTO
	select BR2_PACKAGE_POCO_JSON

config BR2_PACKAGE_POCO_MONGODB
	bool "MongoDB"
	select BR2_PACKAGE_POCO_NET

config BR2_PACKAGE_POCO_NET
	bool "Net"

config BR2_PACKAGE_POCO_NETSSL_OPENSSL
	bool "NetSSL_OpenSSL"
	select BR2_PACKAGE_OPENSSL
	select BR2_PACKAGE_POCO_CRYPTO
	select BR2_PACKAGE_POCO_NET
	select BR2_PACKAGE_POCO_UTIL

config BR2_PACKAGE_POCO_PDF
	bool "PDF"
	select BR2_PACKAGE_POCO_JSON
	select BR2_PACKAGE_POCO_UTIL
	select BR2_PACKAGE_POCO_XML

config BR2_PACKAGE_POCO_PROMETHEUS
	bool "Prometheus"
	select BR2_PACKAGE_POCO_NET

config BR2_PACKAGE_POCO_REDIS
	bool "Redis"
	select BR2_PACKAGE_POCO_NET

config BR2_PACKAGE_POCO_UTIL
	bool "Util"
	select BR2_PACKAGE_POCO_XML

config BR2_PACKAGE_POCO_XML
	bool "XML"
	select BR2_PACKAGE_EXPAT

config BR2_PACKAGE_POCO_ZIP
	bool "Zip"
	select BR2_PACKAGE_POCO_NET
	select BR2_PACKAGE_POCO_UTIL
	select BR2_PACKAGE_POCO_XML

endif # BR2_PACKAGE_POCO

comment "poco needs a toolchain w/ wchar, NPTL, C++, dynamic library, gcc >= 8"
	depends on !BR2_USE_WCHAR || !BR2_INSTALL_LIBSTDCPP \
		|| !BR2_TOOLCHAIN_HAS_THREADS_NPTL || BR2_STATIC_LIBS \
		|| !BR2_TOOLCHAIN_GCC_AT_LEAST_8
	depends on BR2_PACKAGE_POCO_ARCH_SUPPORTS
```
