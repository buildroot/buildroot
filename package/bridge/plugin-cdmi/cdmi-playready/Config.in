## package/bridge/plugin-cdmi/cdmi-playready/Config.in
```kconfig
config BR2_PACKAGE_CDMI_PLAYREADY
	bool "playready"
	depends on BR2_PACKAGE_PLUGIN_OPENCDMSERVER
	depends on BR2_PACKAGE_PLAYREADY
	help
	  PlayReady DRM OpenCDM(i) compatible plugin
```

## package/bridge/plugin-cdmi/cdmi-widevine/Config.in
```kconfig
config BR2_PACKAGE_CDMI_WIDEVINE
	bool "widevine"
	depends on BR2_PACKAGE_PLUGIN_OPENCDMSERVER
	depends on BR2_PACKAGE_WIDEVINE
	help
	  WideVine DRM OpenCDM(i) compatible plugin
```

## package/bridge/plugin-common/Config.in
```kconfig
config BR2_PACKAGE_PLUGIN_COMMON
	select BR2_PACKAGE_BRIDGE_CONTRACTS
	bool

config BR2_PACKAGE_PLUGIN_COMMANDER
	bool "Commander"
	select BR2_PACKAGE_PLUGIN_COMMON
	help
	  Commander Plugin

menuconfig BR2_PACKAGE_PLUGIN_COMPOSITOR
    select BR2_PACKAGE_BRIDGE_VIRTUALINPUT
    bool "Compositor"
    help
       Bridge Platform Compositor plugin

if BR2_PACKAGE_PLUGIN_COMPOSITOR

config BR2_PACKAGE_PLUGIN_COMPOSITOR_AUTOSTART
    bool "Start Automatically"
    help
      Select this to start the plugin automatically when starting WPEFramework

config BR2_PACKAGE_PLUGIN_COMPOSITOR_OUTOFPROCESS
    bool "Out of process"
    help
      Select this to run this plugin in its own process.

config BR2_PACKAGE_PLUGIN_COMPOSITOR_NEXUS_SERVER
    bool "Nexus server"
    depends on BR2_PACKAGE_HAS_NEXUS
    help
      Include a nxserver with the compositor.

if BR2_PACKAGE_PLUGIN_COMPOSITOR_NEXUS_SERVER

config BR2_PACKAGE_PLUGIN_COMPOSITOR_IRMODE
    string "IR mode"
    default "16"
    help
      Sets the IR Mode to be used with IR Nexus. Every remote has a different mode and key mapping.

config BR2_PACKAGE_PLUGIN_COMPOSITOR_BOXMODE
    string "Memory Box Mode"
    depends on BR2_PACKAGE_PLUGIN_COMPOSITOR_NEXUS_SERVER
    help
      Memory box mode, you can find details from release notes per platform

config BR2_PACKAGE_PLUGIN_COMPOSITOR_ALLOW_UNAUTHENTICATED_CLIENTS
    bool "Allow unauthenticated clients"
    depends on BR2_PACKAGE_PLUGIN_COMPOSITOR_NEXUS_SERVER
    default n

choice
    prompt "svp type"
    default BR2_PACKAGE_PLUGIN_COMPOSITOR_SVP_ALL if BR2_PACKAGE_BCM_REFSW_SAGE
    default BR2_PACKAGE_PLUGIN_COMPOSITOR_SVP_NONE if !BR2_PACKAGE_BCM_REFSW_SAGE

menuconfig BR2_PACKAGE_PLUGIN_COMPOSITOR_SVP_NONE
    bool "none"

menuconfig BR2_PACKAGE_PLUGIN_COMPOSITOR_SVP_VIDEO
    depends on BR2_PACKAGE_BCM_REFSW_SAGE
    bool "video"

menuconfig BR2_PACKAGE_PLUGIN_COMPOSITOR_SVP_ALL
    depends on BR2_PACKAGE_BCM_REFSW_SAGE
    bool "all"

endchoice

config BR2_PACKAGE_PLUGIN_COMPOSITOR_MEMORIES
    bool "Memories"
    depends on BR2_PACKAGE_PLUGIN_COMPOSITOR_NEXUS_SERVER
    default n
    help
      Allow memory heap updates

config BR2_PACKAGE_PLUGIN_COMPOSITOR_MEMORY_GFX
    string "Graphics Memory"
    depends on BR2_PACKAGE_PLUGIN_COMPOSITOR_NEXUS_SERVER && BR2_PACKAGE_PLUGIN_COMPOSITOR_MEMORIES
    help
      Allow update of Graphics memory. The amount of memory in MB to be configured for.

config BR2_PACKAGE_PLUGIN_COMPOSITOR_MEMORY_GFX2
    string "Secondary Graphics Memory"
    depends on BR2_PACKAGE_PLUGIN_COMPOSITOR_NEXUS_SERVER && BR2_PACKAGE_PLUGIN_COMPOSITOR_MEMORIES
    help
      Allow update of Secondary Graphics memory. The amount of memory in MB to be configured for.

config BR2_PACKAGE_PLUGIN_COMPOSITOR_MEMORY_RESTRICTED
    string "Compressed Restricted Region Memory (Video Secure)"
    depends on BR2_PACKAGE_PLUGIN_COMPOSITOR_NEXUS_SERVER && BR2_PACKAGE_PLUGIN_COMPOSITOR_MEMORIES
    help
      Allow update of Compressed Restricted Region Memory (Video Secure) memory. The amount of memory in MB to be configured for.

config BR2_PACKAGE_PLUGIN_COMPOSITOR_MEMORY_MAIN
    string "Main Memory"
    depends on BR2_PACKAGE_PLUGIN_COMPOSITOR_NEXUS_SERVER && BR2_PACKAGE_PLUGIN_COMPOSITOR_MEMORIES
    help
      Allow update of main memory. The amount of memory in MB to be configured for.

config BR2_PACKAGE_PLUGIN_COMPOSITOR_MEMORY_EXPORT
    string "Export Memory"
    depends on BR2_PACKAGE_PLUGIN_COMPOSITOR_NEXUS_SERVER && BR2_PACKAGE_PLUGIN_COMPOSITOR_MEMORIES
    help
      Allow update of Export Region memory. The ammount of memory in MB to be configured for.

config BR2_PACKAGE_PLUGIN_COMPOSITOR_MEMORY_SECUREGFX
    string "Secure Graphics Memory"
    depends on BR2_PACKAGE_PLUGIN_COMPOSITOR_NEXUS_SERVER && BR2_PACKAGE_PLUGIN_COMPOSITOR_MEMORIES
    help
      Allow update of Secure Graphics memory. The amount of memory in MB to be configured for.

config BR2_PACKAGE_PLUGIN_COMPOSITOR_MEMORY_CLIENT
    string "Client Memory"
    depends on BR2_PACKAGE_PLUGIN_COMPOSITOR_NEXUS_SERVER && BR2_PACKAGE_PLUGIN_COMPOSITOR_MEMORIES
    depends on BR2_PACKAGE_BCM_REFSW_SAGE
    help
      Allow update of Client memory. SAGE must be told which heap the client's will be using. The amount of memory in MB to be configured for.

config BR2_PACKAGE_PLUGIN_COMPOSITOR_HARDWAREREADY
    string "Manual overrule of the time it takes to initialisize all hardware (ms)"
    default 0

endif
endif

config BR2_PACKAGE_PLUGIN_DIALSERVER
	bool "DialServer"
	select BR2_PACKAGE_PLUGIN_COMMON
	help
	  DIALServer Plugin

config BR2_PACKAGE_PLUGIN_DEVICEINFO
	bool "DeviceInfo"
	select BR2_PACKAGE_PLUGIN_COMMON
	help
	  DeviceInfo Plugin

config BR2_PACKAGE_PLUGIN_DHCPSERVER
	bool "DHCPServer"
	select BR2_PACKAGE_PLUGIN_COMMON
	help
	  DHCPServer Plugin, implements the dhcp protocol as server (IPv4 only).

config BR2_PACKAGE_PLUGIN_DISPLAYINFO
	bool "DisplayInfo"
	select BR2_PACKAGE_PLUGIN_COMMON
	help
	  DisplayInfo Plugin

config BR2_PACKAGE_PLUGIN_LAUNCHER
	bool "Launcher"
	select BR2_PACKAGE_PLUGIN_COMMON
	help
	  Launcher Plugin
	
menuconfig BR2_PACKAGE_PLUGIN_LOCATIONSYNC
	bool "LocationSync"
	select BR2_PACKAGE_PLUGIN_COMMON
	help
	  LocationSync Plugin
	   
if BR2_PACKAGE_PLUGIN_LOCATIONSYNC

config BR2_PACKAGE_PLUGIN_LOCATIONSYNC_URI
	string "location URI"
	default "http://ip-api.com/json"
endif	   

config BR2_PACKAGE_PLUGIN_MONITOR
	bool "Monitor"
	select BR2_PACKAGE_PLUGIN_COMMON
	help
	  Monitor Plugin

menuconfig BR2_PACKAGE_PLUGIN_NETWORKCONTROL
	bool "NetworkControl"
	select BR2_PACKAGE_PLUGIN_COMMON
	help
	  Network Control Plugin, configures network interfaces, static (IPv4/IPv6) or using dhcp (IPv4).

if BR2_PACKAGE_PLUGIN_NETWORKCONTROL

config BR2_PACKAGE_PLUGIN_NETWORKCONTROL_INTERFACES
    string "Network Interfaces Details"
    default "eth0:Dynamic:::;wlan0:Dynamic:::;"
    help
      Set details of network interfaces in the format "Name:Mode:Address:Netmask:Gateway".
      Example "wlan0:Manual:192.168.55.1:24:192.168.55.1;eth0:Manual:192.168.1.158:24:192.168.1.1;eth1:Dynamic:::;"

endif

menuconfig BR2_PACKAGE_PLUGIN_OPENCDMSERVER
	bool "OpenCDMServer"
	select BR2_PACKAGE_PLUGIN_COMMON
	help
	  Open CDM Server, loads and hosts the OpenCDMi plugins.

if BR2_PACKAGE_PLUGIN_OPENCDMSERVER
source "package/bridge/plugin-cdmi/Config.in"
endif

config BR2_PACKAGE_PLUGIN_TIMESYNC
	bool "TimeSync"
	select BR2_PACKAGE_PLUGIN_COMMON
	help
	  TimeSync Plugin

config BR2_PACKAGE_PLUGIN_PLAYERINFO
	bool "PlayerInfo"
	select BR2_PACKAGE_PLUGIN_COMMON
	help
	  PlayerInfo Plugin

menuconfig BR2_PACKAGE_PLUGIN_REMOTECONTROL
	bool "RemoteControl"
	select BR2_PACKAGE_PLUGIN_COMMON
	help
	  RemoteControl Plugin

if BR2_PACKAGE_PLUGIN_REMOTECONTROL

config BR2_PACKAGE_PLUGIN_REMOTECONTROL_IR
    bool "IR (Infrared)"
    help
      Select devices which are based on Infrared (IR) technology

config BR2_PACKAGE_PLUGIN_REMOTECONTROL_IRNEXUS
    bool "BCM Nexus IR Remote Control Unit"
    default false
    depends on BR2_PACKAGE_BCM_REFSW && BR2_PACKAGE_PLUGIN_REMOTECONTROL_IR
    help
      Enable the Nexus IR remote input

config BR2_PACKAGE_PLUGIN_REMOTECONTROL_IRNEXUS_MODE
    string "IR mode"
    default "16"
    depends on BR2_PACKAGE_PLUGIN_REMOTECONTROL_IRNEXUS
    help
      Sets the IR Mode to be used with IR Nexus. Every remote has a different mode and key mapping.

config BR2_PACKAGE_PLUGIN_REMOTECONTROL_IRNEXUS_CODEMASK
    string "IR code mask"
    depends on BR2_PACKAGE_PLUGIN_REMOTECONTROL_IRNEXUS
    help
      Sets a key code mask if the device generates same code based on trigger bit

config BR2_PACKAGE_PLUGIN_REMOTECONTROL_RF
    bool "RF (Radio Frequency)"
    help
      Select devices which are based on Radio Frequency (RF) technology

endif

config BR2_PACKAGE_PLUGIN_SNAPSHOT
	bool "Snapshot"
	select BR2_PACKAGE_PLUGIN_COMMON
	help
	  Snapshot Plugin

config BR2_PACKAGE_PLUGIN_TRACECONTROL
	bool "TraceControl"
	select BR2_PACKAGE_PLUGIN_COMMON
	help
	  TraceControl Plugin

menuconfig BR2_PACKAGE_PLUGIN_WEBKITBROWSER
	bool "WebKitBrowser"
	depends on BR2_PACKAGE_WPEWEBKIT
	select BR2_PACKAGE_PLUGIN_COMMON
	help
	  WebKitBrowser Plugin

if BR2_PACKAGE_PLUGIN_WEBKITBROWSER

config BR2_PACKAGE_PLUGIN_WEBKITBROWSER_AUTOSTART
    bool "autostart"
    default y

config BR2_PACKAGE_PLUGIN_WEBKITBROWSER_STARTURL
    string "start-url"
    default "about:blank"

config BR2_PACKAGE_PLUGIN_WEBKITBROWSER_USERAGENT
    string "useragent"
    default "Mozilla/5.0 (Macintosh, Intel Mac OS X 10_11_4) AppleWebKit/602.1.28+ (KHTML, like Gecko) Version/9.1 Safari/601.5.17"

config BR2_PACKAGE_PLUGIN_WEBKITBROWSER_MEMORYPROFILE
    string "memory-profile"
    default "128m"

config BR2_PACKAGE_PLUGIN_WEBKITBROWSER_MEMORYPRESSURE
    string "memory-pressure"
    default "databaseprocess:50m,networkprocess:100m,webprocess:300m,rpcprocess:50m"

config BR2_PACKAGE_PLUGIN_WEBKITBROWSER_MEDIADISKCACHE
    bool "media-disk-cache"
    default n

config BR2_PACKAGE_PLUGIN_WEBKITBROWSER_DISKCACHE
    string "disk-cache"
    default "0"

config BR2_PACKAGE_PLUGIN_WEBKITBROWSER_XHRCACHE
    bool "xhr-cache"
    default false

config BR2_PACKAGE_PLUGIN_WEBKITBROWSER_TRANSPARENT
    bool "transparent"
    default false

config BR2_PACKAGE_PLUGIN_YOUTUBE
    bool "youtube"
    help
      A wrapper around the youtube app to start it as a
      wpeframework plugin.

endif

config BR2_PACKAGE_PLUGIN_WEBPROXY
	bool "WebProxy"
	select BR2_PACKAGE_PLUGIN_COMMON
	help
	   WebProxy Plugin

menuconfig BR2_PACKAGE_PLUGIN_WEBSERVER
	bool "WebServer"
	select BR2_PACKAGE_PLUGIN_COMMON
	help
	  WebServer Plugin

if BR2_PACKAGE_PLUGIN_WEBSERVER

config BR2_PACKAGE_PLUGIN_WEBSERVER_PATH
	string "path"
	default "/www"

config BR2_PACKAGE_PLUGIN_WEBSERVER_PORT
	string "port"
	default "8080"

endif

config BR2_PACKAGE_PLUGIN_WEBSHELL
	bool "WebShell"
	select BR2_PACKAGE_PLUGIN_COMMON
	help
	  WebShell Plugin

config BR2_PACKAGE_PLUGIN_WIFI
	bool "WifiControl"
	select BR2_PACKAGE_PLUGIN_COMMON
	help
	  WifiControl Plugin


config BR2_PACKAGE_PLUGIN_TUNER
	bool "Tuner"
	select BR2_PACKAGE_PLUGIN_COMMON
	help
	  Tuner Plugin

config BR2_PACKAGE_PLUGIN_RPCLINK
	bool "RPC link server"
	select BR2_PACKAGE_PLUGIN_COMMON
	help
	  Plugin adding an RPC server to act as a server itself
```

## package/bridge/plugin-domotica/Config.in
```kconfig
config BR2_PACKAGE_PLUGIN_DOMOTICA
	bool

config BR2_PACKAGE_PLUGIN_BARN
	bool "Barn"
	select BR2_PACKAGE_BRIDGE_DEVICES
        select BR2_PACKAGE_PLUGIN_DOMOTICA
	help
	   Hardcoded rules in a plugin for a dedictaed service.

config BR2_PACKAGE_PLUGIN_BUTLER
	bool "Butler"
        select BR2_PACKAGE_PLUGIN_DOMOTICA
	help
	   Butler plugin

config BR2_PACKAGE_PLUGIN_I2CCONTROL
	bool "I2CControl"
	select BR2_PACKAGE_BRIDGE_DEVICES
        select BR2_PACKAGE_PLUGIN_DOMOTICA
	help
	   I2CControl plugin

config BR2_PACKAGE_PLUGIN_IOCONTROL
	bool "IOControl"
	select BR2_PACKAGE_BRIDGE_DEVICES
        select BR2_PACKAGE_PLUGIN_DOMOTICA
	help
	   IOControl plugin

config BR2_PACKAGE_PLUGIN_ONEWIRECONTROL
	bool "OneWireControl"
	select BR2_PACKAGE_BRIDGE_DEVICES
        select BR2_PACKAGE_PLUGIN_DOMOTICA
	help
	   1-Wire Control plugin

config BR2_PACKAGE_PLUGIN_RADIOCONTROL
	bool "RadioControl"
        select BR2_PACKAGE_PLUGIN_DOMOTICA
	help
	   RadioControl (NRF24L01) plugin

config BR2_PACKAGE_PLUGIN_SCRIPTENGINE
	bool "ScriptEngine"
        select BR2_PACKAGE_PLUGIN_DOMOTICA
	help
	   Script Engine plugin

config BR2_PACKAGE_PLUGIN_SPICONTROL
	bool "SPIControl"
	select BR2_PACKAGE_BRIDGE_DEVICES
        select BR2_PACKAGE_PLUGIN_DOMOTICA
	help
	   SPIControl plugin

config BR2_PACKAGE_PLUGIN_TEMPCONTROL
	bool "TempControl"
	select BR2_PACKAGE_BRIDGE_DEVICES
        select BR2_PACKAGE_PLUGIN_DOMOTICA
	help
	   TempControl plugin

config BR2_PACKAGE_PLUGIN_VIRTUALCONTROL
	bool "VirtualControl"
        select BR2_PACKAGE_PLUGIN_DOMOTICA
	help
	   VirtualControl plugin

menuconfig BR2_PACKAGE_PLUGIN_ZIGBEECONTROL
	bool "ZigBeeControl"
	select BR2_PACKAGE_BRIDGE_ZIGBEE
        select BR2_PACKAGE_PLUGIN_DOMOTICA
	help
	   ZIGBEE control plugin

if BR2_PACKAGE_PLUGIN_ZIGBEECONTROL

config BR2_PACKAGE_ZIGBEE_PORT
        string "port"
        default "/dev/ttyAMA0"

config BR2_PACKAGE_ZIGBEE_WATCHDOG_TIME
        string "watchdog"
        default "62"
        help
          Watchdog time in minutes. The hosts software will trigger the ZigBee
          device within this period (and configure the stick for this watchdog)

endif


config BR2_PACKAGE_PLUGIN_ZWAVECONTROL
	bool "ZWaveControl"
	select BR2_PACKAGE_BRIDGE_ZWAVE
        select BR2_PACKAGE_PLUGIN_DOMOTICA
	help
	   ZWAVE control plugin
```

## package/bridge/plugin-espial/Config.in
```kconfig
menuconfig BR2_PACKAGE_WPEFRAMEWORK_ESPIAL
    bool "Espial"
    depends on BR2_PACKAGE_ESPIAL_SDK
    help
        WPE Platform Espial Browser plugin

if BR2_PACKAGE_WPEFRAMEWORK_ESPIAL

config BR2_PACKAGE_WPEFRAMEWORK_PLUGIN_ESPIAL_AUTOSTART
    bool "autostart"
    default n

config BR2_PACKAGE_WPEFRAMEWORK_PLUGIN_ESPIAL_URL
    string "URL"
    default "http://www.google.com"

endif

comment "Espial Browser is dependent on the espial-sdk package included"
    depends on !BR2_PACKAGE_ESPIAL_SDK
```

## package/bridge/plugin-netflix/Config.in
```kconfig
menuconfig BR2_PACKAGE_PLUGIN_NETFLIX
    bool "Netflix"
    depends on BR2_PACKAGE_NETFLIX_LIB
    help
        Netflix plugin

if BR2_PACKAGE_PLUGIN_NETFLIX

config BR2_PACKAGE_PLUGIN_NETFLIX_AUTOSTART
    depends on BR2_PACKAGE_PLUGIN_NETFLIX
    bool "autostart"
    default n

config BR2_PACKAGE_PLUGIN_NETFLIX_MODEL
    depends on BR2_PACKAGE_PLUGIN_NETFLIX
    string "model"
    default "Metrological Reference DPI Implementation"

config BR2_PACKAGE_PLUGIN_NETFLIX_SUSPEND_TIMEOUT
    depends on BR2_PACKAGE_PLUGIN_NETFLIX
    int "suspend timeout"
    range 0 300000
    default 5000
    help
        Suspend timeout in milliseconds. If timeout is exceeded, deactivate application.
        min. 0 millisecond
        max. 300000 milliseconds

config BR2_PACKAGE_PLUGIN_NETFLIX_RESUME_TIMEOUT
    depends on BR2_PACKAGE_PLUGIN_NETFLIX
    int "resume timeout"
    range 0 300000
    default 30000
    help
        Resume timeout in milliseconds. If timeout is exceeded, deactivate application.
        min. 0 millisecond
        max. 300000 milliseconds

endif

comment "netflix is dependent on the netflix package compiled as library"
    depends on !BR2_PACKAGE_NETFLIX_LIB
```

## package/bridge/plugin-provisioning/Config.in
```kconfig
config BR2_PACKAGE_PLUGIN_PROVISIONING
	bool "Provisioning"
	depends on BR2_PACKAGE_BRIDGE_PROVISIONPROXY
	help
	   Provisioning plugin

if BR2_PACKAGE_PLUGIN_PROVISIONING
config BR2_PACKAGE_PLUGIN_PROVISIONING_CACHE_PERIODE
    int "cache period (s)"
    default 2592000
    help
        Define the cache period in seconds.
        Set to 0 to disable.

config BR2_PACKAGE_PLUGIN_PROVISIONING_URI
        string "provisioning URI"
        default "provisioning-sdk.metrological.com:80"

config BR2_PACKAGE_PLUGIN_PROVISIONING_OPERATOR
        string "operator"
        default "liberty"
endif

comment "Provisioning is dependent on the bridge extension - provison proxy"
    depends on !BR2_PACKAGE_BRIDGE_PROVISIONPROXY
```
