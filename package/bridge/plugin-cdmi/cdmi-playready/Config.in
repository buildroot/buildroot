## package/bridge/plugin-spotify/Config.in
```kconfig
config BR2_PACKAGE_PLUGIN_SPOTIFY
	bool "Spotify"
	select BR2_PACKAGE_ALSA_LIB
	help
	   WPE Platform plugins that supports spotify services.
            - Spotify connect
```

## package/bridge/plugin-switchboard/Config.in
```kconfig
config BR2_PACKAGE_PLUGIN_SWITCHBOARD
	bool "SwitchBoard"
	help
	   Switch Board plugin
```

## package/broot/Config.in
```kconfig
config BR2_PACKAGE_BROOT
	bool "broot"
	depends on BR2_PACKAGE_HOST_RUSTC_TARGET_ARCH_SUPPORTS
	select BR2_PACKAGE_HOST_RUSTC
	help
	  Broot is a fast and powerful file manager written in Rust and
	  licensed under MIT license. It supports filters, regular
	  expressions, and real-time "show-as-you-type" search for quick
	  and easy navigation, even in complex directory structures.

	  https://github.com/Canop/broot
```

## package/bullet/Config.in
```kconfig
config BR2_PACKAGE_BULLET
	bool "bullet"
	depends on BR2_INSTALL_LIBSTDCPP
	depends on !BR2_STATIC_LIBS # dlfcn.h
	depends on BR2_TOOLCHAIN_HAS_THREADS
	depends on BR2_USE_WCHAR
	help
	  Bullet is a Collision Detection and Rigid Body Dynamics
	  Library.

	  http://bulletphysics.org

comment "bullet needs a toolchain w/ C++, dynamic library, threads, wchar"
	depends on !BR2_INSTALL_LIBSTDCPP || BR2_STATIC_LIBS || \
		!BR2_TOOLCHAIN_HAS_THREADS || !BR2_USE_WCHAR
```

## package/bvi/Config.in
```kconfig
config BR2_PACKAGE_BVI
	bool "bvi"
	select BR2_PACKAGE_NCURSES
	help
	  A visual editor for binary files. Bvi allows the user to
	  edit binary files with a VI-like interface.

	  https://sourceforge.net/projects/bvi
```

## package/ca-certificates/Config.in.host
```kconfig
config BR2_PACKAGE_HOST_CA_CERTIFICATES
	bool "Host CA Certificates"
	help
	  This package includes PEM files of CA certificates to allow
	  SSL-based applications to check for the authenticity of SSL
	  connections on the host.

	  It includes, among others, certificate authorities used by the
	  Debian infrastructure and those shipped with Mozilla's
	  browsers.

	  https://salsa.debian.org/debian/ca-certificates
```

## package/cage/Config.in
```kconfig
comment "cage needs udev, EGL w/ Wayland backend and OpenGL ES support"
	depends on !BR2_PACKAGE_HAS_LIBEGL || \
		!BR2_PACKAGE_HAS_LIBEGL_WAYLAND || \
		!BR2_PACKAGE_HAS_LIBGLES || \
		!BR2_PACKAGE_HAS_UDEV

comment "cage needs a toolchain w/ threads, dynamic library"
	depends on !BR2_TOOLCHAIN_HAS_THREADS || \
		BR2_STATIC_LIBS

config BR2_PACKAGE_CAGE
	bool "cage"
	depends on !BR2_STATIC_LIBS # wlroots
	depends on BR2_TOOLCHAIN_HAS_THREADS # wlroots
	depends on BR2_PACKAGE_HAS_LIBEGL # wlroots
	depends on BR2_PACKAGE_HAS_LIBEGL_WAYLAND # wlroots
	depends on BR2_PACKAGE_HAS_LIBGLES # wlroots
	depends on BR2_PACKAGE_HAS_UDEV # wlroots
	select BR2_PACKAGE_WLROOTS
	help
	  Kiosk compositor for Wayland, which displays a single
	  maximized application at a time.

	  https://www.hjdskes.nl/projects/cage/
```

## package/cairo/Config.in
```kconfig
config BR2_PACKAGE_CAIRO
	bool "cairo"
	select BR2_PACKAGE_PIXMAN
	select BR2_PACKAGE_FONTCONFIG
	select BR2_PACKAGE_XLIB_LIBX11 if BR2_PACKAGE_XORG7
	select BR2_PACKAGE_XLIB_LIBXEXT if BR2_PACKAGE_XORG7
	select BR2_PACKAGE_XLIB_LIBXRENDER if BR2_PACKAGE_XORG7
	help
	  Cairo is a 2D graphics library with support for multiple
	  output devices. Currently supported output targets include
	  the X Window System, Win32, image buffers, and PostScript,
	  PDF, and SVG file output. Experimental backends include
	  OpenGL (through glitz), Quartz, and XCB.

	  http://cairographics.org/

if BR2_PACKAGE_CAIRO

config BR2_PACKAGE_CAIRO_PNG
	bool "png support (png and svg surfaces)"
	select BR2_PACKAGE_LIBPNG

config BR2_PACKAGE_CAIRO_TEE
	bool "tee support"

config BR2_PACKAGE_CAIRO_ZLIB
	bool "zlib support (script, ps, pdf, and xml surfaces)"
	select BR2_PACKAGE_ZLIB

endif
```

## package/cairomm/Config.in
```kconfig
config BR2_PACKAGE_CAIROMM
	bool "cairomm (latest)"
	depends on BR2_TOOLCHAIN_GCC_AT_LEAST_7 # libsigc
	depends on BR2_TOOLCHAIN_HAS_THREADS # libglib2
	depends on BR2_USE_WCHAR # libglib2
	depends on BR2_USE_MMU # libglib2
	depends on BR2_INSTALL_LIBSTDCPP
	select BR2_PACKAGE_CAIRO
	select BR2_PACKAGE_LIBGLIB2
	select BR2_PACKAGE_LIBSIGC
	help
	  The cairomm package is a set of C++ bindings for Cairo.

	  https://www.cairographics.org/cairomm/

comment "cairomm needs a toolchain w/ C++, wchar, threads, gcc >= 7"
	depends on BR2_USE_MMU
	depends on !BR2_TOOLCHAIN_GCC_AT_LEAST_7 || !BR2_USE_WCHAR \
		|| !BR2_TOOLCHAIN_HAS_THREADS || !BR2_INSTALL_LIBSTDCPP
```

## package/cairomm1_14/Config.in
```kconfig
config BR2_PACKAGE_CAIROMM1_14
	bool "cairomm (1.14.x)"
	depends on BR2_TOOLCHAIN_GCC_AT_LEAST_4_9 # C++11
	depends on BR2_TOOLCHAIN_HAS_THREADS # libglib2
	depends on BR2_USE_WCHAR # libglib2
	depends on BR2_USE_MMU # libglib2
	depends on BR2_INSTALL_LIBSTDCPP
	select BR2_PACKAGE_CAIRO
	select BR2_PACKAGE_LIBGLIB2
	select BR2_PACKAGE_LIBSIGC2
	help
	  The cairomm package is a set of C++ bindings for Cairo.

	  This is the last version before the API and ABI change
	  introduced in 1.16.0 which requires C++17.

	  https://www.cairographics.org/cairomm/

comment "cairomm (1.14.x) needs a toolchain w/ C++, wchar, threads, gcc >= 4.9"
	depends on BR2_USE_MMU
	depends on !BR2_TOOLCHAIN_GCC_AT_LEAST_4_9 || !BR2_USE_WCHAR \
		|| !BR2_TOOLCHAIN_HAS_THREADS || !BR2_INSTALL_LIBSTDCPP
```

## package/casync-nano/Config.in
```kconfig
config BR2_PACKAGE_CASYNC_NANO
	bool "casync-nano"
	select BR2_PACKAGE_OPENSSL
	select BR2_PACKAGE_LIBOPENSSL_ENABLE_CHACHA if BR2_PACKAGE_LIBOPENSSL
	select BR2_PACKAGE_ZSTD
	select BR2_PACKAGE_LIBCURL
	help
	  Tiny casync-like tool optimized for embedded systems.

	  https://github.com/florolf/casync-nano

if BR2_PACKAGE_CASYNC_NANO

config BR2_PACKAGE_CASYNC_NANO_CASYNC_SHIM
	bool "install casync shim"
	# only one package should provide the "casync" command
	depends on !BR2_PACKAGE_CASYNC
	help
	  Install a shim that provides basic compatibility with the
	  "extract" sub-command of casync to programs that expect it.

endif
```

## package/casync-nano/Config.in.host
```kconfig
config BR2_PACKAGE_HOST_CASYNC_NANO
	bool "host casync-nano tool"
	help
	  casync-nano host tool (csn-tool) for casync-nano specific
	  features like chunk encryption.

	  https://github.com/florolf/casync-nano
```

## package/catatonit/Config.in
```kconfig
config BR2_PACKAGE_CATATONIT
	bool "catatonit"
	depends on BR2_USE_MMU
	help
	  catatonit is a simple but valid init binary to act as
	  PID 1 for containers.

	  https://github.com/openSUSE/catatonit
```

## package/catch2/Config.in
```kconfig
config BR2_PACKAGE_CATCH2
	bool "catch2"
	depends on BR2_USE_WCHAR
	depends on BR2_TOOLCHAIN_HAS_THREADS
	depends on BR2_INSTALL_LIBSTDCPP
	depends on BR2_TOOLCHAIN_GCC_AT_LEAST_5 # C++14
	depends on BR2_USE_MMU # fork()
	help
	  Catch2 is mainly a unit testing framework for C++, but it
	  also provides basic micro-benchmarking features, and simple
	  BDD macros.

	  Catch2's main advantage is that using it is both simple and
	  natural. Tests autoregister themselves and do not have to
	  be named with valid identifiers, assertions look like
	  normal C++ code, and sections provide a nice way to share
	  set-up and tear-down code in tests.

	  This package allows running testsuites on the target which
	  might be advantageous in certain cases.

	  https://github.com/catchorg/Catch2

comment "catch2 needs a toolchain w/ C++, wchar, threads, gcc >= 5"
	depends on BR2_USE_MMU
	depends on !BR2_USE_WCHAR || !BR2_TOOLCHAIN_HAS_THREADS || \
		!BR2_INSTALL_LIBSTDCPP || \
		!BR2_TOOLCHAIN_GCC_AT_LEAST_5
```

## package/ccspcommonlibrary/Config.in
```kconfig
config BR2_PACKAGE_CCSPCOMMONLIBRARY
    bool "CCSP Common Library"
    select BR2_PACKAGE_DBUS
    select BR2_PACKAGE_RBUS
    select BR2_PACKAGE_SAFECLIB
    default n
    help
       Ccsp common library
```

## package/ccspcr/Config.in
```kconfig
config BR2_PACKAGE_CCSPCR
    bool "CCSP cr module"
    select BR2_PACKAGE_TELEMETRY
    select BR2_PACKAGE_LIBUNPRIV
    default n
    help
       Ccsp cr module
```

## package/cfm/Config.in
```kconfig
config BR2_PACKAGE_CFM
	bool "cfm"
	depends on BR2_TOOLCHAIN_HAS_THREADS
	depends on BR2_TOOLCHAIN_HEADERS_AT_LEAST_5_0
	select BR2_PACKAGE_LIBEV
	select BR2_PACKAGE_LIBMNL
	select BR2_PACKAGE_LIBNL
	help
	  This is the userspace application that configures the kernel
	  to run CFM protocol. The userspace application is made of 2
	  applications, one daemon and a client.

	  https://github.com/microchip-ung/cfm

comment "cfm needs a toolchain w/ threads, kernel headers >= 5.0"
	depends on !BR2_TOOLCHAIN_HAS_THREADS \
		|| !BR2_TOOLCHAIN_HEADERS_AT_LEAST_5_0
```

## package/cgroupfs-mount/Config.in
```kconfig
config BR2_PACKAGE_CGROUPFS_MOUNT
	bool "cgroupfs-mount"
	depends on !BR2_INIT_SYSTEMD
	help
	  cgroupfs mount and umount scripts.

	  Requires a Linux kernel >= 3.0

	  https://github.com/tianon/cgroupfs-mount
```
