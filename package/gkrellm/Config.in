## package/gkrellm/Config.in
```kconfig
config BR2_PACKAGE_GKRELLM
	bool "gkrellm"
	depends on BR2_USE_WCHAR # libglib2
	depends on BR2_TOOLCHAIN_HAS_THREADS # libglib2
	depends on BR2_USE_MMU # libglib2
	select BR2_PACKAGE_LIBGLIB2
	help
	  GKrellM is a single process stack of system monitors.
	  This package only contains the server part. The client
	  can run on a different machine.

	  http://gkrellm.srcbox.net/

comment "gkrellm needs a toolchain w/ wchar, threads"
	depends on BR2_USE_MMU
	depends on !BR2_USE_WCHAR || !BR2_TOOLCHAIN_HAS_THREADS
```

## package/glibc/Config.in
```kconfig
if BR2_TOOLCHAIN_BUILDROOT_GLIBC

comment "Glibc Options"

config BR2_PACKAGE_GLIBC
	bool
	default y
	select BR2_PACKAGE_LINUX_HEADERS
	select BR2_TOOLCHAIN_HAS_SSP if BR2_PACKAGE_HOST_BINUTILS_SUPPORTS_CFI
	help
	  https://www.gnu.org/software/libc/

config BR2_PACKAGE_GLIBC_KERNEL_COMPAT
	bool "Enable compatibility shims to run on older kernels"
	help
	  Say 'y' here if you plan on running your system on a kernel
	  older than the version used for the toolchain headers.

	  Enabling those compatibility shims may generate a slightly
	  bigger and slightly slower glibc library.

	  The oldest supported kernel version depends on the
	  architecture.

config BR2_PACKAGE_GLIBC_UTILS
	bool "Install glibc utilities"
	help
	  Enabling this option will compile and install the getconf,
	  ldconfig, ldd and locale glibc utilities for the target.

endif # BR2_TOOLCHAIN_BUILDROOT_GLIBC
```

## package/glibmm/Config.in
```kconfig
config BR2_PACKAGE_GLIBMM
	bool "glibmm (latest)"
	depends on BR2_TOOLCHAIN_GCC_AT_LEAST_7 # libsigc
	depends on BR2_INSTALL_LIBSTDCPP
	depends on BR2_USE_WCHAR # libglib2
	depends on BR2_TOOLCHAIN_HAS_THREADS # libglib2
	depends on BR2_USE_MMU # libglib2
	select BR2_PACKAGE_LIBGLIB2
	select BR2_PACKAGE_LIBSIGC
	help
	  The GLibmm package is a set of C++ bindings for GLib.

	  http://www.gtkmm.org/

comment "glibmm needs a toolchain w/ C++, wchar, threads, gcc >= 7"
	depends on BR2_USE_MMU
	depends on !BR2_TOOLCHAIN_GCC_AT_LEAST_7 || !BR2_USE_WCHAR \
		|| !BR2_INSTALL_LIBSTDCPP || !BR2_TOOLCHAIN_HAS_THREADS
```

## package/glibmm2_66/Config.in
```kconfig
config BR2_PACKAGE_GLIBMM2_66
	bool "glibmm (2.66.x)"
	depends on BR2_TOOLCHAIN_GCC_AT_LEAST_4_9 # regex_replace
	depends on BR2_INSTALL_LIBSTDCPP
	depends on BR2_USE_WCHAR # libglib2
	depends on BR2_TOOLCHAIN_HAS_THREADS # libglib2
	depends on BR2_USE_MMU # libglib2
	select BR2_PACKAGE_LIBGLIB2
	select BR2_PACKAGE_LIBSIGC2
	help
	  The GLibmm package is a set of C++ bindings for GLib.

	  This is the last version before the API and ABI change
	  introduced in 2.68.0 which requires C++17.

	  http://www.gtkmm.org/

comment "glibmm (2.66.x) needs a toolchain w/ C++, wchar, threads, gcc >= 4.9"
	depends on BR2_USE_MMU
	depends on !BR2_TOOLCHAIN_GCC_AT_LEAST_4_9 || !BR2_USE_WCHAR \
		|| !BR2_INSTALL_LIBSTDCPP || !BR2_TOOLCHAIN_HAS_THREADS
```

## package/glog/Config.in
```kconfig
config BR2_PACKAGE_GLOG
	bool "glog"
	depends on BR2_INSTALL_LIBSTDCPP
	depends on BR2_TOOLCHAIN_HAS_THREADS
	depends on BR2_TOOLCHAIN_GCC_AT_LEAST_6 # C++14
	help
	  C++ implementation of the Google logging module

	  https://github.com/google/glog

comment "glog needs a toolchain w/ C++, threads, gcc >= 6"
	depends on !BR2_INSTALL_LIBSTDCPP || \
		!BR2_TOOLCHAIN_HAS_THREADS || \
		!BR2_TOOLCHAIN_GCC_AT_LEAST_6
```

## package/gluelogic/Config.in
```kconfig
config BR2_PACKAGE_GLUELOGIC
	bool "gluelogic"
	select BR2_PACKAGE_CPPSDK
	help
	  Vendor specific solutions to glue browser and webbridge together. 

if BR2_PACKAGE_GLUELOGIC
	
config BR2_PACKAGE_GLUELOGIC_QUEUEPLAYER
	bool "queueplayer"
	select BR2_PACKAGE_CPPSDK_MQC
	help
	  A abstraction layer for controlling a player using a message queue.

config BR2_PACKAGE_GLUELOGIC_QUEUEREADER
	bool "queuereader"
	help
	  Tool for reading out the message-queues.
	
config BR2_PACKAGE_GLUELOGIC_VIRTUAL_KEYBOARD
	bool "virtualkeyboard"
	select BR2_PACKAGE_CPPSDK_GENERICS
	help
	  An abstraction layer for sending keys, prepared for the /dev/input device.


config BR2_PACKAGE_GLUELOGIC_KEYBOARDSCANNER
	bool "keyboardscanner"
	select BR2_PACKAGE_CPPSDK_MQC
	help
	  A tool to that reads keystrokes and transform them into keyevent queue messages.

menuconfig BR2_PACKAGE_GLUELOGIC_TESTAPPS
	bool "tests"

if BR2_PACKAGE_GLUELOGIC_TESTAPPS

config BR2_PACKAGE_GLUELOGIC_TEST_KEYBOARDSINK
	bool "keyboard-sink"
	select BR2_PACKAGE_GLUELOGIC_VIRTUAL_KEYBOARD
	help
	  The virtual keyboard test sink.

config BR2_PACKAGE_GLUELOGIC_TEST_KEYBOARDSOURCE
	bool "keyboard-source"
	select BR2_PACKAGE_GLUELOGIC_VIRTUAL_KEYBOARD
	help
	  The virtual keyboard test source.

config BR2_PACKAGE_GLUELOGIC_TEST_QUEUEPLAYERSTUB
	bool "queueplayerstub"
	select BR2_PACKAGE_GLUELOGIC_QUEUEPLAYER
	help
	  Test stub for testing the GStreamer sink Dorne.

config BR2_PACKAGE_GLUELOGIC_VIRTUAL_KEYBOARD_TOOLS
	bool "virtualkeyboard-tools"
	select BR2_PACKAGE_GLUELOGIC_VIRTUAL_KEYBOARD
	help
	  Virtual keyboard tools.

endif

endif
```

## package/gnu-efi/Config.in
```kconfig
config BR2_PACKAGE_GNU_EFI_ARCH_SUPPORTS
	bool
	default y if BR2_arm && BR2_ARM_CPU_HAS_ARM && !BR2_ARM_SOFT_FLOAT
	default y if BR2_RISCV_64
	default y if BR2_aarch64
	default y if BR2_i386
	default y if BR2_x86_64
	depends on BR2_USE_MMU

config BR2_PACKAGE_GNU_EFI
	bool "gnu-efi"
	depends on BR2_PACKAGE_GNU_EFI_ARCH_SUPPORTS
	help
	  Develop EFI applications for ARM-64, ARM-32, x86_64, IA-64
	  (IPF), IA-32 (x86), and MIPS platforms using the GNU toolchain
	  and the EFI development environment.

	  https://github.com/ncroxon/gnu-efi
```

## package/gnuplot/Config.in
```kconfig
config BR2_PACKAGE_GNUPLOT
	bool "gnuplot"
	select BR2_PACKAGE_READLINE if !BR2_PACKAGE_LIBEDIT
	help
	  A portable command-line driven graphing utility.

	  http://www.gnuplot.info/
```

## package/gnutls/Config.in
```kconfig
config BR2_PACKAGE_GNUTLS
	bool "gnutls"
	# https://gitlab.com/gnutls/gnutls/issues/203
	depends on !BR2_STATIC_LIBS
	depends on BR2_USE_WCHAR
	select BR2_PACKAGE_LIBTASN1
	select BR2_PACKAGE_LIBUNISTRING
	select BR2_PACKAGE_NETTLE
	help
	  GnuTLS is a secure communications library implementing the SSL
	  and TLS protocols and technologies around them.

	  https://www.gnutls.org/

if BR2_PACKAGE_GNUTLS

config BR2_PACKAGE_GNUTLS_OPENSSL
	bool "OpenSSL compatibility library"
	help
	  Install OpenSSL compatibility library.

config BR2_PACKAGE_GNUTLS_TOOLS
	bool "install tools"
	help
	  Install GnuTLS command line tools for various cryptographic
	  tasks.

config BR2_PACKAGE_GNUTLS_ENABLE_SSL2
	bool "enable SSLv2"
	help
	  Enable SSLv2 protocol.

config BR2_PACKAGE_GNUTLS_ENABLE_GOST
	bool "enable GOST"
	help
	  Enable GOST cipher.

endif

comment "gnutls needs a toolchain w/ wchar, dynamic library"
	depends on !BR2_USE_WCHAR || BR2_STATIC_LIBS
```

## package/go/Config.in.host
```kconfig
# Target go packages should depend on BR2_PACKAGE_HOST_GO_TARGET_ARCH_SUPPORTS
config BR2_PACKAGE_HOST_GO_TARGET_ARCH_SUPPORTS
	bool
	default y
	depends on BR2_PACKAGE_HOST_GO_BOOTSTRAP_STAGE3_ARCH_SUPPORTS
	# See https://go.dev/doc/install/source#environment
	# See src/go/build/syslist.go for the list of supported architectures
	depends on (BR2_arm && BR2_TOOLCHAIN_SUPPORTS_PIE) || BR2_aarch64 \
		|| BR2_i386 || BR2_x86_64 || BR2_powerpc64le \
		|| BR2_mips64 || BR2_mips64el || BR2_riscv || BR2_s390x
	depends on !BR2_ARM_CPU_ARMV4
	# MIPS R6 support in Go has not yet been developed.
	depends on !BR2_MIPS_CPU_MIPS64R6
	# Go doesn't support Risc-v 32-bit.
	depends on !BR2_RISCV_32
	# Go requires the following Risc-v General (G) features:
	depends on !BR2_riscv || (BR2_RISCV_ISA_RVI && \
		BR2_RISCV_ISA_RVM && BR2_RISCV_ISA_RVA && \
		BR2_RISCV_ISA_RVF && BR2_RISCV_ISA_RVD)

config BR2_PACKAGE_HOST_GO_TARGET_CGO_LINKING_SUPPORTS
	bool
	default y
	depends on BR2_PACKAGE_HOST_GO_TARGET_ARCH_SUPPORTS
	# Go doesn't support CGO linking on MIPS64x platforms
	# See: https://github.com/karalabe/xgo/issues/46
	depends on !BR2_mips64 && !BR2_mips64el
	# go uses dlfcn.h + cgo for its plugin module
	depends on !BR2_STATIC_LIBS
	# cgo supports uses threads
	depends on BR2_TOOLCHAIN_HAS_THREADS

# Host go packages should depend on BR2_PACKAGE_HOST_GO_HOST_ARCH_SUPPORTS
config BR2_PACKAGE_HOST_GO_HOST_ARCH_SUPPORTS
	bool
	default y
	depends on BR2_PACKAGE_HOST_GO_BOOTSTRAP_STAGE3_ARCH_SUPPORTS || BR2_PACKAGE_HOST_GO_BIN_HOST_ARCH_SUPPORTS

# CGO linking for the host. Since we use the same compiler for target
# and host, if the target can't do CGO linking, then the host can't.
# But if the target is not supported by Go, then the host can do CGO
# linking (except when it itself does not support CGO linking).
config BR2_PACKAGE_HOST_GO_HOST_CGO_LINKING_SUPPORTS
	bool
	default y if BR2_PACKAGE_HOST_GO_TARGET_CGO_LINKING_SUPPORTS
	default y if !BR2_PACKAGE_HOST_GO_TARGET_ARCH_SUPPORTS
	depends on BR2_PACKAGE_HOST_GO_HOST_ARCH_SUPPORTS
	depends on BR2_HOSTARCH != "mips64"
	depends on BR2_HOSTARCH != "mips64el"

# Go packages should select BR2_PACKAGE_HOST_GO
config BR2_PACKAGE_HOST_GO
	bool "host go"
	depends on BR2_PACKAGE_HOST_GO_HOST_ARCH_SUPPORTS

if BR2_PACKAGE_HOST_GO

choice
	prompt "Go compiler variant"
	default BR2_PACKAGE_HOST_GO_SRC if BR2_PACKAGE_HOST_GO_BOOTSTRAP_STAGE3_ARCH_SUPPORTS
	default BR2_PACKAGE_HOST_GO_BIN if BR2_PACKAGE_HOST_GO_BIN_HOST_ARCH_SUPPORTS
	help
	  Select a Go compiler variant.

	  Default to 'host-go-src'.

config BR2_PACKAGE_HOST_GO_SRC
	bool "host go (source)"
	depends on BR2_PACKAGE_HOST_GO_BOOTSTRAP_STAGE3_ARCH_SUPPORTS
	help
	  This package will build the go compiler for the host.

config BR2_PACKAGE_HOST_GO_BIN
	bool "host go (pre-built)"
	depends on BR2_PACKAGE_HOST_GO_BIN_HOST_ARCH_SUPPORTS
	help
	  This package will install pre-built versions of the compiler

endchoice

endif

config BR2_PACKAGE_PROVIDES_HOST_GO
	string
	# Default to host-go-bin unless src explicitly requested
	default "host-go-src" if BR2_PACKAGE_HOST_GO_SRC
	default "host-go-bin"

source "package/go/go-bin/Config.in.host"
source "package/go/go-bootstrap-stage1/Config.in.host"
source "package/go/go-bootstrap-stage2/Config.in.host"
source "package/go/go-bootstrap-stage3/Config.in.host"
```

## package/go/go-bin/Config.in.host
```kconfig
# Translate the HOSTARCH into the architecture name used by the Go compiler
config BR2_PACKAGE_HOST_GO_BIN_HOST_ARCH
	string
	default "armv6l" if BR2_HOSTARCH = "arm"
	default "arm64" if BR2_HOSTARCH = "aarch64"
	default "ppc64le" if BR2_HOSTARCH = "powerpc64le"
	default "s390x" if BR2_HOSTARCH = "s390x"
	default "386" if BR2_HOSTARCH = "x86"
	default "amd64" if BR2_HOSTARCH = "x86_64"

config BR2_PACKAGE_HOST_GO_BIN_HOST_ARCH_SUPPORTS
	bool
	default y
	depends on BR2_PACKAGE_HOST_GO_BIN_HOST_ARCH != ""
```

## package/go/go-bootstrap-stage1/Config.in.host
```kconfig
config BR2_PACKAGE_HOST_GO_BOOTSTRAP_STAGE1_ARCH_SUPPORTS
	bool
	# See src/cmd/dist/unix.c for the list of supported architectures
	default y if BR2_HOSTARCH = "x86"
	default y if BR2_HOSTARCH = "x86_64"
	default y if BR2_HOSTARCH = "arm"
```

## package/go/go-bootstrap-stage3/Config.in.host
```kconfig
config BR2_PACKAGE_HOST_GO_BOOTSTRAP_STAGE3_ARCH_SUPPORTS
	bool
	default y
	depends on BR2_PACKAGE_HOST_GO_BOOTSTRAP_STAGE2_ARCH_SUPPORTS
```

## package/gobject-introspection/Config.in
```kconfig
config BR2_PACKAGE_GOBJECT_INTROSPECTION_ARCH_SUPPORTS
	bool
	default y
	depends on BR2_PACKAGE_HOST_QEMU_ARCH_SUPPORTS
	# gobject-introspection programs cause a hang of Qemu on
	# Microblaze, and supporting GOI on Microblaze is not very
	# relevant.
	depends on !BR2_microblazeel
	depends on !BR2_microblazebe

config BR2_PACKAGE_GOBJECT_INTROSPECTION
	bool "gobject-introspection"
	depends on BR2_USE_MMU # python3, libglib2
	depends on BR2_PACKAGE_GOBJECT_INTROSPECTION_ARCH_SUPPORTS
	# While gcc 4.8 might be compatible with gobject-introspection,
	# The autobuilders use some toolchains from codesourcery which
	# have gcc 4.8 and a very old version of glibc, which will cause
	# compile errors with locale.c. As such, require 4.9 until this
	# can be verified.
	depends on BR2_TOOLCHAIN_GCC_AT_LEAST_4_9
	depends on BR2_HOST_GCC_AT_LEAST_8 # host-qemu
	depends on BR2_TOOLCHAIN_USES_GLIBC || BR2_TOOLCHAIN_USES_MUSL
	# gobject-introspection does not require python3 to run on the
	# target; however, because the tools run in a qemu wrapper, a
	# cross-compiled python3 must be installed to staging. As there
	# is no current mechanism to tell Buildroot only to install
	# python to staging, then python must also be installed
	# unconditionally to the target when building
	# gobject-introspection.
	depends on BR2_PACKAGE_PYTHON3
	select BR2_PACKAGE_HOST_GOBJECT_INTROSPECTION
	select BR2_PACKAGE_HOST_QEMU
	select BR2_PACKAGE_HOST_QEMU_LINUX_USER_MODE
	select BR2_PACKAGE_LIBFFI
	select BR2_PACKAGE_LIBGLIB2_BOOTSTRAP
	select BR2_PACKAGE_ZLIB
	help
	  GObject introspection is a middleware layer between C
	  libraries (using GObject) and language bindings. The C library
	  can be scanned at compile time and generate a metadata file,
	  in addition to the actual native C library. Then at runtime,
	  language bindings can read this metadata and automatically
	  provide bindings to call into the C library.

	  https://gi.readthedocs.io/

comment "gobject-introspection needs python3"
	depends on !BR2_PACKAGE_PYTHON3
	depends on BR2_PACKAGE_GOBJECT_INTROSPECTION_ARCH_SUPPORTS

comment "gobject-introspection needs a glibc or musl toolchain, gcc >= 4.9, host gcc >= 8"
	depends on BR2_USE_MMU
	depends on BR2_PACKAGE_GOBJECT_INTROSPECTION_ARCH_SUPPORTS
	depends on !(BR2_TOOLCHAIN_USES_GLIBC || BR2_TOOLCHAIN_USES_MUSL) || \
		!BR2_TOOLCHAIN_GCC_AT_LEAST_4_9 || \
		!BR2_HOST_GCC_AT_LEAST_8
```

## package/gocryptfs/Config.in
```kconfig
config BR2_PACKAGE_GOCRYPTFS
	bool "gocryptfs"
	depends on BR2_PACKAGE_HOST_GO_TARGET_ARCH_SUPPORTS
	depends on BR2_TOOLCHAIN_HAS_THREADS
	select BR2_PACKAGE_HOST_GO
	help
	  gocryptfs is an encrypted FUSE overlay filesystem.

	  https://github.com/rfjakob/gocryptfs

comment "gocryptfs needs a toolchain w/ threads"
	depends on BR2_PACKAGE_HOST_GO_TARGET_ARCH_SUPPORTS
	depends on !BR2_TOOLCHAIN_HAS_THREADS
```
