## package/gpsd/Config.in
```kconfig
comment "gpsd needs a toolchain w/ threads, dynamic library"
	depends on BR2_USE_MMU
	depends on !BR2_TOOLCHAIN_HAS_THREADS || BR2_STATIC_LIBS

menuconfig BR2_PACKAGE_GPSD
	bool "gpsd"
	# Uses fork()
	depends on BR2_USE_MMU
	depends on BR2_TOOLCHAIN_HAS_THREADS
	# Always tries to build a shared library
	depends on !BR2_STATIC_LIBS
	select BR2_PACKAGE_GPSD_CLIENTS if !BR2_PACKAGE_GPSD_DAEMON \
				       && !BR2_PACKAGE_GPSD_PYTHON
	help
	  gpsd is a service daemon that monitors one or more GPSes or
	  AIS receivers attached to a host computer through serial or
	  USB ports, making all data on the location/course/velocity of
	  the sensors available to be queried on TCP port 2947 of the
	  host computer.

	  The D-Bus interface is included if dbus-glib is enabled.

	  https://gpsd.gitlab.io/gpsd

if BR2_PACKAGE_GPSD

config BR2_PACKAGE_GPSD_DAEMON
	bool "gpsd daemon"
	default y # legacy
	select BR2_PACKAGE_GPSD_CLIENTS
	help
	  Build and install the gpsd daemon itself

if BR2_PACKAGE_GPSD_DAEMON

config BR2_PACKAGE_GPSD_DEVICES
	string "Where to look for GPSes"
	default "/dev/ttyS1"

comment "Features"

config BR2_PACKAGE_GPSD_CLIENT_DEBUG
	bool "client debugging support"

config BR2_PACKAGE_GPSD_PROFILING
	bool "profiling support"
	depends on BR2_TOOLCHAIN_USES_GLIBC
	depends on !BR2_aarch64
	# Needs glibc for ARC arc-2018.03-eng007+ for correct __mcount linking
	depends on !BR2_arc

comment "profiling support not available with uClibc-based toolchain"
	depends on !BR2_TOOLCHAIN_USES_GLIBC

config BR2_PACKAGE_GPSD_USER
	bool "GPSD privilege revocation user"

config BR2_PACKAGE_GPSD_USER_VALUE
	string "user to run as"
	default "nobody"
	depends on BR2_PACKAGE_GPSD_USER

config BR2_PACKAGE_GPSD_GROUP
	bool "GPSD privilege revocation group"

config BR2_PACKAGE_GPSD_GROUP_VALUE
	string "group to run as"
	default "nobody"
	depends on BR2_PACKAGE_GPSD_GROUP

config BR2_PACKAGE_GPSD_MAX_CLIENT
	bool "compile with limited maximum clients"

config BR2_PACKAGE_GPSD_MAX_CLIENT_VALUE
	int "maximum number of clients"
	default "10"
	depends on BR2_PACKAGE_GPSD_MAX_CLIENT

config BR2_PACKAGE_GPSD_MAX_DEV
	bool "compile with maximum allowed devices"

config BR2_PACKAGE_GPSD_MAX_DEV_VALUE
	int "maximum allowed devices"
	default "2"
	depends on BR2_PACKAGE_GPSD_MAX_DEV

config BR2_PACKAGE_GPSD_SQUELCH
	bool "squelch gpsd_report and gpsd_hexdump to save cpu"

comment "Protocols"

config BR2_PACKAGE_GPSD_AIVDM
	bool "Aivdm"
	help
	  Aivdm support

config BR2_PACKAGE_GPSD_ASHTECH
	bool "Ashtech"
	help
	  Ashtech support

config BR2_PACKAGE_GPSD_EARTHMATE
	bool "Earthmate"
	help
	  DeLorme EarthMate Zodiac support

config BR2_PACKAGE_GPSD_EVERMORE
	bool "EverMore"
	help
	  EverMore binary support

config BR2_PACKAGE_GPSD_FURY
	bool "Fury"
	help
	  Jackson Labs Fury and Firefly support

config BR2_PACKAGE_GPSD_FV18
	bool "FV-18"
	help
	  San Jose Navigation FV-18 support

config BR2_PACKAGE_GPSD_GARMIN
	bool "Garmin (kernel)"
	help
	  Garmin kernel driver support

config BR2_PACKAGE_GPSD_GARMIN_SIMPLE_TXT
	bool "Garmin (simple text)"
	help
	  Garmin Simple Text support

config BR2_PACKAGE_GPSD_GEOSTAR
	bool "Geostar"
	help
	  Geostar Protocol support

config BR2_PACKAGE_GPSD_GPSCLOCK
	bool "GPSClock"
	help
	  GPSClock support

config BR2_PACKAGE_GPSD_GREIS
	bool "Greis"
	help
	  Greis support

config BR2_PACKAGE_GPSD_ISYNC
	bool "iSync"
	help
	  Spectratime iSync LNRClok/GRCLOK support

config BR2_PACKAGE_GPSD_ITRAX
	bool "iTrax"
	help
	  iTrax support

config BR2_PACKAGE_GPSD_NAVCOM
	bool "Navcom"
	help
	  Navcom binary support

config BR2_PACKAGE_GPSD_NMEA2000
	bool "NMEA2000"
	select BR2_PACKAGE_GPSD_NAVCOM
	select BR2_PACKAGE_GPSD_AIVDM
	help
	  NMEA2000/CAN support

config BR2_PACKAGE_GPSD_OCEANSERVER
	bool "OceanServer"
	help
	  OceanServer Digital Compass support

config BR2_PACKAGE_GPSD_ONCORE
	bool "OnCore"
	help
	  OnCore support

config BR2_PACKAGE_GPSD_RTCM104V2
	bool "RTCM104 v2"
	help
	  RTCM104 v2 support

config BR2_PACKAGE_GPSD_RTCM104V3
	bool "RTCM104 v3"
	help
	  RTCM104 v3 support

config BR2_PACKAGE_GPSD_SIRF
	bool "SiRF"
	help
	  SiRF binary support

config BR2_PACKAGE_GPSD_SKYTRAQ
	bool "Skytraq"
	help
	  Skytraq support

config BR2_PACKAGE_GPSD_SUPERSTAR2
	bool "SuperStarII"
	help
	  Novatel SuperStarII binary support

config BR2_PACKAGE_GPSD_TRIMBLE_TSIP
	bool "Trimble TSIP"
	help
	  Trimble TSIP support

config BR2_PACKAGE_GPSD_TRIPMATE
	bool "TripMate"
	help
	  Delorme TripMate support

config BR2_PACKAGE_GPSD_TRUE_NORTH
	bool "True North Technologies"
	help
	  True North Technologies support

config BR2_PACKAGE_GPSD_UBX
	bool "UBX"
	help
	  uBlox UBX binary support

endif  # GPSD_DAEMON

config BR2_PACKAGE_GPSD_CLIENTS
	bool "gpsd clients"
	default y # legacy
	help
	  Build and install gspd client programs, like:
	    - gpsctl
	    - gpsdctl
	    - gpsdecode
	    - gpspipe
	    - ...

config BR2_PACKAGE_GPSD_PYTHON
	bool "build Python support and modules"
	depends on BR2_USE_WCHAR # python3
	select BR2_PACKAGE_PYTHON3
	select BR2_PACKAGE_PYTHON_SERIAL # runtime
	help
	  Python libraries and tools for the gpsd service daemon
	  including gpsfake test harness.

comment "python support needs a toolchain w/ wchar"
	depends on !BR2_USE_WCHAR

endif
```

## package/gr-osmosdr/Config.in
```kconfig
config BR2_PACKAGE_GR_OSMOSDR
	bool "gr-osmosdr"
	depends on BR2_PACKAGE_GNURADIO
	select BR2_PACKAGE_GNURADIO_BLOCKS
	select BR2_PACKAGE_GNURADIO_FFT
	select BR2_PACKAGE_GNURADIO_FILTER
	help
	  GNU Radio block for interfacing with various radio hardware

	  http://osmocom.org/projects/osmosdr

if BR2_PACKAGE_GR_OSMOSDR

config BR2_PACKAGE_GR_OSMOSDR_IQFILE
	bool "IQ File Source support"
	help
	  Enable IQ File Source support

config BR2_PACKAGE_GR_OSMOSDR_RTLSDR
	bool "Osmocom RTLSDR support"
	depends on BR2_TOOLCHAIN_GCC_AT_LEAST_4_9 # librtlsdr -> libusb
	select BR2_PACKAGE_LIBRTLSDR
	help
	  Enable Osmocom RTLSDR support

comment "Osmocom RTLSDR support needs a toolchain w/ gcc >= 4.9"
	depends on !BR2_TOOLCHAIN_GCC_AT_LEAST_4_9

config BR2_PACKAGE_GR_OSMOSDR_RTLSDR_TCP
	bool "RTLSDR TCP Client support"
	help
	  Enable RTLSDR TCP client support

config BR2_PACKAGE_GR_OSMOSDR_RFSPACE
	bool "RFSPACE Receivers support"
	help
	  Enable RFSPACE Receivers support

config BR2_PACKAGE_GR_OSMOSDR_HACKRF
	bool "Osmocom HACKRF support"
	depends on !BR2_STATIC_LIBS # hackrf
	depends on BR2_TOOLCHAIN_HAS_THREADS # hackrf
	depends on BR2_TOOLCHAIN_GCC_AT_LEAST_4_9 # hackrf
	select BR2_PACKAGE_HACKRF
	help
	  Enable Osmocom HACKRF support

comment "hackrf support needs a toolchain w/ threads, dynamic library, gcc >= 4.9"
	depends on BR2_STATIC_LIBS || !BR2_TOOLCHAIN_HAS_THREADS || \
		!BR2_TOOLCHAIN_GCC_AT_LEAST_4_9

endif
```

## package/grantlee/Config.in
```kconfig
config BR2_PACKAGE_GRANTLEE
	bool "grantlee"
	depends on (BR2_PACKAGE_QT5_JSCORE_AVAILABLE && BR2_PACKAGE_QT5) || BR2_PACKAGE_QT6
	select BR2_PACKAGE_QT5SCRIPT if BR2_PACKAGE_QT5
	select BR2_PACKAGE_QT5BASE_GUI if BR2_PACKAGE_QT5
	select BR2_PACKAGE_QT6BASE_GUI if BR2_PACKAGE_QT6
	select BR2_PACKAGE_QT6DECLARATIVE if BR2_PACKAGE_QT6
	help
	  Qt implementation of the Django template framework

	  http://www.grantlee.org
```

## package/graphene/Config.in
```kconfig
config BR2_PACKAGE_GRAPHENE
	bool "graphene"
	depends on BR2_TOOLCHAIN_HAS_THREADS
	help
	  A thin layer of types for graphic libraries.

	  https://ebassi.github.io/graphene/

comment "graphene needs a toolchain w/ threads"
	depends on !BR2_TOOLCHAIN_HAS_THREADS
```

## package/greenpeak/Config.in
```kconfig
config BR2_PACKAGE_GREENPEAK
	bool "greenpeak"
	help
	  Greenpeak kernel drivers.

if BR2_PACKAGE_GREENPEAK

config BR2_PACKAGE_GREENPEAK_KERNEL_MODULE
	bool "kernel module"
    select BR2_PACKAGE_BCM_REFSW_KERNELSPACE_HEADERS if BR2_PACKAGE_HAS_NEXUS
	help
	  Build the kernel module

config BR2_PACKAGE_GREENPEAK_LIB
	bool "userland library"
	help
	  Build a Rf4ce library for use by appplications working with
	  the greenpeak chip in stead of building an application that
	  reads keys from an Rf4ce remote and ingest them into the
	  linux input system.

config BR2_PACKAGE_GREENPEAK_DEVICE_NODE_PATH
	string "device node"
	default /dev/gpK5 if BR2_PACKAGE_GREENPEAK_GP501 || BR2_PACKAGE_GREENPEAK_GP510 || BR2_PACKAGE_GREENPEAK_GP711
	default /dev/gpK7C if BR2_PACKAGE_GREENPEAK_GP502 || BR2_PACKAGE_GREENPEAK_GP712
	help
	  Full path to the greenpeak device node that is on the system.

choice
	prompt "Greenpeak Type"
	default BR2_PACKAGE_GREENPEAK_GP501
	help
	  Select the version of uClibc you wish to use.

	config BR2_PACKAGE_GREENPEAK_GP501
		bool "GP501"

	config BR2_PACKAGE_GREENPEAK_GP502
		bool "GP502"

	config BR2_PACKAGE_GREENPEAK_GP510
		bool "GP510"

	config BR2_PACKAGE_GREENPEAK_GP711
		bool "GP711"

	config BR2_PACKAGE_GREENPEAK_GP712
		bool "GP712"

    config BR2_PACKAGE_GREENPEAK_ZD4500ZNO
		bool "ZD4500ZNO"

endchoice

config BR2_PACKAGE_GREENPEAK_TYPE
	string
	default GP501 if BR2_PACKAGE_GREENPEAK_GP501
	default GP502 if BR2_PACKAGE_GREENPEAK_GP502
	default GP510 if BR2_PACKAGE_GREENPEAK_GP510
	default GP711 if BR2_PACKAGE_GREENPEAK_GP711
	default GP712 if BR2_PACKAGE_GREENPEAK_GP712
	default ZD4500ZNO if BR2_PACKAGE_GREENPEAK_ZD4500ZNO
endif
```

## package/grout/Config.in
```kconfig
config BR2_PACKAGE_GROUT
	bool "grout"
	depends on BR2_PACKAGE_DPDK_ARCH_SUPPORTS # dpdk
	depends on BR2_TOOLCHAIN_HAS_THREADS # dpdk
	depends on BR2_USE_MMU # dpdk, numactl, libecoli
	depends on BR2_TOOLCHAIN_GCC_AT_LEAST_13 # C23 enum underlying types
	depends on BR2_TOOLCHAIN_HEADERS_AT_LEAST_4_19 # dpdk
	depends on BR2_TOOLCHAIN_USES_GLIBC # dpdk
	depends on BR2_TOOLCHAIN_HAS_ATOMIC # numactl
	depends on !BR2_STATIC_LIBS # libecoli
	depends on BR2_USE_WCHAR # libecoli
	select BR2_PACKAGE_DPDK
	select BR2_PACKAGE_LIBEVENT
	select BR2_PACKAGE_NUMACTL
	select BR2_PACKAGE_LIBECOLI
	select BR2_PACKAGE_LIBMNL
	help
	  Graph router based on DPDK

comment "grout needs a glibc toolchain w/ dynamic library, threads, wchar, gcc >= 13, headers >= 4.19"
	depends on BR2_USE_MMU
	depends on BR2_PACKAGE_DPDK_ARCH_SUPPORTS
	depends on BR2_TOOLCHAIN_HAS_ATOMIC
	depends on !BR2_TOOLCHAIN_HAS_THREADS || \
		!BR2_TOOLCHAIN_USES_GLIBC || \
		!BR2_TOOLCHAIN_GCC_AT_LEAST_13 || \
		!BR2_TOOLCHAIN_HEADERS_AT_LEAST_4_19
```

## package/gstreamer1/Config.in
```kconfig
# Gstreamer 1.x & Plugins
source "package/gstreamer1/gstreamer1/Config.in"

if BR2_PACKAGE_GSTREAMER1
source "package/gstreamer1/gst1-aamp/Config.in"
source "package/gstreamer1/gst1-bcm/Config.in"
source "package/gstreamer1/gst1-common/Config.in"
source "package/gstreamer1/gst1-plugins-base/Config.in"
source "package/gstreamer1/gst1-plugins-good/Config.in"
source "package/gstreamer1/gst1-plugins-bad/Config.in"
source "package/gstreamer1/gst1-plugins-ugly/Config.in"
source "package/gstreamer1/gst1-imx/Config.in"
source "package/gstreamer1/gst1-libav/Config.in"
source "package/gstreamer1/gst1-rpicamsrc/Config.in"
source "package/gstreamer1/gst1-rtsp-server/Config.in"
source "package/gstreamer1/gst1-validate/Config.in"
source "package/gstreamer1/gst1-instruments/Config.in"
source "package/gstreamer1/gst1-openwebrtc/Config.in"
source "package/gstreamer1/gst1-vaapi/Config.in"
source "package/gstreamer1/gst-omx/Config.in"
source "package/gstreamer1/gst1-fluendo-ismd/Config.in"
source "package/gstreamer1/gst1-plugins-dorne/Config.in"
endif
```

## package/gstreamer1/gst-omx/Config.in
```kconfig
config BR2_PACKAGE_GST_OMX
	bool "gst-omx"
	depends on BR2_PACKAGE_HAS_LIBOPENMAX
	select BR2_PACKAGE_GST1_PLUGINS_BASE
	select BR2_PACKAGE_GST1_PLUGINS_BAD if BR2_PACKAGE_RPI_USERLAND
	select BR2_PACKAGE_GST1_PLUGINS_BAD_LIB_OPENGL if BR2_PACKAGE_RPI_USERLAND
	select BR2_PACKAGE_GST1_PLUGINS_BAD_LIB_OPENGL_GLES2 if BR2_PACKAGE_RPI_USERLAND
	select BR2_PACKAGE_GST1_PLUGINS_BAD_LIB_OPENGL_EGL if BR2_PACKAGE_RPI_USERLAND
	help
	  GStreamer plug-in to use OpenMAX API.

	  http://cgit.freedesktop.org/gstreamer/gst-omx

comment "gst-omx requires a OpenMAX implementation"
	depends on !BR2_PACKAGE_HAS_LIBOPENMAX
```

## package/gstreamer1/gst-opencdmi/Config.in
```kconfig
config BR2_PACKAGE_GST_OPENCDMI
        bool "gst-opencdmi"
        select BR2_PACKAGE_GST1_PLUGINS_BASE
        help
          GStreamer plug-in to use OpenCDMI CDM decrypt functionalities.
```
