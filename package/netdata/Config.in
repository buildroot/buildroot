## package/netdata/Config.in
```kconfig
config BR2_PACKAGE_NETDATA
	bool "netdata"
	depends on BR2_TOOLCHAIN_HAS_THREADS_NPTL
	depends on BR2_USE_MMU # fork()
	depends on !BR2_STATIC_LIBS # libuv
	depends on BR2_TOOLCHAIN_HAS_SYNC_4 # libuv
	depends on BR2_TOOLCHAIN_GCC_AT_LEAST_4_9 # libuv
	select BR2_PACKAGE_LIBUV
	select BR2_PACKAGE_UTIL_LINUX
	select BR2_PACKAGE_UTIL_LINUX_LIBUUID
	select BR2_PACKAGE_ZLIB
	help
	  Netdata is distributed, real-time, performance and health
	  monitoring for systems and applications. It is a highly
	  optimized monitoring agent you install on all your systems and
	  containers.

	  https://github.com/netdata/netdata

if BR2_PACKAGE_NETDATA

config BR2_PACKAGE_NETDATA_PROMETHEUS
	bool "prometheus remote write backend"
	depends on BR2_PACKAGE_PROTOBUF_ARCH_SUPPORTS
	depends on BR2_INSTALL_LIBSTDCPP # protobuf, snappy
	depends on BR2_TOOLCHAIN_GCC_AT_LEAST_4_8 # protobuf
	select BR2_PACKAGE_PROTOBUF
	select BR2_PACKAGE_SNAPPY
	help
	  Enable prometheus remote write backend

comment "prometheus remote write backend needs a toolchain w/ C++, gcc >= 4.8"
	depends on !BR2_INSTALL_LIBSTDCPP || \
		!BR2_TOOLCHAIN_GCC_AT_LEAST_4_8
	depends on BR2_PACKAGE_PROTOBUF_ARCH_SUPPORTS

endif

comment "netdata needs a toolchain w/ NPTL, dynamic library, gcc >= 4.9"
	depends on !BR2_TOOLCHAIN_HAS_THREADS_NPTL || BR2_STATIC_LIBS \
		|| !BR2_TOOLCHAIN_GCC_AT_LEAST_4_9
	depends on BR2_USE_MMU
	depends on BR2_TOOLCHAIN_HAS_SYNC_4
```

## package/netflix/Config.in
```kconfig
config BR2_PACKAGE_NETFLIX
	bool "netflix"
	select BR2_PACKAGE_LIBMNG
	select BR2_PACKAGE_LIBPNG
	select BR2_PACKAGE_ICU
	select BR2_PACKAGE_JPEG
	select BR2_PACKAGE_WEBP
	select BR2_PACKAGE_FREETYPE
	select BR2_PACKAGE_EXPAT
	select BR2_PACKAGE_OPENSSL
	select BR2_PACKAGE_C_ARES
	select BR2_PACKAGE_LIBCURL
	select BR2_PACKAGE_GRAPHITE2
	help
	  Netflix

if BR2_PACKAGE_NETFLIX

menu "Extra options"

choice
	bool "Application type"
	default BR2_PACKAGE_NETFLIX_APP
	help
	  Choose application type.

config BR2_PACKAGE_NETFLIX_APP
	bool "executable"
	help
	  Create Netflix standalone app.

config BR2_PACKAGE_NETFLIX_LIB
	bool "library"
	help
	  Create Netflix library.

endchoice

config BR2_PACKAGE_NETFLIX_GST_GL
	bool "gl"
	default n

endmenu

endif
```

## package/netflix5/Config.in
```kconfig
config BR2_PACKAGE_NETFLIX5
	bool "netflix5"
	select BR2_PACKAGE_LIBMNG
	select BR2_PACKAGE_LIBPNG
	select BR2_PACKAGE_ICU
	select BR2_PACKAGE_JPEG
	select BR2_PACKAGE_WEBP
	select BR2_PACKAGE_HARFBUZZ
	select BR2_PACKAGE_FREETYPE
	select BR2_PACKAGE_EXPAT
	select BR2_PACKAGE_OPENSSL
	select BR2_PACKAGE_C_ARES
	select BR2_PACKAGE_LIBCURL
	select BR2_PACKAGE_GRAPHITE2
	select BR2_PACKAGE_NGHTTP2
	select BR2_PACKAGE_TREMOR
	help
	  Netflix5

if BR2_PACKAGE_NETFLIX5

menu "Extra options"

choice
	bool "NETFLIX5 Minor Version"
	default BR2_PACKAGE_NETFLIX5_1
	help
	  Choose NF5 minor version - 5.0 or 5.1, default - 5.1

config BR2_PACKAGE_NETFLIX5_0
	bool "5.0"
	help
	  Netflix5.0

config BR2_PACKAGE_NETFLIX5_1
        bool "5.1"
        help
          Netflix5.1
endchoice

choice
	bool "Application type"
	default BR2_PACKAGE_NETFLIX5_LIB
	help
	  Choose application type.

config BR2_PACKAGE_NETFLIX5_APP
	bool "executable"
	help
	  Create Netflix standalone app.

config BR2_PACKAGE_NETFLIX5_LIB
	bool "library"
	help
	  Create Netflix library.

endchoice

config BR2_PACKAGE_NETFLIX5_KEYMAP
	string "keymap"
	help
	  Install custom keymap

config BR2_PACKAGE_NETFLIX5_GST_GL
	bool "gl"
	depends on BR2_PACKAGE_GST1_PLUGINS_BAD_PLUGIN_GL
	default y

config BR2_PACKAGE_NETFLIX5_MARVEL
	bool "marvel"
	depends on BR2_PACKAGE_MARVELL_AMPSDK
	default n

config BR2_PACKAGE_NETFLIX5_WESTEROS_SINK
	bool "westeros-sink"
	depends on BR2_PACKAGE_WPEFRAMEWORK_COMPOSITOR
	default n

config BR2_PACKAGE_NETFLIX5_AUDIO_MIXER
        bool "audio-mixer"
        select BR2_PACKAGE_TREMOR
        default BR2_PACKAGE_HAS_NEXUS

if BR2_PACKAGE_NETFLIX5_AUDIO_MIXER

choice
	bool "Audio Mixer type"
	default BR2_PACKAGE_NETFLIX5_AUDIO_MIXER_SOFTWARE
	help
	  Choose Audio Mixer type

config BR2_PACKAGE_NETFLIX5_AUDIO_MIXER_SOFTWARE
	bool "software"
	help
	  Software Audio Mixer

config BR2_PACKAGE_NETFLIX5_AUDIO_MIXER_NEXUS
	bool "nexus"
	depends on BR2_PACKAGE_HAS_NEXUS
	help
	  Nexus Audio Mixer

endchoice
endif

choice
	bool "DRM"
	default BR2_PACKAGE_NETFLIX5_DRM_PLAYREADY
	help
	  Choose DRM Type

config BR2_PACKAGE_NETFLIX5_DRM_PLAYREADY
	bool "playready"
	select BR2_PACKAGE_PLAYREADY
	help
	  DRM Playready

config BR2_PACKAGE_NETFLIX5_DRM_OCDM
	bool "ocdm"
	depends on BR2_PACKAGE_WPEFRAMEWORK_CDMI
	help
	  DRM Ocdm

endchoice

endmenu
endif
```

## package/netflix52/Config.in
```kconfig
config BR2_PACKAGE_NETFLIX52
	bool "netflix5.2"
	select BR2_PACKAGE_LIBMNG
	select BR2_PACKAGE_LIBPNG
	select BR2_PACKAGE_ICU
	select BR2_PACKAGE_OPENJPEG
	select BR2_PACKAGE_LCMS2
	select BR2_PACKAGE_JPEG
	select BR2_PACKAGE_WEBP
	select BR2_PACKAGE_HARFBUZZ
	select BR2_PACKAGE_FREETYPE
	select BR2_PACKAGE_EXPAT
	select BR2_PACKAGE_OPENSSL
	select BR2_PACKAGE_C_ARES
	select BR2_PACKAGE_LIBCURL
	select BR2_PACKAGE_GRAPHITE2
	select BR2_PACKAGE_NGHTTP2
	select BR2_PACKAGE_TREMOR
	select BR2_PACKAGE_LIBOPENH264
	select BR2_PACKAGE_FDK_AAC
	help
	  Netflix 5.2

if BR2_PACKAGE_NETFLIX52

menu "Extra options"

choice
	bool "NETFLIX52 Minor Version"
	default BR2_PACKAGE_NETFLIX5_2
	help
	  Choose NF5 minor version - 5.2.2, default - 5.2.2

config BR2_PACKAGE_NETFLIX5_2
	bool "5.2.2"
	help
	  Netflix5.2.2

endchoice
choice
	bool "Build Type"
	default BR2_PACKAGE_NETFLIX52_BUILD_RELEASE
	help
	  Choose build Type
	  
config BR2_PACKAGE_NETFLIX52_BUILD_ML
	bool "Metrological"
	help
	  Build with the original metrological flags

config BR2_PACKAGE_NETFLIX52_BUILD_DEBUG
	bool "Debug"
	help
	  Build a debug build with tracing and symbols

config BR2_PACKAGE_NETFLIX52_BUILD_RELEASE_DEBUG
	bool "Release Debug"
	help
	  Build a debug build with tracing and symbols and production code on (strict SSL/HTTPS).

config BR2_PACKAGE_NETFLIX52_BUILD_RELEASE
	bool "Release"
	select BR2_PACKAGE_NETFLIX52_MINIFY_JS
	help
	  Build a release build without tracing and symbols (e.g. for binary delivery)

endchoice

choice
	bool "Application type"
	default BR2_PACKAGE_NETFLIX52_LIB
	help
	  Choose application type.

config BR2_PACKAGE_NETFLIX52_APP
	bool "executable"
	help
	  Create Netflix standalone app.

config BR2_PACKAGE_NETFLIX52_LIB
	bool "library"
	help
	  Create Netflix library.

endchoice

config BR2_PACKAGE_NETFLIX52_KEYMAP
	string "keymap"
	help
	  Install custom keymap

config BR2_PACKAGE_NETFLIX52_GST_GL
        bool "gl"
        depends on BR2_PACKAGE_GST1_PLUGINS_BAD_PLUGIN_GL
        default y

config BR2_PACKAGE_NETFLIX52_WESTEROS_SINK
	bool "westeros-sink"
	depends on BR2_PACKAGE_WPEFRAMEWORK_COMPOSITOR
	default n

config BR2_PACKAGE_NETFLIX52_AUDIO_MIXER
        bool "audio-mixer"
        select BR2_PACKAGE_TREMOR
        default BR2_PACKAGE_HAS_NEXUS

if BR2_PACKAGE_NETFLIX52_AUDIO_MIXER

choice
	bool "Audio Mixer type"
	default BR2_PACKAGE_NETFLIX52_AUDIO_MIXER_SOFTWARE
	help
	  Choose Audio Mixer type

config BR2_PACKAGE_NETFLIX52_AUDIO_MIXER_SOFTWARE
	bool "software"
	help
	  Software Audio Mixer

config BR2_PACKAGE_NETFLIX52_AUDIO_MIXER_NEXUS
	bool "nexus"
	depends on BR2_PACKAGE_HAS_NEXUS
	help
	  Nexus Audio Mixer

endchoice
endif
choice
	bool "DRM"
	default BR2_PACKAGE_NETFLIX52_DRM_OCDM
	help
	  Choose DRM Type

config BR2_PACKAGE_NETFLIX52_DRM_PLAYREADY
	bool "playready"
	select BR2_PACKAGE_PLAYREADY
	help
	  DRM Playready

config BR2_PACKAGE_NETFLIX52_DRM_OCDM
	bool "ocdm"
	depends on BR2_PACKAGE_WPEFRAMEWORK_CDMI
	help
	  DRM Ocdm

endchoice

config BR2_PACKAGE_NETFLIX52_DISABLE_TOOLS
	bool "Disable tools"
	default y
	help
	  Do not build tools for netflix

config BR2_PACKAGE_NETFLIX52_MINIFY_JS
    default y
	bool "Minify JS"
	help
	  minify javascript files like boot.js
	  
config BR2_PACKAGE_NETFLIX52_CREATE_BINARY_ML_DELIVERY
	bool "Create delivery package"
	help
	  Create tarball containing the build to be deployed else where.

endmenu
endif
```

## package/nethogs/Config.in
```kconfig
config BR2_PACKAGE_NETHOGS
	bool "nethogs"
	depends on BR2_INSTALL_LIBSTDCPP
	select BR2_PACKAGE_LIBPCAP
	select BR2_PACKAGE_NCURSES
	help
	  NetHogs is a small 'net top' tool. Instead of breaking the
	  traffic down per protocol or per subnet, like most tools
	  do, it groups bandwidth by process.

          https://github.com/raboof/nethogs

comment "nethogs needs a toolchain w/ C++"
	depends on !BR2_INSTALL_LIBSTDCPP
```

## package/networkd-dispatcher/Config.in
```kconfig
config BR2_PACKAGE_NETWORKD_DISPATCHER
	bool "networkd-dispatcher"
	depends on BR2_PACKAGE_GOBJECT_INTROSPECTION_ARCH_SUPPORTS # python-gobject -> gobject-introspection
	depends on BR2_HOST_GCC_AT_LEAST_8 # python-gobject -> gobject-introspection -> host-qemu
	depends on BR2_TOOLCHAIN_GCC_AT_LEAST_4_9 # python-gobject -> gobject-introspection
	depends on BR2_TOOLCHAIN_USES_GLIBC # python-gobject -> gobject-introspection
	depends on !BR2_PACKAGE_PYTHON # python3
	depends on BR2_PACKAGE_SYSTEMD # runtime
	select BR2_PACKAGE_DBUS # dbus-python
	select BR2_PACKAGE_DBUS_PYTHON # runtime
	select BR2_PACKAGE_PYTHON3 # python-gobject
	select BR2_PACKAGE_PYTHON_GOBJECT # runtime
	select BR2_PACKAGE_SYSTEMD_NETWORKD # runtime
	help
	  Networkd-dispatcher is a dispatcher daemon for
	  systemd-networkd connection status changes.
	  This daemon is similar to NetworkManager-dispatcher,
	  but is much more limited in the types of events it
	  supports due to the limited nature of systemd-networkd.

	  https://gitlab.com/craftyguy/networkd-dispatcher

comment "networkd-dispatcher needs a glibc toolchain, gcc >= 4.9, host gcc >= 8"
	depends on BR2_PACKAGE_GOBJECT_INTROSPECTION_ARCH_SUPPORTS
	depends on BR2_PACKAGE_SYSTEMD
	depends on !BR2_PACKAGE_PYTHON
	depends on !BR2_HOST_GCC_AT_LEAST_8 || \
		!BR2_TOOLCHAIN_GCC_AT_LEAST_4_9 || \
		!BR2_TOOLCHAIN_USES_GLIBC
```

## package/nexus/Config.in
```kconfig
config BR2_PACKAGE_HAS_NEXUS
	bool

config BR2_PACKAGE_PROVIDES_NEXUS
	depends on BR2_PACKAGE_HAS_NEXUS
	string

config BR2_PACKAGE_HAS_OPUS_DECODER
	bool

config BR2_PACKAGE_PROVIDES_OPUS_DECODER
	depends on BR2_PACKAGE_HAS_OPUS_DECODER
	string

config BR2_PACKAGE_HAS_VP9_DECODER
	bool

config BR2_PACKAGE_PROVIDES_VP9_DECODER
	depends on BR2_PACKAGE_HAS_VP9_DECODER
	string

config BR2_PACKAGE_HAS_NEXUS_SAGE
	bool

config BR2_PACKAGE_PROVIDES_NEXUS_SAGE
	depends on BR2_PACKAGE_HAS_NEXUS_SAGE
	string
```

## package/nfs-utils/Config.in
```kconfig
comment "nfs-utils needs a toolchain w/ threads"
	depends on BR2_USE_MMU
	depends on !BR2_TOOLCHAIN_HAS_THREADS

config BR2_PACKAGE_NFS_UTILS
	bool "nfs-utils"
	depends on BR2_TOOLCHAIN_HAS_THREADS # libtirpc, rpcbind
	depends on BR2_USE_MMU # fork()
	select BR2_PACKAGE_LIBTIRPC # IPv6 requires libtirpc
	select BR2_PACKAGE_UTIL_LINUX
	select BR2_PACKAGE_UTIL_LINUX_LIBBLKID
	select BR2_PACKAGE_UTIL_LINUX_LIBMOUNT
	select BR2_PACKAGE_UTIL_LINUX_LIBUUID
	help
	  The NFS Linux kernel server.

	  Supports NFSv3 and optionally NFSv4 (and later).

	  http://linux-nfs.org/

if BR2_PACKAGE_NFS_UTILS

config BR2_PACKAGE_NFS_UTILS_NFSV4
	bool "NFSv4/NFSv4.1"
	depends on !BR2_STATIC_LIBS # keyutils, lvm2
	select BR2_PACKAGE_KEYUTILS
	select BR2_PACKAGE_LIBEVENT
	select BR2_PACKAGE_LVM2
	select BR2_PACKAGE_SQLITE
	help
	  Enable NFSv4/NFSv4.1/NFSv4.2 support

comment "NFSv4/NFSv4.1 support needs a toolchain w/ dynamic library"
	depends on BR2_STATIC_LIBS

config BR2_PACKAGE_NFS_UTILS_GSS
	bool "gss"
	depends on BR2_PACKAGE_NFS_UTILS_NFSV4
	select BR2_PACKAGE_LIBTIRPC_GSS
	help
	  Enable GSS support

config BR2_PACKAGE_NFS_UTILS_RPCDEBUG
	bool "rpcdebug"
	help
	  The RPC debugging utility

config BR2_PACKAGE_NFS_UTILS_RPC_LOCKD
	bool "rpc.lockd"
	help
	  NFS lock manager for Linux kernels older than 2.4

config BR2_PACKAGE_NFS_UTILS_RPC_NFSD
	bool "rpc.nfsd"
	default y
	select BR2_PACKAGE_RPCBIND # runtime
	help
	  NFS server

config BR2_PACKAGE_NFS_UTILS_RPC_RQUOTAD
	bool "rpc.rquotad"
	help
	  NFS remote quota server

endif
```

## package/nftables/nftables-python/Config.in
```kconfig
config BR2_PACKAGE_NFTABLES_PYTHON
	bool "python bindings"
	default y # legacy
	depends on BR2_PACKAGE_PYTHON3
```

## package/nginx-headers-more/Config.in
```kconfig
config BR2_PACKAGE_NGINX_HEADERS_MORE
	bool "nginx-headers-more"
	depends on BR2_PACKAGE_NGINX_HTTP
	help
	  Set and clear input and output headers...more than "add"!

	  https://github.com/openresty/headers-more-nginx-module
```

## package/nginx-substitutions/Config.in
```kconfig
config BR2_PACKAGE_NGINX_SUBSTITUTIONS
	bool "nginx-substitutions"
	depends on BR2_PACKAGE_NGINX_HTTP
	help
	  nginx_substitutions_filter is a filter module which can do both regular
	  expression and fixed string substitutions on response bodies. This
	  module is quite different from the Nginx's native Substitution Module.
	  It scans the output chains buffer and matches string line by line, just
	  like Apache's mod_substitute

	  https://github.com/yaoweibin/ngx_http_substitutions_filter_module
```

## package/ngircd/Config.in
```kconfig
config BR2_PACKAGE_NGIRCD
	bool "ngircd"
	depends on BR2_USE_MMU # fork()
	help
	  Next Generation IRC server daemon.

	  http://ngircd.barton.de
```

## package/ngrep/Config.in
```kconfig
config BR2_PACKAGE_NGREP
	bool "ngrep"
	depends on BR2_USE_WCHAR
	select BR2_PACKAGE_LIBPCAP
	select BR2_PACKAGE_PCRE2
	help
	  Network grep.

	  https://github.com/jpr5/ngrep/

comment "ngrep needs a toolchain w/ wchar"
	depends on !BR2_USE_WCHAR
```

## package/ninja/Config.in
```kconfig
config BR2_PACKAGE_NINJA
	bool "ninja"
	help
	  Enables faster incremental builds of WebKit.
```

## package/nodejs/Config.in.host
```kconfig
config BR2_PACKAGE_HOST_NODEJS_BIN_ARCH_SUPPORTS
	bool
	default y if BR2_HOSTARCH = "aarch64"
	default y if BR2_HOSTARCH = "arm"
	default y if BR2_HOSTARCH = "ppc64le"
	default y if BR2_HOSTARCH = "x86_64"

comment "host nodejs needs a host gcc >= 8"
	depends on !BR2_PACKAGE_HOST_NODEJS_BIN_ARCH_SUPPORTS
	depends on !BR2_HOST_GCC_AT_LEAST_8

config BR2_PACKAGE_HOST_NODEJS
	bool "host nodejs"
	depends on BR2_PACKAGE_HOST_NODEJS_BIN_ARCH_SUPPORTS || \
		BR2_HOST_GCC_AT_LEAST_8
	help
	  Event-driven I/O server-side JavaScript environment based on
	  V8.

	  http://nodejs.org/

if BR2_PACKAGE_HOST_NODEJS

choice
	prompt "host nodejs variant"
	default BR2_PACKAGE_HOST_NODEJS_BIN if BR2_PACKAGE_HOST_NODEJS_BIN_ARCH_SUPPORTS
	default BR2_PACKAGE_HOST_NODEJS_SRC
	help
	  Select a nodejs variant - built from source or
	  pre-built.

config BR2_PACKAGE_HOST_NODEJS_BIN
	bool "pre-built version"
	depends on BR2_PACKAGE_HOST_NODEJS_BIN_ARCH_SUPPORTS

config BR2_PACKAGE_HOST_NODEJS_SRC
	bool "compile from source"
	depends on BR2_HOST_GCC_AT_LEAST_8
	select BR2_PACKAGE_HOST_PYTHON3
	select BR2_PACKAGE_HOST_PYTHON3_BZIP2
	select BR2_PACKAGE_HOST_PYTHON3_SSL

comment "host nodejs from source needs a host gcc >= 8"
	depends on !BR2_HOST_GCC_AT_LEAST_8

endchoice

config BR2_PACKAGE_HOST_NODEJS_COREPACK
	bool "Corepack"
	help
	  Enable Corepack with host nodejs.

	  Corepack is a zero-runtime-dependency Node.js script that
	  acts as a bridge between Node.js projects and the package
	  managers they are intended to be used with during
	  development. In practical terms, Corepack will let you use
	  Yarn and pnpm without having to install them - just like
	  what currently happens with npm, which is shipped by Node.js
	  by default.

endif

config BR2_PACKAGE_PROVIDES_HOST_NODEJS
	string
	default "host-nodejs-src" if BR2_PACKAGE_HOST_NODEJS_SRC
	# default to host-nodejs-bin so it's used if nothing is set explicitly
	default "host-nodejs-bin" if !BR2_PACKAGE_HOST_NODEJS_SRC
```
