## package/nodogsplash/Config.in
```kconfig
config BR2_PACKAGE_NODOGSPLASH
	bool "nodogsplash"
	depends on BR2_PACKAGE_LIBMICROHTTPD
	help
	   Nodogsplash is a Captive Portal that offers 
	   a simple way to provide restricted access to the Internet by 
	   showing a splash page to the user before Internet access is granted

	   https://github.com/nodogsplash/nodogsplash/
```

## package/nopoll/Config.in
```kconfig
config BR2_PACKAGE_NOPOLL
    bool "nopoll"
    default n
    help
      noPoll is a OpenSource WebSocket implementation 
```

## package/noto-fonts/Config.in
```kconfig
config BR2_PACKAGE_NOTO_FONTS
	bool "Google Noto Fonts"
	help
	  Google Noto Fonts.

if BR2_PACKAGE_NOTO_FONTS

config BR2_PACKAGE_NOTO_FONTS_ARABIC
	bool "Arabic fonts"
	default n
	help
	  Arabic fonts support

config BR2_PACKAGE_NOTO_FONTS_BENGALI
	bool "Bengali fonts"
	default n
	help
	  Bengali fonts support

config BR2_PACKAGE_NOTO_FONTS_CHINESE
	bool "Chinese fonts"
	default n
	help
	  Chinese fonts support

config BR2_PACKAGE_NOTO_FONTS_ETHIOPIC
	bool "Ethiopic fonts"
	default n
	help
	  Ethiopic fonts support

config BR2_PACKAGE_NOTO_FONTS_GEORGIAN
	bool "Georgian fonts"
	default n
	help
	  Georgian fonts support

config BR2_PACKAGE_NOTO_FONTS_HEBREW
	bool "Hebrew fonts"
	default n
	help
	  Hebrew fonts support

config BR2_PACKAGE_NOTO_FONTS_JAPANESE
	bool "Japanese fonts"
	default n
	help
	  Japanese fonts support

config BR2_PACKAGE_NOTO_FONTS_KOREAN
	bool "Korean fonts"
	default n
	help
	  Korean fonts support

config BR2_PACKAGE_NOTO_FONTS_THAI
	bool "Thai fonts"
	default n
	help
	  Thai fonts support

endif
```

## package/nouveau-drm/Config.in
```kconfig
config BR2_PACKAGE_NOUVEAU_DRM
	bool "nouveau-drm"
    help
        Here be dragons.
```

## package/nqptp/Config.in
```kconfig
config BR2_PACKAGE_NQPTP
	bool "nqptp"
	depends on BR2_USE_MMU
	depends on BR2_TOOLCHAIN_HAS_THREADS
	select BR2_PACKAGE_LIBCONFIG
	help
	  nqptp is a daemon that monitors timing data from PTP clocks
	  it sees on ports 319 and 320. It maintains records for one
	  clock, identified by its Clock ID.

	  It is a companion application to Shairport Sync and provides
	  timing information for AirPlay 2 operation.

	  https://github.com/mikebrady/nqptp

comment "nqptp needs a toolchain w/ threads"
	depends on BR2_USE_MMU
	depends on !BR2_TOOLCHAIN_HAS_THREADS
```

## package/ntpsec/Config.in
```kconfig
config BR2_PACKAGE_NTPSEC
	bool "ntpsec"
	depends on BR2_USE_MMU # python3
	depends on BR2_USE_WCHAR # python3
	depends on BR2_TOOLCHAIN_HAS_THREADS # python3
	depends on !BR2_STATIC_LIBS # python3
	select BR2_PACKAGE_LIBCAP
	select BR2_PACKAGE_OPENSSL
	select BR2_PACKAGE_PYTHON3
	help
	  NTPsec project - a secure, hardened, and improved
	  implementation of Network Time Protocol derived
	  from NTP Classic, Dave Mills’s original.

	  Provides things like ntpd, ntpdate, ntpq, etc...

	  https://www.ntpsec.org/

if BR2_PACKAGE_NTPSEC

config BR2_PACKAGE_NTPSEC_CLASSIC_MODE
	bool "classic-mode"
	help
	  Enable strict configuration and log-format compatibility
	  with NTP Classic.

config BR2_PACKAGE_NTPSEC_NTS
	bool "NTS support"
	help
	  Enable Network Time Security (NTS) support.

config BR2_PACKAGE_NTPSEC_REFCLOCK_ALL
	bool "refclock-all"
	select BR2_PACKAGE_PPS_TOOLS
	help
	  Enable all refclocks (hardware, sync source and discplined
	  clocks)

endif

comment "ntpsec needs a toolchain w/ wchar, threads, dynamic library"
	depends on BR2_USE_MMU
	depends on !BR2_USE_WCHAR || !BR2_TOOLCHAIN_HAS_THREADS || \
		BR2_STATIC_LIBS
```

## package/nushell/Config.in
```kconfig
config BR2_PACKAGE_NUSHELL
	bool "nushell"
	depends on BR2_PACKAGE_HOST_RUSTC_TARGET_ARCH_SUPPORTS
	select BR2_PACKAGE_HOST_RUSTC
	select BR2_PACKAGE_OPENSSL
	select BR2_PACKAGE_HOST_PKGCONF
	select BR2_PACKAGE_NCURSES
	select BR2_PACKAGE_NCURSES_TARGET_PROGS
	help
	  A new type of shell.

	  https://github.com/nushell/nushell
```
