## package/squid/Config.in
```kconfig
comment "squid needs a toolchain w/ C++, threads, gcc >= 8, host gcc >= 8"
	depends on BR2_USE_MMU
	depends on BR2_TOOLCHAIN_HAS_ATOMIC
	depends on !BR2_INSTALL_LIBSTDCPP || \
		!BR2_TOOLCHAIN_HAS_THREADS || \
		!BR2_TOOLCHAIN_GCC_AT_LEAST_8 || \
		!BR2_HOST_GCC_AT_LEAST_8

config BR2_PACKAGE_SQUID
	bool "squid"
	depends on BR2_TOOLCHAIN_HAS_ATOMIC
	depends on BR2_INSTALL_LIBSTDCPP
	depends on BR2_TOOLCHAIN_HAS_THREADS
	depends on BR2_TOOLCHAIN_GCC_AT_LEAST_8 # C++17
	depends on BR2_HOST_GCC_AT_LEAST_8 # C++17
	# needs fork()
	depends on BR2_USE_MMU
	select BR2_PACKAGE_LIBCAP
	select BR2_PACKAGE_LIBTOOL
	select BR2_PACKAGE_LIBXML2
	help
	  Caching proxy for the Web supporting HTTP, HTTPS, FTP, and
	  more.

	  http://www.squid-cache.org/
```

## package/sratom/Config.in
```kconfig
config BR2_PACKAGE_SRATOM
	bool "sratom"
	select BR2_PACKAGE_LV2
	select BR2_PACKAGE_SERD
	select BR2_PACKAGE_SORD
	help
	  Sratom is a library for serialising LV2 atoms to and from
	  RDF, particularly the Turtle syntax.

	  https://drobilla.net/software/sratom.html
```

## package/ssdp-responder/Config.in
```kconfig
config BR2_PACKAGE_SSDP_RESPONDER
	bool "ssdp-responder"
	depends on BR2_USE_MMU
	help
	  Simple Service Discovery Protocol daemon (SSDP) for networked
	  Linux and UNIX devices. Useful in any setup, big or small, but
	  targeted more at embedded systems that need to announce
	  themselves to Windows systems.

	  The project consists of ssdpd and ssdp-scan.  The former is a
	  stand-alone UNIX daemon, it has no dependencies but a standard
	  C library.  It comes with built-in web server for serving the
	  UPnP XML description on port 1901, the XML is used by Windows
	  to present the icon, by default an InternetGatewayDevice is
	  announced.

	  ssdp-scan is a tool, similar to mdns-scan, to find other SSDP
	  capable hosts on the network.  Take care to only use it for
	  debugging, or quicker device discovery operations, since it
	  scans the network quite aggressively.

	  https://github.com/troglobit/ssdp-responder/
```

## package/sslh/Config.in
```kconfig
config BR2_PACKAGE_SSLH
	bool "sslh"
	# uses fork()
	depends on BR2_USE_MMU
	select BR2_PACKAGE_LIBCONFIG
	help
	  Applicative protocol multiplexer

	  http://www.rutschle.net/tech/sslh.shtml
```

## package/starfive-spltool/Config.in.host
```kconfig
config BR2_PACKAGE_HOST_STARFIVE_SPLTOOL
	bool "host starfive-spltool"
	depends on BR2_riscv
	help
	  Add header to the Secondary Program Loader with the 3rd party
	  software given by Starfive-Tech for their SoCs.

	  https://github.com/starfive-tech/soft_3rdpart/tree/JH7110_VisionFive2_devel/spl_tool
```

## package/stb/Config.in
```kconfig
config BR2_PACKAGE_STB
	bool "stb"
	help
	  Single-file image and audio processing libraries for C/C++.

	  https://github.com/nothings/stb
```

## package/stella/Config.in
```kconfig
config BR2_PACKAGE_STELLA
	bool "stella"
	depends on !BR2_STATIC_LIBS # sdl2
	depends on BR2_INSTALL_LIBSTDCPP
	depends on BR2_TOOLCHAIN_HAS_THREADS
	depends on BR2_TOOLCHAIN_GCC_AT_LEAST_7 # C++17
	depends on !BR2_TOOLCHAIN_HAS_GCC_BUG_64735 # exception_ptr
	select BR2_PACKAGE_SDL2
	help
	  Stella is a multi-platform Atari 2600 VCS emulator.

	  https://stella-emu.github.io/

comment "stella needs a toolchain w/ dynamic library, C++, threads, gcc >= 7"
	depends on BR2_STATIC_LIBS || !BR2_INSTALL_LIBSTDCPP || \
		!BR2_TOOLCHAIN_HAS_THREADS || \
		!BR2_TOOLCHAIN_GCC_AT_LEAST_7

comment "stella needs a toolchain not affected by GCC bug 64735"
	depends on BR2_TOOLCHAIN_HAS_GCC_BUG_64735
```

## package/stellarium/Config.in
```kconfig
config BR2_PACKAGE_STELLARIUM
	bool "stellarium"
	depends on BR2_PACKAGE_QT5 || BR2_PACKAGE_QT6
	depends on BR2_PACKAGE_QT5_GL_AVAILABLE || BR2_PACKAGE_QT6_GL_SUPPORTS
	depends on BR2_PACKAGE_HAS_LIBGL # does not support OpenGL ES
	select BR2_PACKAGE_QT5BASE_CONCURRENT if BR2_PACKAGE_QT5
	select BR2_PACKAGE_QT5BASE_GUI if BR2_PACKAGE_QT5
	select BR2_PACKAGE_QT5BASE_NETWORK if BR2_PACKAGE_QT5
	select BR2_PACKAGE_QT5BASE_OPENGL if BR2_PACKAGE_QT5
	select BR2_PACKAGE_QT5BASE_PRINTSUPPORT if BR2_PACKAGE_QT5
	select BR2_PACKAGE_QT5BASE_WIDGETS if BR2_PACKAGE_QT5
	select BR2_PACKAGE_QT5CHARTS if BR2_PACKAGE_QT5
	select BR2_PACKAGE_QT5LOCATION if BR2_PACKAGE_QT5
	select BR2_PACKAGE_QT5MULTIMEDIA if BR2_PACKAGE_QT5
	select BR2_PACKAGE_QT5SVG if BR2_PACKAGE_QT5
	select BR2_PACKAGE_QT6BASE_CONCURRENT if BR2_PACKAGE_QT6
	select BR2_PACKAGE_QT6BASE_GUI if BR2_PACKAGE_QT6
	select BR2_PACKAGE_QT6BASE_NETWORK if BR2_PACKAGE_QT6
	select BR2_PACKAGE_QT6BASE_OPENGL if BR2_PACKAGE_QT6
	select BR2_PACKAGE_QT6BASE_PRINTSUPPORT if BR2_PACKAGE_QT6
	select BR2_PACKAGE_QT6BASE_WIDGETS if BR2_PACKAGE_QT6
	select BR2_PACKAGE_QT6CHARTS if BR2_PACKAGE_QT6
	select BR2_PACKAGE_QT6MULTIMEDIA if BR2_PACKAGE_QT6
	select BR2_PACKAGE_QT6POSITIONING if BR2_PACKAGE_QT6
	select BR2_PACKAGE_QT6SVG if BR2_PACKAGE_QT6
	select BR2_PACKAGE_ZLIB
	help
	  Stellarium is a free open source planetarium for your
	  computer. It shows a realistic sky in 3D, just like what
	  you see with the naked eye, binoculars or a telescope.

	  https://stellarium.org

comment "stellarium needs Qt5/6 and an OpenGL provider"
	depends on (!BR2_PACKAGE_QT5 && !BR2_PACKAGE_QT6) || !BR2_PACKAGE_HAS_LIBGL
```

## package/strace/Config.in
```kconfig
config BR2_PACKAGE_STRACE
	bool "strace"
	depends on BR2_TOOLCHAIN_HEADERS_AT_LEAST_5_1 # time_types.h
	depends on !BR2_RISCV_32
	help
	  A useful diagnostic, instructional, and debugging tool.
	  Allows you to track what system calls a program makes
	  while it is running.

	  If you want 'strace -k' to work, make sure to enable the
	  'libunwind' package.

	  https://strace.io

comment "strace needs a toolchain w/ headers >= 5.1"
	depends on !BR2_TOOLCHAIN_HEADERS_AT_LEAST_5_1
```

## package/stress-ng/Config.in
```kconfig
config BR2_PACKAGE_STRESS_NG
	bool "stress-ng"
	depends on BR2_USE_MMU # fork()
	# perf.c needs PERF_COUNT_HW_REF_CPU_CYCLES
	depends on BR2_TOOLCHAIN_HAS_SYNC_4
	depends on BR2_TOOLCHAIN_HEADERS_AT_LEAST_3_3
	depends on BR2_TOOLCHAIN_HAS_THREADS
	# fenv.h lacks FE_INVALID, FE_OVERFLOW & FE_UNDERFLOW on ARC
	depends on !BR2_arc
	help
	  stress-ng will stress test a computer system in various
	  selectable ways. It was designed to exercise various physical
	  subsystems of a computer as well as the various operating
	  system kernel interfaces.

	  https://github.com/ColinIanKing/stress-ng

comment "stress-ng needs a toolchain w/ threads, headers >= 3.3"
	depends on !BR2_arc
	depends on BR2_TOOLCHAIN_HAS_SYNC_4
	depends on BR2_USE_MMU
	depends on !BR2_TOOLCHAIN_HEADERS_AT_LEAST_3_3 || !BR2_TOOLCHAIN_HAS_THREADS
```

## package/strongswan/Config.in
```kconfig
comment "strongswan needs a toolchain w/ threads, dynamic library"
	depends on BR2_USE_MMU
	depends on BR2_TOOLCHAIN_HAS_ATOMIC
	depends on !BR2_TOOLCHAIN_HAS_THREADS || BR2_STATIC_LIBS

menuconfig BR2_PACKAGE_STRONGSWAN
	bool "strongswan"
	depends on BR2_USE_MMU # fork()
	depends on BR2_TOOLCHAIN_HAS_THREADS
	depends on BR2_TOOLCHAIN_HAS_ATOMIC
	depends on !BR2_STATIC_LIBS
	help
	  strongSwan is an OpenSource IPsec implementation for the
	  Linux operating system. It is based on the discontinued
	  FreeS/WAN project and the X.509 patch.

	  The focus is on:
	   - simplicity of configuration
	   - strong encryption and authentication methods
	   - powerful IPsec policies supporting large and complex
	     VPN networks

	  strongSwan provide many plugins. Only a few are presented
	  here.

	  http://www.strongswan.org/

if BR2_PACKAGE_STRONGSWAN

choice
	prompt "Cryptographic backend"
	default BR2_PACKAGE_STRONGSWAN_GMP

config BR2_PACKAGE_STRONGSWAN_BOTAN
	bool "botan"
	depends on BR2_PACKAGE_BOTAN_ARCH_SUPPORTS
	depends on BR2_INSTALL_LIBSTDCPP
	depends on BR2_TOOLCHAIN_GCC_AT_LEAST_4_8
	depends on !BR2_TOOLCHAIN_HAS_GCC_BUG_64735
	select BR2_PACKAGE_BOTAN

comment "botan backend needs a toolchain w/ C++, gcc >= 4.8"
	depends on !BR2_INSTALL_LIBSTDCPP \
		|| !BR2_TOOLCHAIN_GCC_AT_LEAST_4_8
	depends on BR2_PACKAGE_BOTAN_ARCH_SUPPORTS

comment "botan backend needs a toolchain not affected by GCC bug 64735"
	depends on BR2_PACKAGE_BOTAN_ARCH_SUPPORTS
	depends on BR2_TOOLCHAIN_HAS_GCC_BUG_64735

config BR2_PACKAGE_STRONGSWAN_OPENSSL
	bool "OpenSSL"
	select BR2_PACKAGE_OPENSSL

config BR2_PACKAGE_STRONGSWAN_GCRYPT
	bool "libgcrypt"
	depends on BR2_PACKAGE_LIBGPG_ERROR_ARCH_SUPPORTS # libgcrypt
	select BR2_PACKAGE_LIBGCRYPT

config BR2_PACKAGE_STRONGSWAN_GMP
	bool "GNU MP (libgmp)"
	select BR2_PACKAGE_GMP

config BR2_PACKAGE_STRONGSWAN_WOLFSSL
	bool "wolfssl"
	select BR2_PACKAGE_WOLFSSL

endchoice

config BR2_PACKAGE_STRONGSWAN_AF_ALG
	bool "Enable AF_ALG crypto interface to Linux Crypto API"

config BR2_PACKAGE_STRONGSWAN_CURL
	bool "Enable CURL fetcher plugin to fetch files via libcurl"
	select BR2_PACKAGE_LIBCURL

config BR2_PACKAGE_STRONGSWAN_MD4
	bool "Enable MD4 hash algorithm"

config BR2_PACKAGE_STRONGSWAN_CHARON
	bool "Enable the IKEv1/IKEv2 keying daemon charon"
	default y

if BR2_PACKAGE_STRONGSWAN_CHARON

config BR2_PACKAGE_STRONGSWAN_TNCCS_11
	bool "Enable TNCCS 1.1 protocol module"
	select BR2_PACKAGE_LIBXML2

config BR2_PACKAGE_STRONGSWAN_TNCCS_20
	bool "Enable TNCCS 2.0 protocol module"

config BR2_PACKAGE_STRONGSWAN_TNCCS_DYNAMIC
	bool "Enable dynamic TNCCS protocol discovery module"

config BR2_PACKAGE_STRONGSWAN_SYSTIME_FIX
	bool "Enable systime-fix plugin"

config BR2_PACKAGE_STRONGSWAN_EAP_SIM
	bool "Enable EAP-SIM"
	default y if BR2_PACKAGE_STRONGSWAN_EAP # legacy

config BR2_PACKAGE_STRONGSWAN_EAP_SIM_FILE
	bool "Enable EAP-SIM file backend"
	default y if BR2_PACKAGE_STRONGSWAN_EAP # legacy
	select BR2_PACKAGE_STRONGSWAN_EAP_SIM

config BR2_PACKAGE_STRONGSWAN_EAP_SIM_PCSC
	bool "Enable EAP-SIM smart card backend"
	depends on !BR2_STATIC_LIBS # pcsc-lite
	select BR2_PACKAGE_PCSC_LITE
	select BR2_PACKAGE_STRONGSWAN_EAP_SIM

config BR2_PACKAGE_STRONGSWAN_EAP_AKA
	bool "Enable EAP-AKA"
	default y if BR2_PACKAGE_STRONGSWAN_EAP # legacy

config BR2_PACKAGE_STRONGSWAN_EAP_AKA_3GPP2
	bool "Enable EAP-AKA 3GPP2 algorithms"
	default y if BR2_PACKAGE_STRONGSWAN_EAP # legacy
	select BR2_PACKAGE_GMP
	select BR2_PACKAGE_STRONGSWAN_EAP_AKA

config BR2_PACKAGE_STRONGSWAN_EAP_SIMAKA_SQL
	bool "Enable EAP-SIM/AKA backend based on a triplet/quintuplet SQL database"
	default y if BR2_PACKAGE_STRONGSWAN_EAP # legacy
	select BR2_PACKAGE_STRONGSWAN_EAP_AKA
	select BR2_PACKAGE_STRONGSWAN_EAP_SIM

config BR2_PACKAGE_STRONGSWAN_EAP_SIMAKA_PSEUDONYM
	bool "Enable EAP-SIM/AKA pseudonym storage"
	default y if BR2_PACKAGE_STRONGSWAN_EAP # legacy
	select BR2_PACKAGE_STRONGSWAN_EAP_AKA
	select BR2_PACKAGE_STRONGSWAN_EAP_SIM

config BR2_PACKAGE_STRONGSWAN_EAP_SIMAKA_REAUTH
	bool "Enable EAP-SIM/AKA reauthentication data storage"
	default y if BR2_PACKAGE_STRONGSWAN_EAP # legacy
	select BR2_PACKAGE_STRONGSWAN_EAP_AKA
	select BR2_PACKAGE_STRONGSWAN_EAP_SIM

config BR2_PACKAGE_STRONGSWAN_EAP_IDENTITY
	bool "Enable EAP-Identity"
	default y if BR2_PACKAGE_STRONGSWAN_EAP # legacy

config BR2_PACKAGE_STRONGSWAN_EAP_MD5
	bool "Enable EAP-MD5"
	default y if BR2_PACKAGE_STRONGSWAN_EAP # legacy

config BR2_PACKAGE_STRONGSWAN_EAP_GTC
	bool "Enable EAP-GDC"
	default y if BR2_PACKAGE_STRONGSWAN_EAP # legacy

config BR2_PACKAGE_STRONGSWAN_EAP_MSCHAPV2
	bool "Enable EAP-MSCHAPv2"
	default y if BR2_PACKAGE_STRONGSWAN_EAP # legacy
	select BR2_PACKAGE_STRONGSWAN_MD4

config BR2_PACKAGE_STRONGSWAN_EAP_PEAP
	bool "Enable EAP-PEAP"
	default y if BR2_PACKAGE_STRONGSWAN_EAP # legacy

config BR2_PACKAGE_STRONGSWAN_EAP_RADIUS
	bool "Enable EAP-RADIUS"
	default y if BR2_PACKAGE_STRONGSWAN_EAP # legacy

config BR2_PACKAGE_STRONGSWAN_EAP_TLS
	bool "Enable EAP-TLS"
	default y if BR2_PACKAGE_STRONGSWAN_EAP # legacy

config BR2_PACKAGE_STRONGSWAN_EAP_TTLS
	bool "Enable EAP-TTLS"
	default y if BR2_PACKAGE_STRONGSWAN_EAP # legacy

config BR2_PACKAGE_STRONGSWAN_EAP_DYNAMIC
	bool "Enable EAP-DYNAMIC"
	default y if BR2_PACKAGE_STRONGSWAN_EAP # legacy

config BR2_PACKAGE_STRONGSWAN_EAP_TNC
	bool "Enable EAP-TNC"
	default y if BR2_PACKAGE_STRONGSWAN_EAP # legacy

config BR2_PACKAGE_STRONGSWAN_UNITY
	bool "Enables Cisco Unity extension plugin"

config BR2_PACKAGE_STRONGSWAN_STROKE
	bool "Enable charons stroke configuration backend"
	default y

config BR2_PACKAGE_STRONGSWAN_SQL
	bool "Enable SQL database configuration backend"
	depends on BR2_PACKAGE_SQLITE || BR2_PACKAGE_MYSQL

endif

config BR2_PACKAGE_STRONGSWAN_PKI
	bool "Enable pki certificate utility"
	default y

config BR2_PACKAGE_STRONGSWAN_SCEP
	bool "Enable SCEP client tool"

config BR2_PACKAGE_STRONGSWAN_SCRIPTS
	bool "Enable additional utilities (found in scripts directory)"
	default y
	depends on BR2_PACKAGE_STRONGSWAN_CHARON

config BR2_PACKAGE_STRONGSWAN_VICI
	bool "Enable vici/swanctl"
	default y
	depends on BR2_PACKAGE_STRONGSWAN_CHARON

endif
```

## package/stunnel/Config.in
```kconfig
config BR2_PACKAGE_STUNNEL
	bool "stunnel"
	depends on BR2_USE_MMU # fork()
	select BR2_PACKAGE_OPENSSL
	select BR2_PACKAGE_OPENSSL_FORCE_LIBOPENSSL
	select BR2_PACKAGE_LIBOPENSSL_ENABLE_DES
	help
	  Stunnel is a program that wraps any TCP connection with an SSL
	  connection.

	  http://www.stunnel.org/
```

## package/sudo/Config.in
```kconfig
config BR2_PACKAGE_SUDO
	bool "sudo"
	# uses fork()
	depends on BR2_USE_MMU
	select BR2_PACKAGE_LIBXCRYPT if BR2_TOOLCHAIN_USES_GLIBC
	help
	  Sudo is a program designed to allow a sysadmin to give
	  limited root privileges to users and log root activity. The
	  basic philosophy is to give as few privileges as possible
	  but still allow people to get their work done.

	  https://www.sudo.ws/sudo/
```

## package/sunxi-mali-utgard-driver/Config.in
```kconfig
comment "sunxi-mali-utgard-driver needs a Linux kernel to be built"
	depends on BR2_PACKAGE_SUNXI_MALI_UTGARD
	depends on !BR2_LINUX_KERNEL

config BR2_PACKAGE_SUNXI_MALI_UTGARD_DRIVER
	bool "sunxi-mali-utgard-driver"
	default y
	depends on BR2_PACKAGE_SUNXI_MALI_UTGARD # runtime
	depends on BR2_LINUX_KERNEL
	select BR2_LINUX_NEEDS_MODULES # not using kernel-module infra
	help
	  This package builds and installs the Linux kernel driver for
	  the Mali Utgard GPU on Allwinner platforms, compatible with
	  recent Linux kernels (>= 4.4). Note that it should be
	  installed together with the corresponding userspace OpenGL
	  libraries, which are provided as binaries only at:
	  https://github.com/bootlin/mali-blobs

	  sunxi-mali-utgard-driver requires a Linux kernel >= 4.4
	  with the following options enabled:

	  - CONFIG_CMA
	  - CONFIG_DMA_CMA

	  starting from Linux Kernel >= 4.20 following options must be
	  enabled:
	  - CONFIG_DRM_FBDEV_LEAK_PHYS_SMEM

	  The following kernel command line options must be passed:

	  - drm_kms_helper.drm_leak_fbdev_smem = 1
	    since drm_kms_helper.drm_leak_fbdev_smem is set to 0 by
	    default

	  - drm_kms_helper.drm_fbdev_overalloc >= 200
	    since the driver requires at least double buffering and
	    fails to work with the default value(100).

	  https://github.com/mripard/sunxi-mali/blob/master/README.md
```
