## package/sunxi-mali-utgard/Config.in
```kconfig
config BR2_PACKAGE_SUNXI_MALI_UTGARD
	bool "sunxi-mali-utgard"
	depends on BR2_aarch64 || (BR2_ARM_EABIHF && BR2_arm)
	depends on BR2_TOOLCHAIN_USES_GLIBC
	select BR2_PACKAGE_HAS_LIBEGL
	select BR2_PACKAGE_HAS_LIBGLES
	help
	  Install userspace Allwinner OpenGL libraries for Mali
	  Utgard GPUs.

	  https://github.com/bootlin/mali-blobs

if BR2_PACKAGE_SUNXI_MALI_UTGARD

config BR2_PACKAGE_PROVIDES_LIBEGL
	default "sunxi-mali-utgard"

config BR2_PACKAGE_PROVIDES_LIBGLES
	default "sunxi-mali-utgard"

choice
	prompt "Version"
	default BR2_PACKAGE_SUNXI_MALI_UTGARD_R6P2
	help
	  Select the version of the userspace module.

config BR2_PACKAGE_SUNXI_MALI_UTGARD_R6P2
	bool "r6p2"
config BR2_PACKAGE_SUNXI_MALI_UTGARD_R8P1
	bool "r8p1"

endchoice

config BR2_PACKAGE_SUNXI_MALI_UTGARD_REVISION
	string
	default "r6p2"	if BR2_PACKAGE_SUNXI_MALI_UTGARD_R6P2
	default "r8p1"	if BR2_PACKAGE_SUNXI_MALI_UTGARD_R8P1

endif

comment "sunxi-mali-utgard needs an EABIhf glibc toolchain"
	depends on BR2_arm
	depends on !BR2_TOOLCHAIN_USES_GLIBC || !BR2_ARM_EABIHF
```

## package/superiotool/Config.in
```kconfig
config BR2_PACKAGE_SUPERIOTOOL
	bool "superiotool"
	depends on BR2_x86_64 || BR2_i386
	select BR2_PACKAGE_PCIUTILS
	help
	  Super I/O detection tool.

	  https://www.coreboot.org/Superiotool
```

## package/supertuxkart/Config.in
```kconfig
config BR2_PACKAGE_SUPERTUXKART
	bool "supertuxkart"
	depends on BR2_HOSTARCH = "x86_64" || BR2_HOSTARCH = "x86"
	depends on BR2_i386 || BR2_x86_64
	depends on BR2_USE_MMU # fork()
	depends on BR2_INSTALL_LIBSTDCPP # openal
	depends on BR2_TOOLCHAIN_GCC_AT_LEAST_4_9 # harfbuzz, openal
	depends on BR2_TOOLCHAIN_HAS_THREADS_NPTL # openal
	depends on BR2_PACKAGE_OPENAL_ARCH_SUPPORTS # openal
	depends on BR2_PACKAGE_HAS_LIBGL
	depends on BR2_PACKAGE_XORG7
	depends on !BR2_TOOLCHAIN_USES_MUSL
	select BR2_PACKAGE_FREETYPE
	select BR2_PACKAGE_ENET
	select BR2_PACKAGE_HARFBUZZ
	select BR2_PACKAGE_JPEG
	select BR2_PACKAGE_LIBCURL
	select BR2_PACKAGE_LIBOGG
	select BR2_PACKAGE_LIBPNG
	select BR2_PACKAGE_LIBSQUISH
	select BR2_PACKAGE_LIBVORBIS
	select BR2_PACKAGE_OPENSSL if !BR2_PACKAGE_MBEDTLS
	select BR2_PACKAGE_OPENAL
	select BR2_PACKAGE_SDL2
	select BR2_PACKAGE_XLIB_LIBXRANDR
	select BR2_PACKAGE_ZLIB
	select BR2_PACKAGE_BLUEZ5_UTILS_PLUGINS_HID if BR2_PACKAGE_BLUEZ5_UTILS && BR2_TOOLCHAIN_HEADERS_AT_LEAST_3_18 # runtime
	help
	  Karts. Nitro. Action! SuperTuxKart is a free 3D arcade kart
	  racer with multiple karts, tracks and modes you can play.
	  Beat the evil Nolok by any means necessary, and make the
	  mascot kingdom safe once again!

	  http://supertuxkart.sourceforge.net/Main_Page

comment "supertuxkart needs an OpenGL backend, a uClibc or glibc toolchain w/ NPTL, C++, gcc >= 4.9"
	depends on BR2_HOSTARCH = "x86_64" || BR2_HOSTARCH = "x86"
	depends on BR2_i386 || BR2_x86_64
	depends on BR2_USE_MMU
	depends on BR2_PACKAGE_OPENAL_ARCH_SUPPORTS
	depends on BR2_PACKAGE_XORG7
	depends on !BR2_TOOLCHAIN_HAS_THREADS_NPTL \
		|| !BR2_INSTALL_LIBSTDCPP \
		|| !BR2_TOOLCHAIN_GCC_AT_LEAST_4_9 \
		|| !BR2_PACKAGE_HAS_LIBGL \
		|| BR2_TOOLCHAIN_USES_MUSL
```

## package/sway/Config.in
```kconfig
config BR2_PACKAGE_SWAY
	bool "sway"
	depends on BR2_PACKAGE_SYSTEMD # is required by the sd-bus provider
	depends on !BR2_STATIC_LIBS # wlroots
	depends on BR2_TOOLCHAIN_HAS_THREADS # pango, wlroots
	depends on BR2_PACKAGE_HAS_LIBEGL # wlroots
	depends on BR2_PACKAGE_HAS_LIBGLES # wlroots
	depends on BR2_PACKAGE_HAS_UDEV # wlroots
	depends on BR2_TOOLCHAIN_HAS_SYNC_4 # json-c, pango
	depends on BR2_USE_WCHAR # pango
	depends on BR2_USE_MMU # pango
	depends on BR2_INSTALL_LIBSTDCPP # pango
	depends on BR2_TOOLCHAIN_GCC_AT_LEAST_4_9 # pango
	select BR2_PACKAGE_WLROOTS
	select BR2_PACKAGE_JSON_C
	select BR2_PACKAGE_PCRE
	select BR2_PACKAGE_CAIRO
	select BR2_PACKAGE_CAIRO_PNG
	select BR2_PACKAGE_PANGO
	select BR2_PACKAGE_XKEYBOARD_CONFIG # runtime
	help
	  i3-compatible Wayland compositor
	  Note:
	    The default sway config uses the foot package as the
	    default terminal. If you plan on using the default
	    config, it is recommended to select the foot package!

	  https://github.com/swaywm/sway

if BR2_PACKAGE_SWAY

config BR2_PACKAGE_SWAY_SWAYBAR
	bool "swaybar"
	select BR2_PACKAGE_DEJAVU
	select BR2_PACKAGE_JQ if BR2_PACKAGE_BASH_COMPLETION # Runtime
	select BR2_PACKAGE_DMENU_WAYLAND # Runtime
	help
	  Enable support for swaybar

if BR2_PACKAGE_SWAY_SWAYBAR

config BR2_PACKAGE_SWAY_SWAYBAR_TRAY
	bool "swaybar tray"
	help
	  Enable support for swaybar tray

endif # BR2_PACKAGE_SWAY_SWAYBAR

config BR2_PACKAGE_SWAY_SWAYNAG
	bool "swaynag"
	help
	  Enable support for swaynag

endif # BR2_PACKAGE_SWAY

comment "sway needs systemd, udev, EGL and OpenGL ES support"
	depends on !BR2_PACKAGE_SYSTEMD || \
		!BR2_PACKAGE_HAS_UDEV || \
		!BR2_PACKAGE_HAS_LIBEGL || \
		!BR2_PACKAGE_HAS_LIBGLES

comment "sway needs a toolchain w/ wchar, threads, C++, dynamic library, gcc >= 4.9"
	depends on BR2_USE_MMU
	depends on BR2_TOOLCHAIN_HAS_SYNC_4
	depends on !BR2_USE_WCHAR || \
		!BR2_TOOLCHAIN_HAS_THREADS || \
		!BR2_TOOLCHAIN_GCC_AT_LEAST_4_9 || \
		!BR2_INSTALL_LIBSTDCPP || \
		BR2_STATIC_LIBS
```

## package/swaybg/Config.in
```kconfig
config BR2_PACKAGE_SWAYBG
	bool "swaybg"
	default y if BR2_PACKAGE_SWAY
	depends on !BR2_STATIC_LIBS # wayland -> dlfcn.h
	depends on BR2_TOOLCHAIN_HAS_THREADS # wayland
	select BR2_PACKAGE_CAIRO
	select BR2_PACKAGE_CAIRO_PNG
	select BR2_PACKAGE_WAYLAND
	select BR2_PACKAGE_WAYLAND_PROTOCOLS
	help
	  Wallpaper tool for Wayland compositors.

	  https://github.com/swaywm/swaybg
```

## package/swipl/Config.in
```kconfig
# swipl supports arch for which libc fenv.h provides all four macros:
# FE_DOWNWARD, FE_TONEAREST, FE_TOWARDZERO, FE_UPWARD
# See for example in glibc https://sourceware.org/git/glibc.git
# git grep -E '^[[:space:]]*#[[:space:]]*define[[:space:]]+FE_(TONEAREST|UPWARD|DOWNWARD|TOWARDZERO)' sysdeps/
config BR2_PACKAGE_SWIPL_ARCH_SUPPORTS
	bool
	default y if BR2_aarch64 || BR2_aarch64_be
	default y if BR2_arceb || BR2_arcle
	default y if BR2_arm || BR2_armeb
	default y if BR2_i386
	default y if BR2_m68k
	# BR2_microblaze has only FE_TONEAREST
	default y if BR2_mips || BR2_mipsel || BR2_mips64 || BR2_mips64el
	default y if BR2_or1k
	default y if BR2_powerpc || BR2_powerpc64 || BR2_powerpc64le
	default y if BR2_riscv
	default y if BR2_s390x
	# BR2_sh has only FE_{TONEAREST,TOWARDZERO}
	default y if BR2_sparc || BR2_sparc64
	default y if BR2_x86_64
	# BR2_xtensa supports only uclibc which does not have fenv.h

config BR2_PACKAGE_SWIPL
	bool "swipl"
	depends on BR2_TOOLCHAIN_GCC_AT_LEAST_5 # __has_attribute()
	depends on BR2_PACKAGE_SWIPL_ARCH_SUPPORTS
	# swipl needs fenv.h which is not provided by uclibc
	depends on !BR2_TOOLCHAIN_USES_UCLIBC
	select BR2_PACKAGE_ZLIB
	help
	  SWI-Prolog offers a comprehensive free Prolog
	  environment. Since its start in 1987, SWI-Prolog development
	  has been driven by the needs of real world
	  applications. SWI-Prolog is widely used in research and
	  education as well as commercial applications.

	  https://www.swi-prolog.org

comment "swipl needs a glibc or musl toolchain w/ gcc >= 5"
	depends on BR2_PACKAGE_SWIPL_ARCH_SUPPORTS
	depends on !BR2_TOOLCHAIN_GCC_AT_LEAST_5 || \
		BR2_TOOLCHAIN_USES_UCLIBC
```

## package/swtpm/Config.in.host
```kconfig
config BR2_PACKAGE_HOST_SWTPM
	bool "host swtpm"
	help
	  Compiles SWTPM software TPM emulator for the host.

	  The SWTPM package provides TPM emulators with different
	  front-end interfaces to libtpms. TPM emulators provide socket
	  interfaces (TCP/IP and Unix) and the Linux CUSE interface for
	  the creation of multiple native /dev/vtpm* devices.

	  https://github.com/stefanberger/swtpm/wiki
```

## package/swugenerator/Config.in.host
```kconfig
config BR2_PACKAGE_HOST_SWUGENERATOR
	bool "host swugenerator"
	help
	  A host tool to generate SWU update package for SWUpdate.

	  https://github.com/sbabic/swugenerator
```

## package/synaptics/Config.in
```kconfig
source "package/synaptics/marvell-firmware/Config.in"
source "package/synaptics/marvell-ampsdk/Config.in"
```

## package/synaptics/marvell-ampsdk/Config.in
```kconfig
menuconfig BR2_PACKAGE_MARVELL_AMPSDK
	bool "Marvell Armada Media Player SDK"
	help
	  Collection of prebuild binaries for Synaptics/Marvell Media Playback
```

## package/synaptics/marvell-firmware/Config.in
```kconfig
menuconfig BR2_PACKAGE_MARVELL_FIRMWARE
	bool "Marvell Firmware"
	select BR2_PACKAGE_HAS_LIBEGL if BR2_PACKAGE_MARVELL_FIRMWARE_GFX
	select BR2_PACKAGE_HAS_LIBGLES  if BR2_PACKAGE_MARVELL_FIRMWARE_GFX
	select BR2_PACKAGE_HAS_LIBOPENVG  if BR2_PACKAGE_MARVELL_FIRMWARE_GFX
	depends on BR2_PACKAGE_MARVELL_AMPSDK
	help
	  Collection of prebuild binaries for Synaptics/Marvell SOC

if BR2_PACKAGE_MARVELL_FIRMWARE


config BR2_PACKAGE_PROVIDES_LIBEGL
	default "marvell-firmware"

config BR2_PACKAGE_PROVIDES_LIBGLES
	default "marvell-firmware"

config BR2_PACKAGE_PROVIDES_LIBOPENVG
	default "marvell-firmware"

config BR2_PACKAGE_MARVELL_FIRMWARE_GFX
    bool "Install per-build graphic libraries"
    help
      per-build graphic libraries for Synaptics/Marvell SOC

endif
```
