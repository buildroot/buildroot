## package/python-channels-redis/Config.in
```kconfig
config BR2_PACKAGE_PYTHON_CHANNELS_REDIS
	bool "python-channels-redis"
	# python-channels -> python-daphne -> python-autobahn -> python-cryptography
	depends on BR2_PACKAGE_HOST_RUSTC_TARGET_ARCH_SUPPORTS
	select BR2_PACKAGE_PYTHON_AIOREDIS # runtime
	select BR2_PACKAGE_PYTHON_ASGIREF # runtime
	select BR2_PACKAGE_PYTHON_CHANNELS # runtime
	select BR2_PACKAGE_PYTHON_MSGPACK # runtime
	help
	  A Django Channels channel layer that uses Redis as its
	  backing store, and supports both a single-server and
	  sharded configurations, as well as group support.

	  http://github.com/django/channels_redis/
```

## package/python-chardet/Config.in
```kconfig
config BR2_PACKAGE_PYTHON_CHARDET
	bool "python-chardet"
	help
	  Universal encoding detector for Python 3.

	  https://github.com/chardet/chardet
```

## package/python-charset-normalizer/Config.in
```kconfig
config BR2_PACKAGE_PYTHON_CHARSET_NORMALIZER
	bool "python-charset-normalizer"
	help
	  The Real First Universal Charset Detector. Open, modern and
	  actively maintained alternative to Chardet.

	  https://github.com/ousret/charset_normalizer
```

## package/python-cherrypy/Config.in
```kconfig
config BR2_PACKAGE_PYTHON_CHERRYPY
	bool "python-cherrypy"
	select BR2_PACKAGE_PYTHON_CHEROOT # runtime
	select BR2_PACKAGE_PYTHON_JARACO_COLLECTIONS # runtime
	select BR2_PACKAGE_PYTHON_MORE_ITERTOOLS # runtime
	select BR2_PACKAGE_PYTHON_PORTEND # runtime
	select BR2_PACKAGE_PYTHON_ZC_LOCKFILE # runtime
	select BR2_PACKAGE_PYTHON3_PYEXPAT # runtime
	select BR2_PACKAGE_PYTHON3_ZLIB # runtime
	help
	  A minimalist web framework

	  http://www.cherrypy.org
```

## package/python-click/Config.in
```kconfig
config BR2_PACKAGE_PYTHON_CLICK
	bool "python-click"
	help
	  Python composable command line interface toolkit.

	  https://click.palletsprojects.com/
```

## package/python-cloudpickle/Config.in
```kconfig
config BR2_PACKAGE_PYTHON_CLOUDPICKLE
	bool "python-cloudpickle"
	help
	  Pickler class to extend the standard pickle.Pickler
	  functionality.

	  https://github.com/cloudpipe/cloudpickle
```

## package/python-colorlog/Config.in
```kconfig
config BR2_PACKAGE_PYTHON_COLORLOG
	bool "python-colorlog"
	depends on BR2_PACKAGE_PYTHON3
	help
	  Log formatting with colors.

	  https://github.com/borntyping/python-colorlog
```

## package/python-colorzero/Config.in
```kconfig
config BR2_PACKAGE_PYTHON_COLORZERO
	bool "python-colorzero"
	depends on BR2_PACKAGE_PYTHON3
	help
	  A color manipulation library for Python.

	  https://github.com/waveform80/colorzero
```

## package/python-configobj/Config.in
```kconfig
config BR2_PACKAGE_PYTHON_CONFIGOBJ
	bool "python-configobj"
	help
	  Config file reading, writing and validation.

	  https://github.com/DiffSK/configobj
```

## package/python-connexion/Config.in
```kconfig
config BR2_PACKAGE_PYTHON_CONNEXION
	bool "python-connexion"
	select BR2_PACKAGE_PYTHON_SETUPTOOLS_SCM
	select BR2_PACKAGE_PYTHON_CLICKCLICK # runtime
	select BR2_PACKAGE_PYTHON_FLASK # runtime
	select BR2_PACKAGE_PYTHON_IMPORTLIB_METADATA # runtime
	select BR2_PACKAGE_PYTHON_INFLECTION # runtime
	select BR2_PACKAGE_PYTHON_ITSDANGEROUS # runtime
	select BR2_PACKAGE_PYTHON_JSONSCHEMA # runtime
	select BR2_PACKAGE_PYTHON_PACKAGING # runtime
	select BR2_PACKAGE_PYTHON_PYYAML # runtime
	select BR2_PACKAGE_PYTHON_REQUESTS # runtime
	select BR2_PACKAGE_PYTHON_WERKZEUG # runtime
	help
	  Connexion - API first applications with OpenAPI/Swagger and
	  Flask.

	  https://github.com/zalando/connexion
```

## package/python-construct/Config.in
```kconfig
config BR2_PACKAGE_PYTHON_CONSTRUCT
	bool "python-construct"
	help
	  A powerful declarative symmetric parser/builder for binary
	  data.

	  https://construct.readthedocs.io/
```

## package/python-contourpy/Config.in
```kconfig
config BR2_PACKAGE_PYTHON_CONTOURPY
	bool "python-contourpy"
	depends on BR2_INSTALL_LIBSTDCPP
	select BR2_PACKAGE_PYTHON_PYBIND
	help
	  Python library for calculating contours of 2D quadrilateral
	  grids.

	  https://github.com/contourpy/contourpy

comment "python-contourpy needs a toolchain w/ C++"
	depends on !BR2_INSTALL_LIBSTDCPP
```

## package/python-couchdb/Config.in
```kconfig
config BR2_PACKAGE_PYTHON_COUCHDB
	bool "python-couchdb"
	select BR2_PACKAGE_PYTHON3_SSL # runtime
	help
	  Python client library for working with CouchDB.

	  https://github.com/djc/couchdb-python/
```

## package/python-crayons/Config.in
```kconfig
config BR2_PACKAGE_PYTHON_CRAYONS
	bool "python-crayons"
	help
	  This module is really simple, it gives you
	  colored strings for terminal usage.

	  https://pypi.org/project/crayons
```

## package/python-crc/Config.in
```kconfig
config BR2_PACKAGE_PYTHON_CRC
	bool "python-crc"
	help
	  Pure Python CRC library.

	  https://github.com/Nicoretti/crc
```

## package/python-crontab/Config.in
```kconfig
config BR2_PACKAGE_PYTHON_CRONTAB
	bool "python-crontab"
	depends on BR2_PACKAGE_PYTHON3 # python-dateutil -> host-python-setuptools-scm
	select BR2_PACKAGE_PYTHON_DATEUTIL # runtime
	help
	  Crontab module for reading and writing crontab files and
	  accessing the system cron automatically and simply using
	  a direct API.

	  https://gitlab.com/doctormo/python-crontab/
```

## package/python-crossbar/Config.in
```kconfig
config BR2_PACKAGE_PYTHON_CROSSBAR
	bool "python-crossbar"
	depends on BR2_PACKAGE_HOST_RUSTC_TARGET_ARCH_SUPPORTS # python-cryptography
	depends on BR2_PACKAGE_PYTHON_NUMPY_ARCH_SUPPORTS # python-numpy
	depends on BR2_TOOLCHAIN_USES_GLIBC || BR2_TOOLCHAIN_USES_MUSL # python-numpy
	depends on BR2_INSTALL_LIBSTDCPP # python-autobahn's compress and serialization
	# All the following dependencies are runtime dependencies. It
	# matches almost 1:1 the requirements-min.txt from crossbar
	# with the following exceptions:
	# - importlib-resources is in Python itself, so no external
	#   module is needed
	# - vmprof, while listed as a needed dependency, isn't
	#   actually strictly necesary
	# - wsaccel is not a direct dependency, it is there to make
	#   sure autobahn has the 'accelerate' feature, when the
	#   Python implementation is CPython, and our package does
	#   enable autobahn[accelerate]
	select BR2_PACKAGE_PYTHON_AUTOBAHN
	select BR2_PACKAGE_PYTHON_AUTOBAHN_ACCELERATE
	select BR2_PACKAGE_PYTHON_AUTOBAHN_COMPRESS
	select BR2_PACKAGE_PYTHON_AUTOBAHN_ENCRYPTION
	select BR2_PACKAGE_PYTHON_AUTOBAHN_SCRAM
	select BR2_PACKAGE_PYTHON_AUTOBAHN_SERIALIZATION
	select BR2_PACKAGE_PYTHON_AUTOBAHN_TWISTED
	select BR2_PACKAGE_PYTHON_BITSTRING
	select BR2_PACKAGE_PYTHON_CBOR
	select BR2_PACKAGE_PYTHON_CLICK
	select BR2_PACKAGE_PYTHON_COLORAMA
	select BR2_PACKAGE_PYTHON_CRYPTOGRAPHY
	select BR2_PACKAGE_PYTHON_JINJA2
	select BR2_PACKAGE_PYTHON_LMDB
	select BR2_PACKAGE_PYTHON_MARKUPSAFE
	select BR2_PACKAGE_PYTHON_MISTUNE
	select BR2_PACKAGE_PYTHON_PASSLIB
	select BR2_PACKAGE_PYTHON_PRIORITY
	select BR2_PACKAGE_PYTHON_PSUTIL
	select BR2_PACKAGE_PYTHON_PYASN1
	select BR2_PACKAGE_PYTHON_PYASN1_MODULES
	select BR2_PACKAGE_PYTHON_PYGMENTS
	select BR2_PACKAGE_PYTHON_PYNACL
	select BR2_PACKAGE_PYTHON_PYOPENSSL
	select BR2_PACKAGE_PYTHON_PYQRCODE
	select BR2_PACKAGE_PYTHON_PYTRIE
	select BR2_PACKAGE_PYTHON_PYYAML
	select BR2_PACKAGE_PYTHON_SDNOTIFY
	select BR2_PACKAGE_PYTHON_SETPROCTITLE
	select BR2_PACKAGE_PYTHON_SETUPTOOLS
	select BR2_PACKAGE_PYTHON_TREQ
	select BR2_PACKAGE_PYTHON_TWISTED
	select BR2_PACKAGE_PYTHON_TWISTED_CONCH
	select BR2_PACKAGE_PYTHON_TWISTED_HTTP2
	select BR2_PACKAGE_PYTHON_TWISTED_TLS
	select BR2_PACKAGE_PYTHON_TXAIO
	select BR2_PACKAGE_PYTHON_TXTORCON
	select BR2_PACKAGE_PYTHON_UBJSON
	select BR2_PACKAGE_PYTHON_WATCHDOG
	select BR2_PACKAGE_PYTHON_WERKZEUG
	select BR2_PACKAGE_PYTHON_ZLMDB
	select BR2_PACKAGE_PYTHON_ZOPE_INTERFACE
	help
	  Crossbar.io is an open-source WAMP application router that
	  allows to build advanced applications from loosely-coupled
	  components that can talk in real-time with each other.

	  https://pypi.python.org/pypi/crossbar

comment "python-crossbar needs a glibc or musl toolchain w/ C++"
	depends on BR2_PACKAGE_HOST_RUSTC_TARGET_ARCH_SUPPORTS
	depends on BR2_PACKAGE_PYTHON_NUMPY_ARCH_SUPPORTS
	depends on !(BR2_TOOLCHAIN_USES_GLIBC || BR2_TOOLCHAIN_USES_MUSL) || \
		!BR2_INSTALL_LIBSTDCPP
```

## package/python-cryptography/Config.in
```kconfig
config BR2_PACKAGE_PYTHON_CRYPTOGRAPHY
	bool "python-cryptography"
	depends on BR2_PACKAGE_HOST_RUSTC_TARGET_ARCH_SUPPORTS
	select BR2_PACKAGE_OPENSSL
	select BR2_PACKAGE_PYTHON_CFFI # runtime
	help
	  cryptography is a package designed to expose cryptographic
	  primitives and recipes to Python developers.

	  https://cryptography.io
```

## package/python-cssselect2/Config.in
```kconfig
config BR2_PACKAGE_PYTHON_CSSSELECT2
	bool "python-cssselect2"
	depends on BR2_PACKAGE_PYTHON3
	select BR2_PACKAGE_PYTHON_TINYCSS2 # runtime
	select BR2_PACKAGE_PYTHON_WEBENCODINGS # runtime
	help
	  CSS selectors for Python ElementTree.

	  https://doc.courtbouillon.org/cssselect2/
```

## package/python-dbus-fast/Config.in
```kconfig
config BR2_PACKAGE_PYTHON_DBUS_FAST
	bool "python-dbus-fast"
	select BR2_PACKAGE_HOST_PYTHON_CYTHON
	select BR2_PACKAGE_PYTHON3_PYEXPAT # runtime
	help
	  A faster version of dbus-next, a DBus library for Python with
	  asyncio support.

	  https://github.com/bluetooth-devices/dbus-fast
```

## package/python-dbus-next/Config.in
```kconfig
config BR2_PACKAGE_PYTHON_DBUS_NEXT
	bool "python-dbus-next"
	depends on BR2_PACKAGE_PYTHON3
	select BR2_PACKAGE_PYTHON3_PYEXPAT # runtime
	help
	  A zero-dependency DBus library for Python with asyncio
	  support.

	  https://github.com/altdesktop/python-dbus-next
```

## package/python-decorator/Config.in
```kconfig
config BR2_PACKAGE_PYTHON_DECORATOR
	bool "python-decorator"
	depends on BR2_PACKAGE_PYTHON3
	help
	  Better living through Python with decorators

	  https://github.com/micheles/decorator
```

## package/python-decouple/Config.in
```kconfig
config BR2_PACKAGE_PYTHON_DECOUPLE
	bool "python-decouple"
	help
	  Strict separation of settings from code.

	  http://github.com/henriquebastos/python-decouple/
```

## package/python-deprecation/Config.in
```kconfig
config BR2_PACKAGE_PYTHON_DEPRECATION
	bool "python-deprecation"
	help
	  A library to handle automated deprecations in Python.

	  https://pypi.org/project/deprecation/
```

## package/python-dictdiffer/Config.in
```kconfig
config BR2_PACKAGE_PYTHON_DICTDIFFER
	bool "python-dictdiffer"
	help
	  Dictdiffer is a library that helps you to diff and patch
	  dictionaries.

	  https://github.com/inveniosoftware/dictdiffer
```
