## package/quickjs/Config.in
```kconfig
config BR2_PACKAGE_QUICKJS
	bool "quickjs"
	depends on !BR2_STATIC_LIBS
	# No way to check for fenv support.
	depends on !BR2_TOOLCHAIN_USES_UCLIBC
	depends on BR2_USE_MMU # fork()
	help
	  QuickJS is a small and embeddable Javascript engine.
	  It supports the ES2020 specification including modules,
	  asynchronous generators, proxies and BigInt.

	  https://bellard.org/quickjs/

comment "quickjs needs a glibc or musl toolchain w/ dynamic library"
	depends on BR2_USE_MMU
	depends on BR2_STATIC_LIBS || BR2_TOOLCHAIN_USES_UCLIBC
```

## package/radvd/Config.in
```kconfig
config BR2_PACKAGE_RADVD
	bool "radvd"
	depends on BR2_USE_MMU # fork()
	depends on BR2_PACKAGE_LIBBSD_ARCH_SUPPORTS # libbsd
	depends on !BR2_STATIC_LIBS  # libbsd
	depends on BR2_TOOLCHAIN_HAS_THREADS  # libbsd
	depends on BR2_USE_WCHAR # libbsd
	select BR2_PACKAGE_LIBBSD
	help
	  IPv6 Router Advertisement Daemon.

	  On busybox and sysvinit systems, radvd will be started only if
	  a /etc/radvd.conf exists.

	  To enable it at build time with systemd, add /etc/radvd.conf
	  and a /etc/systemd/system-preset/40-radvd.preset file with

	    enable radvd.service

	  http://www.litech.org/radvd/
```

## package/ramspeed/Config.in
```kconfig
comment "ramspeed needs a toolchain not affected by GCC bug 43744"
	depends on BR2_TOOLCHAIN_HAS_GCC_BUG_43744

config BR2_PACKAGE_RAMSPEED
	bool "ramspeed"
	depends on !BR2_TOOLCHAIN_HAS_GCC_BUG_43744
	help
	  RAMspeed is a free open source command line utility
	  to measure cache and memory performance.

	  http://alasir.com/software/ramspeed/
```

## package/ranger/Config.in
```kconfig
config BR2_PACKAGE_RANGER
	bool "ranger"
	depends on BR2_USE_MMU # python3
	depends on BR2_USE_WCHAR # python3
	depends on BR2_TOOLCHAIN_HAS_THREADS # python3
	depends on !BR2_STATIC_LIBS # python3
	select BR2_PACKAGE_PYTHON3
	select BR2_PACKAGE_PYTHON3_CURSES
	help
	  ranger is a console file manager with VI key bindings. It
	  provides a minimalistic and nice curses interface with a
	  view on the directory hierarchy.  It ships with "rifle", a
	  file launcher that is good at automatically finding out
	  which program to use for what file type.

	  https://ranger.github.io

comment "ranger needs a toolchain w/ wchar, threads, dynamic library"
	depends on BR2_USE_MMU
	depends on !BR2_USE_WCHAR || !BR2_TOOLCHAIN_HAS_THREADS || BR2_STATIC_LIBS
```

## package/rasdaemon/Config.in
```kconfig
config BR2_PACKAGE_RASDAEMON
	bool "rasdaemon"
	depends on !BR2_STATIC_LIBS # libtraceevent
	depends on BR2_TOOLCHAIN_HAS_THREADS
	select BR2_PACKAGE_LIBTRACEEVENT
	select BR2_PACKAGE_ARGP_STANDALONE if BR2_TOOLCHAIN_USES_UCLIBC || BR2_TOOLCHAIN_USES_MUSL
	help
	  rasdaemon is a tool that collects all hardware error events
	  reported by the Linux Kernel from several sources (EDAC, MCE
	  PCI, ...) into one common framework.

	  https://github.com/mchehab/rasdaemon

if BR2_PACKAGE_RASDAEMON

config BR2_PACKAGE_RASDAEMON_AER
	bool "Enable AER support"
	select BR2_PACKAGE_PCIUTILS
	help
	  Enable handling of AER (Advanced Error Reporting) events on
	  PCIe

endif

comment "rasdaemon needs a toolchain w/ threads, dynamic library"
	depends on !BR2_TOOLCHAIN_HAS_THREADS || BR2_STATIC_LIBS
```

## package/raspi2fb/Config.in
```kconfig
config BR2_PACKAGE_RASPI2FB
	bool "raspi2fb"
	select BR2_PACKAGE_LIBBSD
	select BR2_PACKAGE_RPI_USERLAND
	help
	  Program to copy the Raspberry Pi display
	  to a secondary framebuffer.

	  https://github.com/AndrewFromMelbourne/raspi2fb
```

## package/rauc-hawkbit-updater/Config.in
```kconfig
config BR2_PACKAGE_RAUC_HAWKBIT_UPDATER
	bool "rauc-hawkbit-updater"
	depends on BR2_TOOLCHAIN_HAS_THREADS # rauc, json-glib
	depends on BR2_USE_MMU # rauc, json-glib
	depends on BR2_USE_WCHAR # rauc, json-glib
	select BR2_PACKAGE_JSON_GLIB
	select BR2_PACKAGE_LIBCURL
	# runtime
	select BR2_PACKAGE_RAUC
	help
	  rauc-hawkbit-updater is a link between Pengutronix RAUC and
	  the Eclipse Hawkbit API. Hawkbit can communicate to remote
	  update servers, and use the d-bus interface to trigger
	  updates from RAUC.

	  http://rauc.io/

comment "rauc-hawkbit-updater needs a toolchain w/ wchar, threads"
	depends on BR2_USE_MMU
	depends on !BR2_USE_WCHAR || !BR2_TOOLCHAIN_HAS_THREADS
```

## package/rbus-core/Config.in
```kconfig
config BR2_PACKAGE_RBUS_CORE
    bool "RBUS Core"
    select BR2_PACKAGE_RTMESSAGE
    select BR2_PACKAGE_MSGPACK_C
    default n
    help
       RBUS Core is for the bus communication to support TR181/TR369 and
       build on top of rtMessage, as an alternate to D-bus
```

## package/rbus/Config.in
```kconfig
config BR2_PACKAGE_RBUS
    bool "RBUS"
    select BR2_PACKAGE_RBUS_CORE
    select BR2_PACKAGE_LINENOISE
    default n
    help
       RDK Bus (RBus) is a lightweight, fast and efficient bus messaging system
```

## package/rdk-sdk/Config.in
```kconfig
config BR2_PACKAGE_RDK_SDK
	bool "rdk-sdk"
	select BR2_PACKAGE_RDK_VERSIONING
	help
	  If this flag is enabled, some of the packages will be set to
          the version as found in the currently supported RDK Yocto.

config BR2_PACKAGE_RDK_VERSIONING
	bool
```

## package/rdksplashscreen/Config.in
```kconfig
config BR2_PACKAGE_RDKSPLASHSCREEN
	bool "rdk splash screen"

	help
	   RDK bootup splash screen for devices

if BR2_PACKAGE_RDKSPLASHSCREEN

config BR2_PACKAGE_RDKSPLASHSCREEN_OPERATOR
	string "operator"
	default ""

config BR2_PACKAGE_RDKSPLASHSCREEN_URL
	string "url"
	default ""

endif
```

## package/rdma-core/Config.in
```kconfig
config BR2_PACKAGE_RDMA_CORE
	bool "rdma-core"
	depends on BR2_USE_MMU # fork() used in rstream example
	depends on BR2_TOOLCHAIN_HAS_SYNC_4
	depends on BR2_TOOLCHAIN_HEADERS_AT_LEAST_3_4  # iproute2
	depends on !BR2_STATIC_LIBS # dlopen()
	depends on BR2_TOOLCHAIN_HAS_THREADS
	select BR2_PACKAGE_IPROUTE2  # runtime
	select BR2_PACKAGE_LIBNL
	help
	  This is the userspace components for the Linux Kernel's
	  drivers/infiniband subsystem.

	  https://github.com/linux-rdma/rdma-core

comment "rdma-core needs a toolchain w/ headers >= 3.4, threads, dynamic library"
	depends on BR2_USE_MMU
	depends on BR2_TOOLCHAIN_HAS_SYNC_4
	depends on !BR2_TOOLCHAIN_HEADERS_AT_LEAST_3_4 \
		|| !BR2_TOOLCHAIN_HAS_THREADS || BR2_STATIC_LIBS
```

## package/re2/Config.in
```kconfig
config BR2_PACKAGE_RE2
	bool "re2"
	depends on BR2_PACKAGE_LIBABSEIL_CPP_ARCH_SUPPORTS
	depends on BR2_INSTALL_LIBSTDCPP
	depends on BR2_TOOLCHAIN_GCC_AT_LEAST_8 # C++14
	depends on BR2_TOOLCHAIN_HAS_THREADS
	depends on !BR2_STATIC_LIBS # libabseil-cpp
	select BR2_PACKAGE_LIBABSEIL_CPP
	help
	  RE2 is a fast, safe, thread-friendly alternative
	  to backtracking regular expression engines like
	  those used in PCRE, Perl, and Python.
	  It is a C++ library.

	  https://github.com/google/re2

comment "re2 needs a toolchain w/ C++, threads, dynamic library, gcc >= 8"
	depends on BR2_PACKAGE_LIBABSEIL_CPP_ARCH_SUPPORTS
	depends on !BR2_INSTALL_LIBSTDCPP || \
		!BR2_TOOLCHAIN_HAS_THREADS || \
		BR2_STATIC_LIBS || !BR2_TOOLCHAIN_GCC_AT_LEAST_8
```

## package/redis-plus-plus/Config.in
```kconfig
config BR2_PACKAGE_REDIS_PLUS_PLUS
	bool "redis-plus-plus"
	depends on BR2_INSTALL_LIBSTDCPP
	select BR2_PACKAGE_HIREDIS
	help
	  Redis client written in C++

	  This is a C++ client library for Redis.
	  It's based on hiredis, and is compatible
	  with C++ 17, C++ 14, and C++ 11.

	  https://github.com/sewenew/redis-plus-plus

comment "redis-plus-plus needs a toolchain w/ C++"
	depends on !BR2_INSTALL_LIBSTDCPP
```

## package/refpolicy/Config.in
```kconfig
config BR2_PACKAGE_REFPOLICY
	bool "refpolicy"
	depends on BR2_TOOLCHAIN_HAS_THREADS # libsepol
	# Even though libsepol is not necessary for building, we get
	# the policy version from libsepol, so we select it, and treat
	# it like a runtime dependency.
	select BR2_PACKAGE_LIBSEPOL
	help
	  The SELinux Reference Policy project (refpolicy) is a
	  complete SELinux policy that can be used as the system
	  policy for a variety of systems and used as the basis for
	  creating other policies. Reference Policy was originally
	  based on the NSA example policy, but aims to accomplish many
	  additional goals.

	  The current refpolicy does not fully support Buildroot and
	  needs modifications to work with the default system file
	  layout. These changes should be added as patches to the
	  refpolicy that modify a single SELinux policy.

	  The refpolicy works for the most part in permissive
	  mode. Only the basic set of utilities are enabled in the
	  example policy config and some of the pathing in the
	  policies is not correct.  Individual policies would need to
	  be tweaked to get everything functioning properly.

	  https://github.com/TresysTechnology/refpolicy

if BR2_PACKAGE_REFPOLICY

choice
	prompt "SELinux default state"
	default BR2_PACKAGE_REFPOLICY_POLICY_STATE_PERMISSIVE

config BR2_PACKAGE_REFPOLICY_POLICY_STATE_ENFORCING
	bool "Enforcing"
	help
	  SELinux security policy is enforced

config BR2_PACKAGE_REFPOLICY_POLICY_STATE_PERMISSIVE
	bool "Permissive"
	help
	  SELinux prints warnings instead of enforcing

config BR2_PACKAGE_REFPOLICY_POLICY_STATE_DISABLED
	bool "Disabled"
	help
	  No SELinux policy is loaded
endchoice

config BR2_PACKAGE_REFPOLICY_POLICY_STATE
	string
	default "permissive" if BR2_PACKAGE_REFPOLICY_POLICY_STATE_PERMISSIVE
	default "enforcing" if BR2_PACKAGE_REFPOLICY_POLICY_STATE_ENFORCING
	default "disabled" if BR2_PACKAGE_REFPOLICY_POLICY_STATE_DISABLED

config BR2_REFPOLICY_EXTRA_MODULES_DIRS
	string "Extra modules directories"
	help
	  Specify a space-separated list of directories containing
	  SELinux modules that will be built into the SELinux
	  policy. The modules will be automatically enabled in the
	  policy.

	  Each of those directories must contain the SELinux policy
	  .fc, .if and .te files directly at the top-level, with no
	  sub-directories. Also, you cannot have several modules with
	  the same name in different directories.

config BR2_REFPOLICY_EXTRA_MODULES
	string "Extra modules to enable"
	help
	  List of extra SELinux modules to enable in the refpolicy.

endif

comment "refpolicy needs a toolchain w/ threads"
	depends on !BR2_TOOLCHAIN_HAS_THREADS
```

## package/reproc/Config.in
```kconfig
config BR2_PACKAGE_REPROC
	bool "reproc"
	depends on BR2_USE_MMU # fork()
	depends on BR2_USE_WCHAR # uses wchar_t
	depends on BR2_TOOLCHAIN_HAS_THREADS # pthread
	help
	  reproc is a cross-platform C/C++ library that simplifies
	  starting, stopping and communicating with external programs.

	  https://github.com/DaanDeMeyer/reproc

comment "reproc needs a toolchain w/ threads, wchar"
	depends on BR2_USE_MMU
	depends on !BR2_USE_WCHAR || !BR2_TOOLCHAIN_HAS_THREADS
```

## package/reterminal_camera/Config.in
```kconfig
config BR2_PACKAGE_RETERMINAL_CAMERA
	bool "camera test use v4l2 for seeed reterminal"
```

## package/reterminal_qt5_demo/Config.in
```kconfig
config BR2_PACKAGE_RETERMINAL_QT5_DEMO
	bool"PYQT5 demo"
	help
	  seeed reTerminal QT5 demo
```

## package/riemann-c-client/Config.in
```kconfig
config BR2_PACKAGE_RIEMANN_C_CLIENT
	bool "riemann-c-client"
	depends on BR2_INSTALL_LIBSTDCPP # protobuf-c
	depends on BR2_TOOLCHAIN_HAS_THREADS # protobuf-c
	depends on BR2_PACKAGE_HOST_PROTOBUF_ARCH_SUPPORTS # protobuf-c
	depends on BR2_HOST_GCC_AT_LEAST_7 # protobuf-c
	select BR2_PACKAGE_PROTOBUF_C
	help
	  Riemann-c-client is a C client library for the Riemann
	  monitoring system, providing a convenient and simple API,
	  high test coverage and a copyleft license, along with API
	  and ABI stability.

	  https://github.com/algernon/riemann-c-client

comment "riemann-c-client needs a toolchain w/ C++, threads, host gcc >= 7"
	depends on !BR2_INSTALL_LIBSTDCPP || !BR2_TOOLCHAIN_HAS_THREADS || \
		!BR2_HOST_GCC_AT_LEAST_7
	depends on BR2_PACKAGE_HOST_PROTOBUF_ARCH_SUPPORTS
```

## package/riscv-isa-sim/Config.in.host
```kconfig
config BR2_PACKAGE_HOST_RISCV_ISA_SIM
	bool "host riscv-isa-sim"
	depends on BR2_HOST_GCC_AT_LEAST_4_9 # C++11
	help
	  Spike, the RISC-V ISA Simulator, implements a functional
	  model of one or more RISC-V harts.

	  The host package provides an alternative solution to qemu.

	  https://github.com/riscv-software-src/riscv-isa-sim

comment "host riscv-isa-sim needs host gcc >= 4.9"
	depends on !BR2_HOST_GCC_AT_LEAST_4_9
```

## package/rlwrap/Config.in
```kconfig
config BR2_PACKAGE_RLWRAP
	bool "rlwrap"
	depends on BR2_USE_MMU # fork()
	select BR2_PACKAGE_READLINE
	help
	  rlwrap is a 'readline wrapper', a small utility that uses the
	  GNU Readline library to allow the editing of keyboard input
	  for any command.

	  https://github.com/hanslub42/rlwrap

if BR2_PACKAGE_RLWRAP

config BR2_PACKAGE_RLWRAP_SPY_ON_READLINE
	bool "spy on readline"
	default y
	help
	  If we want to keep the display tidy when re-sizing the
	  terminal window or printing multi-line prompts, we have to
	  know whether or not readline is in horizontal-scroll-mode
	  (i.e. wheter long lines are scrolled or wrapped). At present,
	  this involves a look at a private readline variable - if you
	  feel guilty about that, disable this option

config BR2_PACKAGE_RLWRAP_HOMEGROWN_REDISPLAY
	bool "homegrown redisplay"
	help
	  Some people report double echoing of user input. Enabling this
	  option will cure the problem - though the display will then
	  flicker over slow connections (cf. BUGS)

config BR2_PACKAGE_RLWRAP_MULTIBYTE_AWARE
	bool "multibyte awareness"
	default y
	depends on BR2_USE_WCHAR
	help
	  Prevent rlwrap from seeing multibyte characters as multiple
	  characters

comment "rlwrap multibyte awareness needs a toolchain w/ wchar"
	depends on !BR2_USE_WCHAR

endif
```

## package/rng-tools/Config.in
```kconfig
config BR2_PACKAGE_RNG_TOOLS
	bool "rng-tools"
	# pthread_setaffinity_np
	depends on BR2_TOOLCHAIN_HAS_THREADS_NPTL
	depends on BR2_USE_MMU # libcap
	select BR2_PACKAGE_ARGP_STANDALONE if BR2_TOOLCHAIN_USES_UCLIBC || BR2_TOOLCHAIN_USES_MUSL
	select BR2_PACKAGE_LIBCAP
	select BR2_PACKAGE_OPENSSL
	help
	  Daemon to use hardware random number generators.

	  https://github.com/nhorman/rng-tools

if BR2_PACKAGE_RNG_TOOLS

config BR2_PACKAGE_RNG_TOOLS_JITTERENTROPY_LIBRARY
	bool "Jitterentropy Library support"
	default y
	select BR2_PACKAGE_JITTERENTROPY_LIBRARY
	help
	  Enable Jitterentropy Library support.

	  The Jitter RNG provides a noise source using the CPU
	  execution timing jitter. It does not depend on any
	  system resource other than a high-resolution time stamp.

config BR2_PACKAGE_RNG_TOOLS_NISTBEACON
	bool "NIST Entropy Beacon support"
	select BR2_PACKAGE_JANSSON
	select BR2_PACKAGE_LIBCURL
	select BR2_PACKAGE_LIBXML2
	help
	  Enable NIST Entropy Beacon support.

	  Entropy gathered from the NIST network entropy beacon. Note
	  that this entropy source is disabled by default as it should
	  never be used for cryptographic purposes, or any use case in
	  which random data should be known only by a single entity.

config BR2_PACKAGE_RNG_TOOLS_QRYPT
	bool "Qrypt Entropy Beacon support"
	select BR2_PACKAGE_JANSSON
	select BR2_PACKAGE_LIBCURL
	help
	  Enable Qrypt NIST-Beacon like entropy support.

	  Entropy gathered from Qrypt server based entropy beacons. Like
	  NIST, it should likely not be used directly in cryptographic
	  operation, as the entropy may be intercepted over a network,
	  but can provide copius amounts of entropy for non-crypto
	  purposes.

endif

comment "rng-tools needs a toolchain w/ NPTL"
	depends on BR2_USE_MMU
	depends on !BR2_TOOLCHAIN_HAS_THREADS_NPTL
```

## package/rnnoise/Config.in
```kconfig
config BR2_PACKAGE_RNNOISE
	bool "rnnoise"
	help
	  RNNoise is a noise suppression library based on a recurrent
	  neural network.

	  https://github.com/xiph/rnnoise/
```
