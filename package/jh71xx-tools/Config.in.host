## package/jh71xx-tools/Config.in.host
```kconfig
config BR2_PACKAGE_HOST_JH71XX_TOOLS
	bool "host jh71xx-tools"
	depends on BR2_riscv
	help
	  Bootloader recovery and updater tool for StarFive JH7100 SoCs.

	  https://github.com/kprasadvnsi/JH71xx-tools
```

## package/jitterentropy-library/Config.in
```kconfig
config BR2_PACKAGE_JITTERENTROPY_LIBRARY
	bool "libjitterentropy"
	depends on BR2_TOOLCHAIN_HAS_THREADS
	help
	  Hardware RNG based on CPU timing jitter.

	  https://github.com/smuellerDD/jitterentropy-library

comment "libjitterentropy needs a toolchain w/ threads"
	depends on !BR2_TOOLCHAIN_HAS_THREADS
```

## package/k3conf/Config.in
```kconfig
config BR2_PACKAGE_K3CONF
	bool "k3conf"
	depends on BR2_aarch64
	help
	  k3conf is a Linux user-space standalone application designed
	  to provide a quick'n easy way to dynamically diagnose Texas
	  Instruments' K3 architecture based processors.

	  k3conf currently supports Texas Instruments AM654, J721E,
	  J7200, AM64x, AM62x, J721S2, J784S4, J722S, AM62Ax, AM62Px,
	  and AM62Lx devices. Along with the BeagleBoard variants of
	  the above mentioned TI SOC's.

	  https://git.ti.com/cgit/k3conf/k3conf
```

## package/kernel_module/Config.in
```kconfig
config BR2_PACKAGE_KERNEL_MODULE
        bool "kernel_module of seeed reterminal"
        depends on BR2_LINUX_KERNEL
	depends on BR2_PACKAGE_DTC_PROGRAMS
```

## package/kexec-lite/Config.in
```kconfig
config BR2_PACKAGE_KEXEC_LITE_ARCH_SUPPORTS
	bool
	default y
	depends on BR2_powerpc || BR2_powerpc64 || BR2_powerpc64le

config BR2_PACKAGE_KEXEC_LITE
	bool "kexec-lite"
	depends on BR2_PACKAGE_KEXEC_LITE_ARCH_SUPPORTS
	depends on !BR2_STATIC_LIBS # dtc, elfutils
	depends on BR2_USE_WCHAR # elfutils
	depends on BR2_TOOLCHAIN_HAS_THREADS # elfutils
	select BR2_PACKAGE_ELFUTILS
	select BR2_PACKAGE_DTC
	select BR2_PACKAGE_DTC_PROGRAMS
	help
	  Kexec is a user space utility for loading another kernel
	  and asking the currently running kernel to do something with
	  it.

	  This package is a tiny implementation of the kexec userspace
	  components, for devicetree-based platforms.

	  https://github.com/antonblanchard/kexec-lite

comment "kexec-lite needs a toolchain w/ wchar, dynamic library, threads"
	depends on BR2_PACKAGE_KEXEC_LITE_ARCH_SUPPORTS
	depends on BR2_STATIC_LIBS || !BR2_USE_WCHAR \
		|| !BR2_TOOLCHAIN_HAS_THREADS
```

## package/kexec/Config.in
```kconfig
config BR2_PACKAGE_KEXEC_ARCH_SUPPORTS
	bool
	default y
	depends on BR2_i386 || BR2_x86_64 || BR2_arm || BR2_armeb || \
		BR2_mips || BR2_mips64 || BR2_mipsel || BR2_mips64el || \
		BR2_powerpc || BR2_powerpc64 || BR2_powerpc64le || \
		BR2_sh4 || BR2_sh4a || BR2_aarch64 || BR2_s390x || BR2_m68k

config BR2_PACKAGE_KEXEC
	bool "kexec"
	depends on BR2_PACKAGE_KEXEC_ARCH_SUPPORTS
	depends on BR2_TOOLCHAIN_HEADERS_AT_LEAST_3_17 # memfd_create()
	help
	  Kexec is a user space utility for loading another kernel
	  and asking the currently running kernel to do something with
	  it.

	  https://www.kernel.org/pub/linux/utils/kernel/kexec/

if BR2_PACKAGE_KEXEC

config BR2_PACKAGE_KEXEC_ZLIB
	bool "zlib support"
	select BR2_PACKAGE_ZLIB
	help
	  Support for compressed kernel images

endif

comment "kexec needs a toolchain w/ headers >= 3.17"
	depends on BR2_PACKAGE_KEXEC_ARCH_SUPPORTS
	depends on !BR2_TOOLCHAIN_HEADERS_AT_LEAST_3_17
```

## package/kibi/Config.in
```kconfig
config BR2_PACKAGE_KIBI
	bool "kibi"
	depends on BR2_PACKAGE_HOST_RUSTC_TARGET_ARCH_SUPPORTS
	select BR2_PACKAGE_HOST_RUSTC
	help
	  A configurable text editor with UTF-8 support, incremental
	  search, syntax highlighting, line numbers and more, written
	  in less than 1024 lines of Rust with minimal dependencies.

	  https://github.com/ilai-deutel/kibi

if BR2_PACKAGE_KIBI

config BR2_PACKAGE_KIBI_SYNTAX_HIGHLIGHTING
	bool "syntax highlighting"
	default y
	help
	  Install files to enable syntax highlighting. This option adds
	  200 KB of data to /usr/share/

endif
```

## package/kismet/Config.in
```kconfig
comment "kismet needs a toolchain w/ threads, C++"
	depends on BR2_USE_MMU
	depends on !BR2_INSTALL_LIBSTDCPP || !BR2_TOOLCHAIN_HAS_THREADS
	depends on BR2_HOSTARCH = "x86_64" || BR2_HOSTARCH = "x86"

config BR2_PACKAGE_KISMET
	bool "kismet"
	depends on BR2_INSTALL_LIBSTDCPP
	depends on BR2_TOOLCHAIN_HAS_THREADS
	depends on BR2_USE_MMU # fork()
	depends on BR2_HOSTARCH = "x86_64" || BR2_HOSTARCH = "x86" # protobuf-c
	select BR2_PACKAGE_LIBPCAP
	select BR2_PACKAGE_PROTOBUF_C
	select BR2_PACKAGE_SQLITE
	select BR2_PACKAGE_ZLIB
	help
	  Kismet is a wireless network and device detector, sniffer,
	  wardriving tool, and WIDS (wireless intrusion detection)
	  framework.

	  Kismet works with Wi-Fi interfaces, Bluetooth interfaces, some
	  SDR (software defined radio) hardware like the RTLSDR, and
	  other specialized capture hardware.

	  http://www.kismetwireless.net

if BR2_PACKAGE_KISMET

config BR2_PACKAGE_KISMET_SERVER
	bool "Install server"
	default y
	depends on BR2_PACKAGE_PROTOBUF_ARCH_SUPPORTS # protobuf
	depends on !BR2_STATIC_LIBS # dlfcn.h
	depends on BR2_TOOLCHAIN_GCC_AT_LEAST_4_8 # protobuf
	depends on !BR2_TOOLCHAIN_HAS_GCC_BUG_64735 # std::future
	select BR2_PACKAGE_LIBMICROHTTPD
	select BR2_PACKAGE_PROTOBUF

comment "server needs a toolchain w/ dynamic library, gcc >= 4.8"
	depends on BR2_PACKAGE_PROTOBUF_ARCH_SUPPORTS
	depends on !BR2_TOOLCHAIN_HAS_GCC_BUG_64735
	depends on BR2_STATIC_LIBS || !BR2_TOOLCHAIN_GCC_AT_LEAST_4_8

comment "server needs a toolchain not affected by GCC bug 64735"
	depends on BR2_TOOLCHAIN_HAS_GCC_BUG_64735

endif
```

## package/kmemd/Config.in
```kconfig
config BR2_PACKAGE_KMEMD
	bool "kmemd"
	depends on BR2_TOOLCHAIN_HAS_SYNC_4 # libbpf
	depends on BR2_USE_WCHAR # libbpf
	depends on !BR2_STATIC_LIBS # libbpf
	depends on BR2_TOOLCHAIN_HAS_THREADS # libbpf
	depends on BR2_TOOLCHAIN_HEADERS_AT_LEAST_5_14
	depends on BR2_TOOLCHAIN_USES_UCLIBC || BR2_TOOLCHAIN_USES_GLIBC # libbpf
	select BR2_PACKAGE_LIBBPF
	help
	  Explore a live Linux kernel's memory using GDB

	  https://github.com/wkz/kmemd

comment "kmemd needs a uClibc or glibc toolchain w/ wchar, dynamic library, threads, headers >= 5.14"
	depends on BR2_TOOLCHAIN_HAS_SYNC_4
	depends on !BR2_USE_WCHAR || BR2_STATIC_LIBS \
		|| !BR2_TOOLCHAIN_HAS_THREADS \
		|| !BR2_TOOLCHAIN_HEADERS_AT_LEAST_4_13 \
		|| !(BR2_TOOLCHAIN_USES_UCLIBC || BR2_TOOLCHAIN_USES_GLIBC)
```

## package/kmod/Config.in.host
```kconfig
config BR2_PACKAGE_HOST_KMOD
	bool "host kmod"
	help
	  kmod is a set of tools to handle common tasks with Linux
	  kernel modules like insert, remove, list, check properties,
	  resolve dependencies and aliases.
```

## package/kmon/Config.in
```kconfig
config BR2_PACKAGE_KMON
	bool "kmon"
	depends on BR2_PACKAGE_HOST_RUSTC_TARGET_ARCH_SUPPORTS
	select BR2_PACKAGE_HOST_RUSTC
	help
	  kmon provides a terminal UI for managing kernel modules
	  and monitoring kernel activities.

	  https://github.com/orhun/kmon
```

## package/kmscube/Config.in
```kconfig
config BR2_PACKAGE_KMSCUBE
	bool "kmscube"
	depends on BR2_PACKAGE_HAS_LIBEGL
	depends on BR2_PACKAGE_HAS_LIBGBM
	depends on BR2_PACKAGE_LIBGBM_HAS_FEATURE_FORMAT_MODIFIER_PLANE_COUNT
	depends on BR2_PACKAGE_HAS_LIBGLES
	depends on BR2_TOOLCHAIN_HAS_THREADS # libdrm
	select BR2_PACKAGE_LIBDRM
	help
	  kmscube is an application to test kms/drm drivers.

	  https://cgit.freedesktop.org/mesa/kmscube/

if BR2_PACKAGE_KMSCUBE

config BR2_PACKAGE_KMSCUBE_GSTREAMER
	bool "Enable gstreamer video support"
	depends on BR2_USE_WCHAR # glib2
	depends on BR2_TOOLCHAIN_HAS_THREADS # glib2
	depends on BR2_USE_MMU # glib2
	select BR2_PACKAGE_LIBGLIB2
	select BR2_PACKAGE_GST1_PLUGINS_BASE
	select BR2_PACKAGE_GST1_PLUGINS_BASE_PLUGIN_APP
	select BR2_PACKAGE_GSTREAMER1

endif

comment "kmscube needs EGL, GBM and OpenGL ES, and a toolchain w/ thread support"
	depends on \
		!BR2_PACKAGE_HAS_LIBEGL || \
		!BR2_PACKAGE_HAS_LIBGBM || \
		!BR2_PACKAGE_LIBGBM_HAS_FEATURE_FORMAT_MODIFIER_PLANE_COUNT || \
		!BR2_PACKAGE_HAS_LIBGLES || \
		!BR2_TOOLCHAIN_HAS_THREADS
```

## package/knock/Config.in
```kconfig
config BR2_PACKAGE_KNOCK
	bool "knock"
	help
	  A port knocking implementation.
	  Provides a daemon and a user application. Port knocking can be
	  used to run an arbitrary application, once the daemon detects
	  a predefined sequence of incoming TCP/UDP packets on a network
	  interface. This can be used, e.g. to open up ports in a
	  firewall.

	  http://www.zeroflux.org/projects/knock

if BR2_PACKAGE_KNOCK

config BR2_PACKAGE_KNOCK_KNOCKD
	bool "knockd"
	default y
	depends on BR2_USE_MMU # fork()
	select BR2_PACKAGE_LIBPCAP
	help
	  Enable knockd

endif
```

## package/kodi-imagedecoder-heif/Config.in
```kconfig
config BR2_PACKAGE_KODI_IMAGEDECODER_HEIF
	bool "kodi-imagedecoder-heif"
	depends on BR2_INSTALL_LIBSTDCPP # libde265, libheif, tinyxml2
	depends on BR2_TOOLCHAIN_HAS_THREADS # libde265, libheif
	depends on !BR2_TOOLCHAIN_HAS_BINUTILS_BUG_30730 # libheif
	depends on BR2_TOOLCHAIN_GCC_AT_LEAST_4_8 # libheif
	select BR2_PACKAGE_LIBDE265
	select BR2_PACKAGE_LIBHEIF
	select BR2_PACKAGE_TINYXML2
	help
	  HEIF image decoder add-on for Kodi

	  https://github.com/xbmc/imagedecoder.heif

comment "kodi-imagedecoder-heif needs a toolchain w/ C++, threads, gcc >= 4.8"
	depends on !BR2_TOOLCHAIN_HAS_BINUTILS_BUG_30730 # libheif
	depends on !BR2_INSTALL_LIBSTDCPP || !BR2_TOOLCHAIN_HAS_THREADS || \
		!BR2_TOOLCHAIN_GCC_AT_LEAST_4_8
```

## package/kodi-imagedecoder-raw/Config.in
```kconfig
config BR2_PACKAGE_KODI_IMAGEDECODER_RAW
	bool "kodi-imagedecoder-raw"
	depends on BR2_TOOLCHAIN_HAS_SYNC_4
	depends on BR2_INSTALL_LIBSTDCPP
	select BR2_PACKAGE_JPEG
	select BR2_PACKAGE_LCMS2
	select BR2_PACKAGE_LIBRAW
	help
	  RAW image decoder add-on for Kodi

	  https://github.com/xbmc/imagedecoder.raw

comment "kodi-imagedecoder-raw needs a toolchain w/ C++"
	depends on BR2_TOOLCHAIN_HAS_SYNC_4
	depends on !BR2_INSTALL_LIBSTDCPP
```

## package/kodi-inputstream-ffmpegdirect/Config.in
```kconfig
config BR2_PACKAGE_KODI_INPUTSTREAM_FFMPEGDIRECT
	bool "kodi-inputstream-ffmpegdirect"
	depends on BR2_PACKAGE_FFMPEG_ARCH_SUPPORTS
	select BR2_PACKAGE_BZIP2
	select BR2_PACKAGE_FFMPEG
	select BR2_PACKAGE_FFMPEG_GPL
	select BR2_PACKAGE_FFMPEG_POSTPROC
	help
	  This is a Kodi input stream addon for streams that can be
	  opened by FFmpeg's libavformat, such as plain TS, HLS and
	  DASH streams.

	  https://github.com/xbmc/inputstream.ffmpegdirect
```

## package/kodi-inputstream-rtmp/Config.in
```kconfig
config BR2_PACKAGE_KODI_INPUTSTREAM_RTMP
	bool "kodi-inputstream-rtmp"
	select BR2_PACKAGE_OPENSSL
	select BR2_PACKAGE_RTMPDUMP
	select BR2_PACKAGE_ZLIB
	help
	  RTMP input stream add-on for Kodi

	  https://github.com/xbmc/inputstream.rtmp
```

## package/kodi-pvr-dvbviewer/Config.in
```kconfig
config BR2_PACKAGE_KODI_PVR_DVBVIEWER
	bool "kodi-pvr-dvbviewer"
	select BR2_PACKAGE_TINYXML
	help
	  Kodi's DVBViewer client addon

	  https://github.com/kodi-pvr/pvr.dvbviewer
```

## package/kodi-pvr-filmon/Config.in
```kconfig
config BR2_PACKAGE_KODI_PVR_FILMON
	bool "kodi-pvr-filmon"
	select BR2_PACKAGE_JSONCPP
	help
	  Filmon PVR client addon for Kodi

	  https://github.com/kodi-pvr/pvr.filmon
```

## package/kodi-pvr-hts/Config.in
```kconfig
config BR2_PACKAGE_KODI_PVR_HTS
	bool "kodi-pvr-hts"
	depends on BR2_TOOLCHAIN_GCC_AT_LEAST_7 # C++17
	help
	  Tvheadend HTSP PVR client addon for Kodi

	  https://github.com/kodi-pvr/pvr.hts

comment "kodi-pvr-hts needs a toolchain w/ gcc >= 7"
	depends on !BR2_TOOLCHAIN_GCC_AT_LEAST_7
```

## package/kodi-pvr-iptvsimple/Config.in
```kconfig
config BR2_PACKAGE_KODI_PVR_IPTVSIMPLE
	bool "kodi-pvr-iptvsimple"
	# kodi-inputstream-adaptive
	depends on BR2_aarch64 || BR2_arm || BR2_i386 || BR2_mipsel \
		|| BR2_mips64el || BR2_x86_64
	select BR2_PACKAGE_KODI_INPUTSTREAM_ADAPTIVE # runtime
	select BR2_PACKAGE_KODI_INPUTSTREAM_FFMPEGDIRECT # runtime
	select BR2_PACKAGE_KODI_INPUTSTREAM_RTMP # runtime
	select BR2_PACKAGE_PUGIXML
	select BR2_PACKAGE_XZ
	select BR2_PACKAGE_ZLIB
	help
	  IPTV Live TV and Radio PVR client addon for Kodi

	  https://github.com/kodi-pvr/pvr.iptvsimple
```

## package/kodi-pvr-mythtv/Config.in
```kconfig
config BR2_PACKAGE_KODI_PVR_MYTHTV
	bool "kodi-pvr-mythtv"
	help
	  MythTV PVR for Kodi

	  https://github.com/kodi-pvr/pvr.mythtv
```

## package/kodi-pvr-pctv/Config.in
```kconfig
config BR2_PACKAGE_KODI_PVR_PCTV
	bool "kodi-pvr-pctv"
	select BR2_PACKAGE_JSONCPP
	help
	  PCTV PVR client addon for Kodi

	  https://github.com/kodi-pvr/pvr.vdr.vnsi
```

## package/kodi-pvr-plutotv/Config.in
```kconfig
config BR2_PACKAGE_KODI_PVR_PLUTOTV
	bool "kodi-pvr-plutotv"
	select BR2_PACKAGE_JSON_FOR_MODERN_CPP
	help
	  Pluto.tv PVR Client for Kodi

	  https://github.com/kodi-pvr/pvr.plutotv
```

## package/kodi-pvr-vdr-vnsi/Config.in
```kconfig
config BR2_PACKAGE_KODI_PVR_VDR_VNSI
	bool "kodi-pvr-vdr-vnsi"
	depends on BR2_TOOLCHAIN_GCC_AT_LEAST_7 # C++17
	help
	  Kodi PVR addon VNSI

	  https://github.com/kodi-pvr/pvr.vdr.vnsi

comment "kodi-pvr-vdr-vnsi needs a toolchain w/ gcc >= 7"
	depends on !BR2_TOOLCHAIN_GCC_AT_LEAST_7
```
