## package/xfsprogs/Config.in
```kconfig
comment "xfsprogs needs a toolchain w/ threads, C++"
	depends on BR2_PACKAGE_LIBURCU_ARCH_SUPPORTS
	depends on BR2_USE_MMU
	depends on !BR2_TOOLCHAIN_HAS_THREADS || \
		!BR2_INSTALL_LIBSTDCPP

config BR2_PACKAGE_XFSPROGS
	bool "xfsprogs"
	depends on BR2_PACKAGE_LIBURCU_ARCH_SUPPORTS
	depends on BR2_USE_MMU # fork()
	depends on BR2_TOOLCHAIN_HAS_THREADS
	depends on BR2_INSTALL_LIBSTDCPP # liburcu
	select BR2_PACKAGE_INIH
	select BR2_PACKAGE_LIBURCU
	select BR2_PACKAGE_UTIL_LINUX
	select BR2_PACKAGE_UTIL_LINUX_LIBUUID
	select BR2_PACKAGE_UTIL_LINUX_LIBBLKID
	help
	  The XFS file system utilities and libraries

	  https://xfs.wiki.kernel.org
```

## package/xfsprogs/Config.in.host
```kconfig
config BR2_PACKAGE_HOST_XFSPROGS
	bool "host xfsprogs"
	help
	  The XFS file system utilities and libraries

	  https://xfs.wiki.kernel.org
```

## package/xilinx-fpgautil/Config.in
```kconfig
config BR2_PACKAGE_XILINX_FPGAUTIL
	bool "xilinx-fpgautil"
	depends on BR2_arm || BR2_aarch64
	help
	  Xilinx FPGA Manager Utility for zynq, zynqmp
	  and versal products.

	  https://github.com/Xilinx/meta-xilinx/blob/master/meta-xilinx-core/recipes-bsp/fpga-manager-script/files/fpgautil.c
```

## package/xinetd/Config.in
```kconfig
config BR2_PACKAGE_XINETD
	bool "xinetd"
	depends on BR2_USE_MMU # fork()
	depends on !BR2_TOOLCHAIN_USES_UCLIBC # no ecvt/fcvt
	help
	  xinetd is a secure replacement for inetd. It was originally
	  written by panos@cs.colorado.edu.

	  https://github.com/openSUSE/xinetd

comment "xinetd needs a glibc or musl toolchain"
	depends on BR2_USE_MMU
	depends on BR2_TOOLCHAIN_USES_UCLIBC
```

## package/xione-sdk/Config.in
```kconfig
config BR2_PACKAGE_XIONE_SDK
	bool "xione-sdk"
	depends on BR2_arm
	select BR2_PACKAGE_HAS_SDK
	select BR2_PACKAGE_HAS_LIBEGL
	select BR2_PACKAGE_HAS_LIBGLES
	select BR2_PACKAGE_HAS_PLAYREADY
	select BR2_PACKAGE_HAS_WIDEVINE
	help
	  Pre-compiled binaries for a platform

if BR2_PACKAGE_XIONE_SDK

config BR2_PACKAGE_PROVIDES_LIBEGL
	default "xione-sdk"

config BR2_PACKAGE_PROVIDES_LIBGLES
	default "xione-sdk"

config BR2_PACKAGE_SDK_INSTALL
        string 
	default "xione-sdk"

endif
```

## package/xml-security-c/Config.in
```kconfig
config BR2_PACKAGE_XML_SECURITY_C
	bool "xml-security-c"
	depends on BR2_INSTALL_LIBSTDCPP # xerces
	depends on !BR2_STATIC_LIBS # xerces
	depends on BR2_USE_WCHAR # xerces
	depends on BR2_TOOLCHAIN_GCC_AT_LEAST_4_7 # C++11
	select BR2_PACKAGE_LIBOPENSSL_ENABLE_DES if BR2_PACKAGE_LIBOPENSSL
	select BR2_PACKAGE_OPENSSL
	select BR2_PACKAGE_XERCES
	help
	  The xml-security-c library is a C++ implementation of
	  the XML Digital Signature and Encryption specifications.

	  https://santuario.apache.org/cindex.html

comment "xml-security-c needs a toolchain w/ C++, wchar, dynamic library, gcc >= 4.7"
	depends on !BR2_INSTALL_LIBSTDCPP || !BR2_USE_WCHAR || \
		BR2_STATIC_LIBS || !BR2_TOOLCHAIN_GCC_AT_LEAST_4_7
```

## package/xmrig/Config.in
```kconfig
# archs officially supported by upstream
config BR2_PACKAGE_XMRIG_ARCH_SUPPORTS
	bool
	default y if BR2_ARM_CPU_ARMV7A
	default y if BR2_aarch64
	default y if BR2_x86_64
	default y if BR2_i386

config BR2_PACKAGE_XMRIG
	bool "xmrig"
	depends on BR2_PACKAGE_XMRIG_ARCH_SUPPORTS
	depends on BR2_USE_MMU # libuv
	depends on BR2_TOOLCHAIN_HAS_SYNC_4 # libuv
	depends on BR2_TOOLCHAIN_HAS_THREADS_NPTL # libuv
	# xmrig needs fenv.h which is not provided by uclibc
	depends on !BR2_TOOLCHAIN_USES_UCLIBC
	depends on !BR2_STATIC_LIBS # libuv
	depends on BR2_TOOLCHAIN_GCC_AT_LEAST_4_9 # libuv
	depends on BR2_INSTALL_LIBSTDCPP
	select BR2_PACKAGE_LIBUV
	help
	  RandomX, CryptoNight, AstroBWT and Argon2 CPU/GPU miner.

	  https://xmrig.com

comment "xmrig needs a glibc or musl toolchain w/ NPTL, dynamic library, C++, gcc >= 4.9"
	depends on BR2_PACKAGE_XMRIG_ARCH_SUPPORTS
	depends on BR2_USE_MMU
	depends on BR2_TOOLCHAIN_HAS_SYNC_4
	depends on !BR2_TOOLCHAIN_HAS_THREADS_NPTL || \
		BR2_TOOLCHAIN_USES_UCLIBC || BR2_STATIC_LIBS || \
		!BR2_INSTALL_LIBSTDCPP || \
		!BR2_TOOLCHAIN_GCC_AT_LEAST_4_9
```

## package/xnnpack/Config.in
```kconfig
config BR2_PACKAGE_XNNPACK_ARCH_SUPPORTS
	bool
	default y if BR2_i386
	default y if BR2_x86_64
	depends on BR2_PACKAGE_CPUINFO_ARCH_SUPPORTS

config BR2_PACKAGE_XNNPACK
	bool "xnnpack"
	depends on BR2_PACKAGE_XNNPACK_ARCH_SUPPORTS
	depends on BR2_INSTALL_LIBSTDCPP
	depends on BR2_TOOLCHAIN_GCC_AT_LEAST_4_9 # C++14
	depends on BR2_TOOLCHAIN_HAS_THREADS # cpuinfo, pthreadpool
	select BR2_PACKAGE_CPUINFO
	select BR2_PACKAGE_FP16
	select BR2_PACKAGE_FXDIV
	select BR2_PACKAGE_PTHREADPOOL
	help
	  XNNPACK is a highly optimized solution for neural network
	  inference on ARM, x86, WebAssembly, and RISC-V platforms.

	  https://github.com/google/XNNPACK

comment "xnnpack needs a toolchain w/ C++14, threads"
	depends on !BR2_INSTALL_LIBSTDCPP || \
		!BR2_TOOLCHAIN_GCC_AT_LEAST_4_9 || !BR2_TOOLCHAIN_HAS_THREADS
```

## package/xr819-xradio/Config.in
```kconfig
config BR2_PACKAGE_XR819_XRADIO
	bool "xr819-xradio"
	depends on BR2_LINUX_KERNEL
	depends on BR2_arm || BR2_armeb || BR2_aarch64 || \
		BR2_aarch64_be || BR2_riscv
	help
	  Wireless driver for SDIO WiFi chip XR819

	  https://github.com/fifteenhex/xradio

comment "xr819-xradio driver needs a Linux kernel to be built"
	depends on !BR2_LINUX_KERNEL
```

## package/xscreensaver/Config.in
```kconfig
config BR2_PACKAGE_XSCREENSAVER
	bool "xscreensaver"
	depends on BR2_PACKAGE_XORG7
	depends on BR2_PACKAGE_HAS_LIBGL # libglu
	depends on BR2_PACKAGE_HOST_RUSTC_ARCH_SUPPORTS # libgtk3
	depends on BR2_USE_WCHAR # libgtk3, libglib2
	depends on BR2_TOOLCHAIN_HAS_THREADS # libgtk3, libglib2
	depends on BR2_USE_MMU # libgtk3, libglib2
	depends on BR2_INSTALL_LIBSTDCPP # libgtk3
	depends on BR2_TOOLCHAIN_HAS_SYNC_4 # libgtk3
	depends on BR2_TOOLCHAIN_GCC_AT_LEAST_4_9 # libgtk3
	select BR2_PACKAGE_GDK_PIXBUF
	select BR2_PACKAGE_LIBGLU
	select BR2_PACKAGE_LIBGTK3
	select BR2_PACKAGE_LIBXCRYPT if BR2_TOOLCHAIN_USES_GLIBC
	select BR2_PACKAGE_LIBXML2
	select BR2_PACKAGE_JPEG
	select BR2_PACKAGE_XLIB_LIBX11
	select BR2_PACKAGE_XLIB_LIBXFT
	select BR2_PACKAGE_XLIB_LIBXI
	select BR2_PACKAGE_XLIB_LIBXT
	help
	  XScreenSaver is the standard screen saver collection shipped
	  on most Linux and Unix systems running the X11 Window
	  System.

	  On X11 systems, XScreenSaver is two things: it is both a
	  large collection of screen savers; and it is also the
	  framework for blanking and locking the screen.

	  http://www.jwz.org/xscreensaver/

comment "xscreensaver needs a toolchain w/ wchar, C++, threads, gcc >= 4.9, OpenGL backend"
	depends on BR2_PACKAGE_XORG7
	depends on BR2_PACKAGE_HOST_RUSTC_ARCH_SUPPORTS
	depends on BR2_USE_MMU
	depends on BR2_TOOLCHAIN_HAS_SYNC_4
	depends on !BR2_INSTALL_LIBSTDCPP || !BR2_TOOLCHAIN_HAS_THREADS || \
		!BR2_TOOLCHAIN_GCC_AT_LEAST_4_9 || \
		!BR2_USE_WCHAR || !BR2_PACKAGE_HAS_LIBGL
```

## package/xvisor/Config.in
```kconfig
config BR2_PACKAGE_XVISOR_ARCH_SUPPORTS
	bool
	default y if BR2_aarch64
	default y if BR2_cortex_a7 || BR2_cortex_a12 || BR2_cortex_a15 || BR2_cortex_a17
	default y if BR2_riscv
	default y if BR2_x86_64
	depends on BR2_USE_MMU

menuconfig BR2_PACKAGE_XVISOR
	bool "xvisor"
	depends on BR2_PACKAGE_XVISOR_ARCH_SUPPORTS
	depends on BR2_TOOLCHAIN_GCC_AT_LEAST_4_9
	help
	  Xvisor is an open-source type-1 hypervisor, which aims at
	  providing a monolithic, light-weight, portable, and flexible
	  virtualization solution.

	  http://www.xhypervisor.org/

if BR2_PACKAGE_XVISOR

choice
	prompt "Xvisor configuration"
	default BR2_PACKAGE_XVISOR_USE_DEFCONFIG

config BR2_PACKAGE_XVISOR_USE_DEFCONFIG
	bool "Using an in-tree defconfig file"

config BR2_PACKAGE_XVISOR_USE_CUSTOM_CONFIG
	bool "Using a custom (def)config file"

endchoice

config BR2_PACKAGE_XVISOR_DEFCONFIG
	string "Defconfig name"
	default "generic-v7-ve" if BR2_ARM_CPU_ARMV7A
	default "generic-v8" if BR2_aarch64
	default "generic-32b" if BR2_RISCV_32
	default "generic-64b" if BR2_RISCV_64
	default "x86_64_generic" if BR2_x86_64
	depends on BR2_PACKAGE_XVISOR_USE_DEFCONFIG
	help
	  Name of the Xvisor defconfig file to use, without the
	  trailing -defconfig. The defconfig is located in
	  arch/<arch>/configs in the source tree.

config BR2_PACKAGE_XVISOR_CUSTOM_CONFIG_FILE
	string "Configuration file path"
	depends on BR2_PACKAGE_XVISOR_USE_CUSTOM_CONFIG
	help
	  Path to the Xvisor configuration file

config BR2_PACKAGE_XVISOR_CREATE_UBOOT_IMAGE
	bool "Create U-Boot image of Xvisor"
	depends on BR2_arm
	select BR2_PACKAGE_HOST_UBOOT_TOOLS
	help
	  Create an image file of Xvisor loadable from Das U-Boot.

config BR2_PACKAGE_XVISOR_BUILD_TEST_DTB
	bool "Build test device-tree blobs"
	help
	  Build test device-tree blobs for popular boards.

endif

comment "xvisor needs a toolchain w/ gcc >= 4.9"
	depends on !BR2_TOOLCHAIN_GCC_AT_LEAST_4_9
	depends on BR2_PACKAGE_XVISOR_ARCH_SUPPORTS
```

## package/yad/Config.in
```kconfig
config BR2_PACKAGE_YAD
	bool "yad"
	depends on BR2_PACKAGE_LIBGTK3_X11
	help
	  YAD (yet another dialog) is a tool for create graphical
	  dialogs from shell scripts.

	  http://sourceforge.net/projects/yad-dialog/

comment "yad needs libgtk3 w/ X11 backend"
	depends on !BR2_PACKAGE_LIBGTK3_X11
```

## package/yavta/Config.in
```kconfig
config BR2_PACKAGE_YAVTA
	bool "yavta"
	help
	  Yet Another V4L2 Test Application

	  https://git.ideasonboard.org/yavta.git
```

## package/yq/Config.in
```kconfig
config BR2_PACKAGE_YQ
	bool "yq"
	depends on BR2_PACKAGE_HOST_GO_TARGET_ARCH_SUPPORTS
	select BR2_PACKAGE_HOST_GO
	help
	  A lightweight and portable command-line YAML, JSON, INI
	  and XML processor, yq uses jq (a popular JSON processor)
	  like syntax.

	  https://mikefarah.gitbook.io/yq/
```

## package/z3/Config.in
```kconfig
# z3 supports arch for which libc fenv.h provides all four macros:
# FE_DOWNWARD, FE_TONEAREST, FE_TOWARDZERO, FE_UPWARD
# See for example in glibc https://sourceware.org/git/glibc.git
# git grep -E '^[[:space:]]*#[[:space:]]*define[[:space:]]+FE_(TONEAREST|UPWARD|DOWNWARD|TOWARDZERO)' sysdeps/
config BR2_PACKAGE_Z3_ARCH_SUPPORTS
	bool
	default y if BR2_aarch64 || BR2_aarch64_be
	default y if BR2_arceb || BR2_arcle
	default y if BR2_arm || BR2_armeb
	default y if BR2_i386
	default y if BR2_m68k
	# BR2_microblaze has only FE_TONEAREST
	default y if BR2_mips || BR2_mipsel || BR2_mips64 || BR2_mips64el
	# BR2_nios2 has only FE_TONEAREST
	default y if BR2_or1k
	default y if BR2_powerpc || BR2_powerpc64 || BR2_powerpc64le
	default y if BR2_riscv
	default y if BR2_s390x
	# BR2_sh has only FE_{TONEAREST,TOWARDZERO}
	default y if BR2_sparc || BR2_sparc64
	default y if BR2_x86_64
	# BR2_xtensa supports only uclibc which does not have fenv.h

config BR2_PACKAGE_Z3
	bool "z3"
	depends on BR2_INSTALL_LIBSTDCPP
	depends on BR2_TOOLCHAIN_GCC_AT_LEAST_7 # c++17
	# z3 needs fenv.h which is not provided by uclibc
	depends on !BR2_TOOLCHAIN_USES_UCLIBC
	depends on BR2_PACKAGE_Z3_ARCH_SUPPORTS
	help
	  Z3, also known as the Z3 Theorem Prover, is a cross-platform
	  satisfiability modulo theories (SMT) solver.

	  https://github.com/Z3Prover/z3

if BR2_PACKAGE_Z3

config BR2_PACKAGE_Z3_PYTHON
	bool "Python bindings"
	depends on BR2_PACKAGE_PYTHON3
	select BR2_PACKAGE_PYTHON3_PYEXPAT # runtime
	select BR2_PACKAGE_PYTHON_SETUPTOOLS # runtime

endif
```

## package/zabbix/Config.in
```kconfig
config BR2_PACKAGE_ZABBIX
	bool "zabbix"
	depends on BR2_TOOLCHAIN_USES_GLIBC
	select BR2_PACKAGE_PCRE
	help
	  Zabbix is an enterprise-class open source distributed
	  monitoring solution. Zabbix is free of cost. Zabbix is
	  written and distributed under the GPL General Public License
	  version 2.

	  https://zabbix.com

comment "zabbix need glibc"
	depends on !BR2_TOOLCHAIN_USES_GLIBC

if BR2_PACKAGE_ZABBIX

comment "zabbix server needs C++ and threads or wchar and dynamic libs"
	depends on BR2_USE_MMU
	depends on \
		!(BR2_INSTALL_LIBSTDCPP && BR2_TOOLCHAIN_HAS_THREADS) && \
		!(BR2_USE_WCHAR && !BR2_STATIC_LIBS)

config BR2_PACKAGE_ZABBIX_SERVER
	bool "zabbix server"
	depends on BR2_USE_MMU # mysql, postgresql
	depends on \
		(BR2_INSTALL_LIBSTDCPP && BR2_TOOLCHAIN_HAS_THREADS) || \
		(BR2_USE_WCHAR && !BR2_STATIC_LIBS)
	select BR2_PACKAGE_ZLIB
	select BR2_PACKAGE_LIBEVENT

if BR2_PACKAGE_ZABBIX_SERVER

choice
	prompt "server database backend"

config BR2_PACKAGE_ZABBIX_SERVER_MYSQL
	bool "mysql"
	depends on BR2_INSTALL_LIBSTDCPP # mysql
	depends on BR2_TOOLCHAIN_HAS_THREADS # mysql
	select BR2_PACKAGE_MYSQL

config BR2_PACKAGE_ZABBIX_SERVER_POSTGRESQL
	bool "postgresql"
	depends on BR2_USE_WCHAR # postgresql
	depends on !BR2_STATIC_LIBS # postgresql
	depends on !BR2_OPTIMIZE_FAST # postgresql
	select BR2_PACKAGE_POSTGRESQL

endchoice

config BR2_PACKAGE_ZABBIX_SERVER_COPY_DUMPS
	bool "install SQL dumps"
	help
	  Copy initial database dumps to /var/lib/zabbix/schema

	  These still need to be imported into the database by hand.

config BR2_PACKAGE_ZABBIX_SERVER_COPY_FRONTEND
	bool "install web UI to target"
	depends on BR2_PACKAGE_PHP # runtime
	select BR2_PACKAGE_PHP_EXT_MYSQLI if BR2_PACKAGE_ZABBIX_SERVER_MYSQL
	select BR2_PACKAGE_PHP_EXT_PGSQL if BR2_PACKAGE_ZABBIX_SERVER_POSTGRESQL
	select BR2_PACKAGE_PHP_EXT_BCMATH
	select BR2_PACKAGE_PHP_EXT_SOCKETS
	select BR2_PACKAGE_PHP_EXT_MBSTRING
	select BR2_PACKAGE_PHP_EXT_GD
	select BR2_PACKAGE_PHP_EXT_LIBXML2
	select BR2_PACKAGE_PHP_EXT_CTYPE
	select BR2_PACKAGE_PHP_EXT_SESSION
	select BR2_PACKAGE_PHP_EXT_XMLREADER
	select BR2_PACKAGE_PHP_EXT_XMLWRITER
	help
	  Copy web-UI to /var/www/zabbix. You need to set up a web
	  server to access it.

comment "zabbix web UI requires PHP"
	depends on !BR2_PACKAGE_PHP

endif

endif
```

## package/zchunk/Config.in
```kconfig
config BR2_PACKAGE_ZCHUNK
	bool "zchunk"
	depends on BR2_USE_MMU # fork()
	select BR2_PACKAGE_ARGP_STANDALONE if BR2_TOOLCHAIN_USES_UCLIBC || BR2_TOOLCHAIN_USES_MUSL
	select BR2_PACKAGE_LIBCURL
	help
	  A file format designed for highly efficient deltas while
	  maintaining good compression.

	  https://github.com/zchunk/zchunk
```

## package/zeek/Config.in
```kconfig
config BR2_PACKAGE_ZEEK
	bool "zeek"
	depends on BR2_USE_MMU # fork()
	depends on BR2_INSTALL_LIBSTDCPP
	depends on !BR2_STATIC_LIBS
	depends on BR2_TOOLCHAIN_HAS_THREADS
	depends on BR2_USE_WCHAR
	depends on BR2_TOOLCHAIN_GCC_AT_LEAST_7 # C++17
	depends on BR2_HOST_GCC_AT_LEAST_7 # host-zeek
	select BR2_PACKAGE_LIBPCAP
	select BR2_PACKAGE_MUSL_FTS if !BR2_TOOLCHAIN_USES_GLIBC
	select BR2_PACKAGE_OPENSSL
	select BR2_PACKAGE_ZLIB
	help
	  The Zeek Network Security Monitor

	  Zeek is a powerful network analysis framework that is much
	  different from the typical IDS you may know. (Zeek is the new
	  name for the long-established Bro system.)

	  https://www.zeek.org

if BR2_PACKAGE_ZEEK

config BR2_PACKAGE_ZEEK_ZEEKCTL
	bool "zeekctl"
	select BR2_PACKAGE_BASH # runtime
	select BR2_PACKAGE_BUSYBOX_SHOW_OTHERS # bash
	select BR2_PACKAGE_PYTHON3
	select BR2_PACKAGE_PYTHON3_CURSES
	select BR2_PACKAGE_PYTHON3_SQLITE
	select BR2_PACKAGE_PYTHON3_ZLIB
	help
	  Tool for managing Zeek deployments

endif

comment "zeek needs a toolchain w/ C++, wchar, threads, dynamic library, gcc >= 7, host gcc >= 7"
	depends on BR2_USE_MMU
	depends on !BR2_INSTALL_LIBSTDCPP || !BR2_USE_WCHAR || \
		!BR2_TOOLCHAIN_HAS_THREADS || BR2_STATIC_LIBS || \
		!BR2_TOOLCHAIN_GCC_AT_LEAST_7 || \
		!BR2_HOST_GCC_AT_LEAST_7
```
