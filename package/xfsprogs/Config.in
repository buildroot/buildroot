## package/zellij/Config.in
```kconfig
config BR2_PACKAGE_ZELLIJ
	bool "zellij"
	# Zellij uses the cranelift crate which has architecure
	# dependencies. Specify them explicitly. See details here:
	# https://docs.rs/cranelift-codegen/0.122.0/cranelift_codegen/
	depends on BR2_x86_64 || BR2_x86_i686 || BR2_aarch64
	depends on BR2_PACKAGE_HOST_RUSTC_TARGET_ARCH_SUPPORTS
	select BR2_PACKAGE_HOST_RUSTC
	help
	  An advanced terminal multiplexer with batteries included.
	  Supports layouts, floating and stacked panes, plugins, and
	  customization. Provides rich functionality out of the box.

	  Zellij is aimed at developers, operations-oriented users,
	  and anyone who loves the terminal.

	  https://github.com/zellij-org/zellij
```

## package/zerofree/Config.in
```kconfig
config BR2_PACKAGE_ZEROFREE
	bool "zerofree"
	depends on BR2_USE_MMU # e2fsprogs
	depends on !BR2_STATIC_LIBS
	select BR2_PACKAGE_E2FSPROGS
	help
	  zerofree is a utility which scans the free blocks in an ext2
	  filesystem and fills any non-zero blocks with zeroes.

	  https://frippery.org/uml/

comment "zerofree needs a toolchain w/ dynamic library"
	depends on BR2_USE_MMU
	depends on BR2_STATIC_LIBS
```

## package/zfs/Config.in
```kconfig
comment "zfs needs a Linux kernel to be built"
	depends on !BR2_LINUX_KERNEL

comment "zfs needs udev /dev management"
	depends on BR2_LINUX_KERNEL
	depends on !BR2_PACKAGE_HAS_UDEV

config BR2_PACKAGE_ZFS
	bool "zfs"
	depends on BR2_LINUX_KERNEL
	depends on BR2_PACKAGE_HAS_UDEV
	depends on BR2_USE_MMU  # util-linux (libblkid)
	depends on BR2_TOOLCHAIN_HAS_THREADS  # libtirpc
	select BR2_LINUX_NEEDS_MODULES
	select BR2_PACKAGE_UTIL_LINUX
	select BR2_PACKAGE_UTIL_LINUX_LIBBLKID
	select BR2_PACKAGE_UTIL_LINUX_LIBUUID
	select BR2_PACKAGE_LIBTIRPC if !BR2_TOOLCHAIN_HAS_NATIVE_RPC
	select BR2_PACKAGE_LIBAIO
	select BR2_PACKAGE_OPENSSL
	select BR2_PACKAGE_ZLIB
	select BR2_PACKAGE_LIBCURL
	help
	  OpenZFS on Linux and FreeBSD

	  OpenZFS is an advanced file system and volume manager which
	  was originally developed for Solaris and is now maintained by
	  the OpenZFS community. This repository contains the code for
	  running OpenZFS on Linux and FreeBSD.

	  This package builds the kernel modules and userland utils
	  required to operates with ZFS volumes.

	  http://zfsonlinux.org/
```

## package/zix/Config.in
```kconfig
config BR2_PACKAGE_ZIX
	bool "zix"
	help
	  A lightweight C library for reading and writing RDF

	  https://gitlab.com/drobilla/zix
```

## package/zoxide/Config.in
```kconfig
config BR2_PACKAGE_ZOXIDE
	bool "zoxide"
	depends on BR2_PACKAGE_HOST_RUSTC_TARGET_ARCH_SUPPORTS
	select BR2_PACKAGE_HOST_RUSTC
	help
	  zoxide is a smarter cd command, inspired by z and autojump.
	  It remembers which directories you use most frequently, so
	  you can "jump" to them in just a few keystrokes.
	  zoxide works on all major shells.

	  https://github.com/ajeetdsouza/zoxide.git
```

## package/zxing-cpp/Config.in
```kconfig
comment "zxing-cpp needs a toolchain w/ C++, wchar, dynamic library, threads"
	depends on !BR2_INSTALL_LIBSTDCPP || !BR2_USE_WCHAR || \
		BR2_STATIC_LIBS || !BR2_TOOLCHAIN_HAS_THREADS

config BR2_PACKAGE_ZXING_CPP
	bool "zxing-cpp"
	depends on !BR2_STATIC_LIBS
	depends on BR2_USE_WCHAR
	depends on BR2_INSTALL_LIBSTDCPP
	depends on BR2_TOOLCHAIN_HAS_THREADS
	select BR2_PACKAGE_STB
	select BR2_PACKAGE_PYTHON_PYBIND if BR2_PACKAGE_PYTHON3
	select BR2_PACKAGE_ZXING_CPP_READERS if !BR2_PACKAGE_ZXING_CPP_WRITERS
	help
	  ZXing-cpp (pronounced "zebra crossing") is an open-source,
	  multi-format 1D/2D barcode image processing library
	  implemented in Java, with ports to other languages. This
	  compiles the C++ port.

	  https://github.com/zxing-cpp/zxing-cpp

if BR2_PACKAGE_ZXING_CPP

config BR2_PACKAGE_ZXING_CPP_READERS
	bool "readers support"
	default y
	help
	  Build with readers (decoders) support

config BR2_PACKAGE_ZXING_CPP_WRITERS
	bool "writers support"
	default y
	help
	  Build with writers (encoders) support

endif # BR2_PACKAGE_ZXING_CPP
```

## package/zynaddsubfx/Config.in
```kconfig
config BR2_PACKAGE_ZYNADDSUBFX
	bool "zynaddsubfx"
	depends on BR2_INSTALL_LIBSTDCPP
	depends on BR2_TOOLCHAIN_GCC_AT_LEAST_4_9 # C++11
	depends on BR2_TOOLCHAIN_HAS_THREADS # liblo
	select BR2_PACKAGE_FFTW
	select BR2_PACKAGE_FFTW_SINGLE
	select BR2_PACKAGE_LIBLO
	select BR2_PACKAGE_MXML
	select BR2_PACKAGE_ZLIB
	help
	  ZynAddSubFX is a fully featured open source software
	  synthesizer capable of making a countless number of
	  instruments, from some common heard from expensive hardware
	  to interesting sounds that you'll boost to an amazing
	  universe of sounds.

	  Note: this Buildroot package does not include the graphical
	  user interface. It is meant to be executed as a headless
	  daemon to be controlled with MIDI events or network OSC
	  (Open Sound Control) events. OSC events can be generated
	  from an external system with the ZynAddSubFX external GUI
	  program zynaddsubfx-ext-gui.

	  https://zynaddsubfx.sourceforge.io/

comment "zynaddsubfx needs a toolchain w/ C++11 and threads"
	depends on !BR2_INSTALL_LIBSTDCPP || \
		!BR2_TOOLCHAIN_GCC_AT_LEAST_4_9 || \
		!BR2_TOOLCHAIN_HAS_THREADS
```
