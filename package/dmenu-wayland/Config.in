## package/dtui/Config.in
```kconfig
config BR2_PACKAGE_DTUI
	bool "dtui"
	depends on BR2_PACKAGE_HOST_RUSTC_TARGET_ARCH_SUPPORTS
	depends on BR2_TOOLCHAIN_HAS_THREADS # dbus
	depends on BR2_USE_MMU # dbus
	select BR2_PACKAGE_DBUS # runtime
	select BR2_PACKAGE_HOST_RUSTC
	help
	  dtui is a minimal TUI for introspecting the state of the
	  system/session D-Bus. It shows current services and lets
	  you introspect objects and their interfaces.

	  https://github.com/Troels51/dtui

comment "dtui needs a toolchain w/ threads"
	depends on BR2_PACKAGE_HOST_RUSTC_TARGET_ARCH_SUPPORTS
	depends on BR2_USE_MMU
	depends on !BR2_TOOLCHAIN_HAS_THREADS
```

## package/dump1090/Config.in
```kconfig
config BR2_PACKAGE_DUMP1090
	bool "dump1090"
	depends on BR2_TOOLCHAIN_HAS_THREADS
	depends on BR2_TOOLCHAIN_GCC_AT_LEAST_4_9 # C11/stdatomic.h
	select BR2_PACKAGE_NCURSES
	help
	  Dump1090 is a simple Mode S decoder for RTLSDR devices

	  https://github.com/flightaware/dump1090

comment "dump1090 needs a toolchain w/ threads, gcc >= 4.9"
	depends on !BR2_TOOLCHAIN_HAS_THREADS || \
		!BR2_TOOLCHAIN_GCC_AT_LEAST_4_9
```

## package/dust/Config.in
```kconfig
config BR2_PACKAGE_DUST
	bool "dust"
	depends on BR2_PACKAGE_HOST_RUSTC_TARGET_ARCH_SUPPORTS
	select BR2_PACKAGE_HOST_RUSTC
	help
	  dust is an alternative written in Rust of the command "du"
	  from the Linux kernel. It aims to be more intuitive and visual
	  in order to give the user a better view of his system's
	  current storage capacity.

	  https://github.com/bootandy/dust.git
```

## package/dxdrm/Config.in
```kconfig
config BR2_PACKAGE_DXDRM
	bool "dxdrm"
	depends on BR2_i386 || BR2_arm
	depends on BR2_INSTALL_LIBSTDCPP
	depends on BR2_TOOLCHAIN_HAS_THREADS
	select BR2_PACKAGE_LIBCURL
	help
	  Discretix PlayReady DRM implementation

	  http://www.metrological.com

if BR2_PACKAGE_DXDRM

choice
	prompt "Device/Model credential provisioning"

config BR2_PACKAGE_DXDRM_EXTERNAL
	bool "external"
	select BR2_PACKAGE_OPENSSL
	select BR2_PACKAGE_CPPSDK
	select BR2_PACKAGE_CPPSDK_GENERICS
	help
	  Device Credentials will be provisioned via an external system.

config BR2_PACKAGE_DXDRM_INTERNAL
	bool "internal"
	help
	  Device credentials are provisioned from locally stored model credentials.

endchoice

endif
```

## package/e2fsprogs/Config.in
```kconfig
menuconfig BR2_PACKAGE_E2FSPROGS
	bool "e2fsprogs"
	depends on BR2_USE_MMU # util-linux/libblkid
	select BR2_PACKAGE_UTIL_LINUX
	select BR2_PACKAGE_UTIL_LINUX_LIBBLKID
	select BR2_PACKAGE_UTIL_LINUX_LIBUUID
	help
	  The EXT2 file system utilities.

	  The following programs are always built and installed:
	  badblocks chattr debugfs dumpe2fs e2freefrag e2fsck e2image
	  e2undo e4crypt e4defrag filefrag fsck fuse2fs logsave lsattr
	  mke2fs mklost+found resize2fs tune2fs

	  The uuid utilities (uuidd, uuidgen) are not built. Use the
	  ones from util-linux, instead.

	  Other programs can be selected individually.

	  http://e2fsprogs.sourceforge.net

if BR2_PACKAGE_E2FSPROGS

config BR2_PACKAGE_E2FSPROGS_DEBUGFS
	bool "debugfs"
	help
	  ext2/ext3/ext4 file system debugger

config BR2_PACKAGE_E2FSPROGS_E2IMAGE
	bool "e2image"
	help
	  Save critical ext2/ext3/ext4 filesystem metadata to a file

config BR2_PACKAGE_E2FSPROGS_E2SCRUB
	bool "e2scrub"
	depends on BR2_PACKAGE_BASH  # runtime
	depends on BR2_PACKAGE_COREUTILS  # runtime
	depends on BR2_PACKAGE_LVM2  # runtime
	depends on BR2_PACKAGE_UTIL_LINUX  # runtime
	help
	  Check the contents of a mounted ext[234] filesystem

comment "e2scrub needs bash, coreutils, lvm2, and util-linux"
	depends on !BR2_PACKAGE_BASH || !BR2_PACKAGE_COREUTILS \
		|| !BR2_PACKAGE_LVM2 || !BR2_PACKAGE_UTIL_LINUX

config BR2_PACKAGE_E2FSPROGS_E4DEFRAG
	bool "e4defrag"
	help
	  Online defragmenter for ext4 filesystem

config BR2_PACKAGE_E2FSPROGS_FSCK
	bool "fsck"
	default y
	depends on !BR2_PACKAGE_UTIL_LINUX_FSCK
	help
	  Check and repair a Linux file system. This is a wrapper around
	  the filesystem-specific fsck tools.

config BR2_PACKAGE_E2FSPROGS_FUSE2FS
	bool "fuse2fs"
	depends on !BR2_STATIC_LIBS # libfuse
	depends on BR2_TOOLCHAIN_HAS_THREADS # libfuse
	select BR2_PACKAGE_LIBFUSE
	help
	  FUSE file system client for ext2/ext3/ext4 file systems

comment "fuse2fs needs a toolchain w/ threads, dynamic library"
	depends on !BR2_TOOLCHAIN_HAS_THREADS || BR2_STATIC_LIBS

config BR2_PACKAGE_E2FSPROGS_RESIZE2FS
	bool "resize2fs"
	help
	  ext2/ext3/ext4 file system resizer

endif
```

## package/ebtables/Config.in
```kconfig
config BR2_PACKAGE_EBTABLES
	bool "ebtables"
	depends on BR2_USE_MMU # fork()
	# https://lore.kernel.org/all/20210518181730.13436-1-patrickdepinguin@gmail.com/
	depends on !BR2_KERNEL_64_USERLAND_32
	help
	  Ethernet bridge frame table administration

	  http://ebtables.netfilter.org/

if BR2_PACKAGE_EBTABLES

config BR2_PACKAGE_EBTABLES_UTILS_SAVE
	bool "ebtables save"
	select BR2_PACKAGE_BASH # runtime
	select BR2_PACKAGE_BUSYBOX_SHOW_OTHERS # bash
	help
	  Install the ebtables-legacy-save tool

config BR2_PACKAGE_EBTABLES_UTILS_RESTORE
	bool "ebtables restore"
	help
	  Install the ebtables-legacy-restore tool

endif
```

## package/edid-decode/Config.in
```kconfig
config BR2_PACKAGE_EDID_DECODE
	bool "edid-decode"
	depends on BR2_INSTALL_LIBSTDCPP
	help
	  Decode EDID data in human-readable format.

	  https://git.linuxtv.org/edid-decode.git/

comment "edid-decode needs a toolchain w/ C++"
	depends on !!BR2_INSTALL_LIBSTDCPP
```

## package/edk2-non-osi/Config.in
```kconfig
config BR2_PACKAGE_EDK2_NON_OSI
	bool
	help
	  EDK2 description files for additional platforms, not
	  compatible with the normal licensing requirements.
	  The main EDK2 bootloader package will depend on these
	  description files while building firmware for some platforms.

	  Only the Marvell Armada files are copied at this point.

	  https://github.com/tianocore/edk2-non-osi
```
