## package/dmenu-wayland/Config.in
```kconfig
config BR2_PACKAGE_DMENU_WAYLAND
	bool "dmenu-wayland"
	depends on BR2_USE_MMU # pango
	depends on BR2_TOOLCHAIN_HAS_SYNC_4 # pango
	depends on BR2_TOOLCHAIN_HAS_THREADS # libglib2, pango, wayland
	depends on BR2_TOOLCHAIN_GCC_AT_LEAST_4_9 # pango
	depends on !BR2_STATIC_LIBS # wayland
	depends on BR2_INSTALL_LIBSTDCPP # pango
	depends on BR2_USE_WCHAR # libglib2, pango
	select BR2_PACKAGE_CAIRO
	select BR2_PACKAGE_CAIRO_PNG
	select BR2_PACKAGE_LIBGLIB2
	select BR2_PACKAGE_LIBXKBCOMMON
	select BR2_PACKAGE_PANGO
	select BR2_PACKAGE_WAYLAND
	select BR2_PACKAGE_WAYLAND_PROTOCOLS
	help
	  dmenu-wl is an efficient dynamic menu for wayland (wlroots).

	  https://github.com/nyyManni/dmenu-wayland

comment "dmenu-wayland needs a toolchain w/ wchar, threads, C++, dynamic library, gcc >= 4.9"
	depends on BR2_USE_MMU
	depends on BR2_TOOLCHAIN_HAS_SYNC_4
	depends on !BR2_TOOLCHAIN_HAS_THREADS || \
		!BR2_TOOLCHAIN_GCC_AT_LEAST_4_9 || BR2_STATIC_LIBS || \
		!BR2_INSTALL_LIBSTDCPP || !BR2_USE_WCHAR
```

## package/dns320l-daemon/Config.in
```kconfig
config BR2_PACKAGE_DNS320L_DAEMON
	bool "dns320l-daemon"
	depends on BR2_PACKAGE_INIPARSER
	help
	  MCU Daemon for the D-Link DNS-320L

	  https://www.aboehler.at/hg/dns320l-daemon
```

## package/docker-cli-buildx/Config.in
```kconfig
config BR2_PACKAGE_DOCKER_CLI_BUILDX
	bool "docker-cli-buildx"
	depends on BR2_PACKAGE_HOST_GO_TARGET_ARCH_SUPPORTS
	depends on BR2_PACKAGE_HOST_GO_TARGET_CGO_LINKING_SUPPORTS
	depends on BR2_TOOLCHAIN_HAS_THREADS
	select BR2_PACKAGE_DOCKER_CLI
	help
	  buildx is a Docker CLI plugin for extended build
	  capabilities with BuildKit.

	  https://github.com/docker/buildx

comment "docker-cli-buildx needs a toolchain w/ threads"
	depends on BR2_PACKAGE_HOST_GO_TARGET_ARCH_SUPPORTS
	depends on BR2_PACKAGE_HOST_GO_TARGET_CGO_LINKING_SUPPORTS
	depends on !BR2_TOOLCHAIN_HAS_THREADS
```

## package/docker-compose/Config.in
```kconfig
config BR2_PACKAGE_DOCKER_COMPOSE
	bool "docker-compose"
	depends on BR2_PACKAGE_HOST_GO_TARGET_ARCH_SUPPORTS
	depends on BR2_PACKAGE_HOST_GO_TARGET_CGO_LINKING_SUPPORTS
	depends on BR2_TOOLCHAIN_HAS_THREADS
	depends on BR2_PACKAGE_DOCKER_CLI
	select BR2_PACKAGE_HOST_GO
	help
	  Multi-container applications with the Docker CLI.

	  https://github.com/docker/compose

comment "docker-compose needs docker-cli and a toolchain w/ threads"
	depends on BR2_PACKAGE_HOST_GO_TARGET_ARCH_SUPPORTS
	depends on BR2_PACKAGE_HOST_GO_TARGET_CGO_LINKING_SUPPORTS
	depends on !BR2_TOOLCHAIN_HAS_THREADS || !BR2_PACKAGE_DOCKER_CLI
```

## package/docker-credential-acr-env/Config.in
```kconfig
config BR2_PACKAGE_DOCKER_CREDENTIAL_ACR_ENV
	bool "docker-credential-acr-env"
	depends on BR2_PACKAGE_HOST_GO_TARGET_ARCH_SUPPORTS
	help
	  The ACR docker credential helper is an alternative to the
	  existing file store based ACR helper [...] which relies
	  on az command line and is not optimised for use in CI
	  environments. Primary use case for this helper is for use
	  with kaniko and other tools running in CI scenarios wishing
	  to push to Azure Container Registry.

	  https://github.com/chrismellard/docker-credential-acr-env/
```

## package/docker-credential-gcr/Config.in
```kconfig
config BR2_PACKAGE_DOCKER_CREDENTIAL_GCR
	bool "docker-credential-gcr"
	depends on BR2_PACKAGE_HOST_GO_TARGET_ARCH_SUPPORTS
	help
	  docker-credential-gcr is Google Container Registry's
	  standalone, gcloud SDK-independent Docker credential
	  helper. It allows for v18.03+ Docker clients to easily make
	  authenticated requests to GCR's repositories (gcr.io,
	  eu.gcr.io, etc.).

	  https://github.com/GoogleCloudPlatform/docker-credential-gcr/
```

## package/docker-engine/Config.in
```kconfig
config BR2_PACKAGE_DOCKER_ENGINE
	bool "docker-engine"
	depends on BR2_PACKAGE_HOST_GO_TARGET_ARCH_SUPPORTS
	depends on BR2_PACKAGE_HOST_GO_TARGET_CGO_LINKING_SUPPORTS
	depends on BR2_TOOLCHAIN_HAS_THREADS
	depends on !BR2_TOOLCHAIN_USES_UCLIBC # containerd -> runc
	depends on BR2_USE_MMU # containerd
	depends on BR2_PACKAGE_LIBSECCOMP_ARCH_SUPPORTS # libseccomp
	depends on BR2_TOOLCHAIN_HEADERS_AT_LEAST_3_17 # libseccomp
	select BR2_PACKAGE_CGROUPFS_MOUNT if !BR2_PACKAGE_SYSTEMD # runtime dependency
	select BR2_PACKAGE_CONTAINERD # runtime dependency
	select BR2_PACKAGE_HOST_GO
	select BR2_PACKAGE_IPTABLES # runtime dependency
	select BR2_PACKAGE_LIBSECCOMP
	help
	  Docker is a platform to build, ship,
	  and run applications as lightweight containers.

	  https://github.com/docker/docker

if BR2_PACKAGE_DOCKER_ENGINE

config BR2_PACKAGE_DOCKER_ENGINE_DRIVER_BTRFS
	bool "btrfs filesystem driver"
	depends on BR2_TOOLCHAIN_HEADERS_AT_LEAST_4_12
	help
	  Build the btrfs filesystem driver for Docker.

comment "brtfs filesystem driver needs headers >= 4.12"
	depends on !BR2_TOOLCHAIN_HEADERS_AT_LEAST_4_12

config BR2_PACKAGE_DOCKER_ENGINE_DRIVER_DEVICEMAPPER
	bool "devicemapper filesystem driver"
	depends on BR2_TOOLCHAIN_HAS_THREADS # lvm2
	depends on BR2_USE_MMU # lvm2
	depends on !BR2_STATIC_LIBS # lvm2
	select BR2_PACKAGE_LVM2
	help
	  Build the devicemapper filesystem driver for Docker.

config BR2_PACKAGE_DOCKER_ENGINE_DRIVER_VFS
	bool "vfs filesystem driver"
	depends on BR2_USE_WCHAR # gvfs
	depends on BR2_USE_MMU # gvfs
	depends on BR2_TOOLCHAIN_HAS_THREADS # gvfs
	depends on !BR2_STATIC_LIBS # gvfs
	select BR2_PACKAGE_GVFS
	help
	  Build the vfs filesystem driver for Docker.

choice
	bool "support docker-init"
	default BR2_PACKAGE_DOCKER_ENGINE_DOCKER_INIT_TINI if BR2_PACKAGE_DOCKER_ENGINE_DOCKER_INIT  # legacy
	help
	  Support providing a minimal init process for containers.
	  Required to use "docker run --init".

config BR2_PACKAGE_DOCKER_ENGINE_DOCKER_INIT_NONE
	bool "none"
	help
	  Do not support docker-init.

config BR2_PACKAGE_DOCKER_ENGINE_DOCKER_INIT_CATATONIT
	bool "catatonit"
	select BR2_PACKAGE_CATATONIT # runtime
	help
	  Support providing a minimal init process for containers,
	  using catatonit.

config BR2_PACKAGE_DOCKER_ENGINE_DOCKER_INIT_TINI
	bool "tini"
	select BR2_PACKAGE_TINI # runtime
	help
	  Support providing a minimal init process for containers,
	  using tini.

endchoice

config BR2_PACKAGE_DOCKER_ENGINE_DOCKER_INIT_NAME
	string
	default "tini" if BR2_PACKAGE_DOCKER_ENGINE_DOCKER_INIT_TINI
	default "catatonit" if BR2_PACKAGE_DOCKER_ENGINE_DOCKER_INIT_CATATONIT

endif

comment "docker-engine needs a glibc or musl toolchain w/ threads, headers >= 3.17"
	depends on BR2_PACKAGE_HOST_GO_TARGET_ARCH_SUPPORTS
	depends on BR2_PACKAGE_HOST_GO_TARGET_CGO_LINKING_SUPPORTS
	depends on BR2_PACKAGE_LIBSECCOMP_ARCH_SUPPORTS
	depends on !BR2_TOOLCHAIN_HAS_THREADS || \
		BR2_TOOLCHAIN_USES_UCLIBC || \
		!BR2_TOOLCHAIN_HEADERS_AT_LEAST_3_17
	depends on BR2_USE_MMU
```

## package/docopt-cpp/Config.in
```kconfig
config BR2_PACKAGE_DOCOPT_CPP
	bool "docopt-cpp"
	depends on BR2_INSTALL_LIBSTDCPP
	depends on BR2_TOOLCHAIN_GCC_AT_LEAST_4_7 # C++11
	help
	  docopt is a library that lets you define a command line
	  interface with the utility argument syntax that has been
	  used by command line utilities for decades (POSIX.1-2017).
	  From the description, docopt automatically generates a parser
	  for the command line arguments.

	  docopt Command-line interface description language
	  http://docopt.org/

	  docopt.cpp is a C++ port of docopt.

	  https://github.com/docopt/docopt.cpp

comment "docopt-cpp needs a toolchain w/ C++, gcc >= 4.7"
	depends on !BR2_INSTALL_LIBSTDCPP || \
		!BR2_TOOLCHAIN_GCC_AT_LEAST_4_7
```

## package/dos2unix/Config.in
```kconfig
config BR2_PACKAGE_DOS2UNIX
	bool "dos2unix"
	depends on BR2_PACKAGE_BUSYBOX_SHOW_OTHERS
	help
	  dos2unix converts text file line endings between CRLF and LF

	  https://waterlander.net/dos2unix/
```

## package/dotconf/Config.in
```kconfig
config BR2_PACKAGE_DOTCONF
	bool "dotconf"
	help
	  Configuration file parser.

	  https://github.com/williamh/dotconf
```

## package/double-conversion/Config.in
```kconfig
config BR2_PACKAGE_DOUBLE_CONVERSION
	bool "double-conversion"
	depends on BR2_INSTALL_LIBSTDCPP
	help
	  Provides binary-decimal and decimal-binary routines for
	  IEEE doubles.

	  https://github.com/google/double-conversion

comment "double-conversion needs a toolchain w/ C++"
	depends on !BR2_INSTALL_LIBSTDCPP
```

## package/douglas/Config.in
```kconfig
config BR2_PACKAGE_DOUGLAS
	select BR2_PACKAGE_JPEG
	select BR2_PACKAGE_ZLIB
	select BR2_PACKAGE_LIBCURL
	bool "douglas"
	help
	  Douglas project

if BR2_PACKAGE_DOUGLAS
menu "Options"

config BR2_PACKAGE_DOUGLAS_PLATFORM_FAMILY_NAME
	string "family name"
	default "rpi-metrological"

config BR2_PACKAGE_DOUGLAS_PLATFORM_NAME
	string "platform name"
	default "rpi-metrological-2018-br"

config BR2_PACKAGE_DOUGLAS_PARTNER_REPOSITORY_URL
	string "partner repo ssh uri"
	default "ssh://git@bitbucket-ext.amazondcl.com:8443/kpn/kpn-metrological.git" 

config BR2_PACKAGE_DOUGLAS_NUMBER_OF_CONCURRENT_JOBS
	string "concurrent jobs"
	default "4"

config BR2_PACKAGE_DOUGLAS_TAG
	string "concurrent jobs"
	default "1.2.0"
	
choice
	prompt "Build type"
	default BR2_PACKAGE_DOUGLAS_BUILD_TYPE_RELEASE
	help
	  Select the build type to use.
	  
	config BR2_PACKAGE_DOUGLAS_BUILD_TYPE_RELEASE
		bool "release"
	config BR2_PACKAGE_DOUGLAS_BUILD_TYPE_RELEASE_DEBUG
		bool "release with debug symbols"
	config BR2_PACKAGE_DOUGLAS_BUILD_TYPE_DEBUG
		bool "debug"
endchoice

choice
	prompt "Backend"
	default BR2_PACKAGE_DOUGLAS_BACKEND_DRM
	help
	  Select the backend you wish to use.
	  
	config BR2_PACKAGE_DOUGLAS_BACKEND_DRM
		bool "with drm"
	config BR2_PACKAGE_DOUGLAS_BACKEND_NO_DRM
		bool "without drm"
	config BR2_PACKAGE_DOUGLAS_BACKEND_FAKE
		bool "fake (for unittests)"
endchoice

config BR2_PACKAGE_DOUGLAS_IG_INSTALL_PATH
	string "install path"
	default "/usr/share/ignition"

config BR2_PACKAGE_DOUGLAS_IG_READ_WRITE_PATH
	string "read/write path"
	default "/root" 

config BR2_PACKAGE_DOUGLAS_IG_TEST_INSTALL_PATH
	string "test install path"
	default "/usr/share/ignition/test"

config BR2_PACKAGE_DOUGLAS_DTID
	string "concurrent jobs"
	default "A71I8788P1ZV8"
	
config BR2_PACKAGE_DOUGLAS_CPU_BIT_WIDTH_AND_ENDIANNESS
	string "concurrent jobs"
	default "LE32"
	
endmenu
endif
```

## package/dpdk/Config.in
```kconfig
config BR2_PACKAGE_DPDK_ARCH_SUPPORTS
	bool
	# DPDK can be used for the following little endian architecture
	default y if BR2_aarch64
	# DPDK requires SSE4.2 for x86_64 since v17.08
	default y if BR2_x86_64 && BR2_X86_CPU_HAS_SSE42

config BR2_PACKAGE_DPDK
	bool "dpdk"
	depends on BR2_PACKAGE_DPDK_ARCH_SUPPORTS
	depends on BR2_TOOLCHAIN_HAS_THREADS # DPDK design
	depends on BR2_USE_MMU # pthread() memory mappings
	depends on BR2_TOOLCHAIN_GCC_AT_LEAST_4_9 # C11/stdatomic.h
	depends on BR2_TOOLCHAIN_HEADERS_AT_LEAST_4_19
	depends on BR2_TOOLCHAIN_USES_GLIBC
	select BR2_PACKAGE_HOST_PYTHON3 # host-python-pyelftools
	help
	  DPDK (Data Plane Development Kit) is a set of libraries
	  and drivers for fast packet processing.

	  http://dpdk.org/

	  Optional but recommended kernel configurations:
	    - CONFIG_VFIO_IOMMU_TYPE1
	    - CONFIG_VFIO_VIRQFD
	    - CONFIG_VFIO
	    - CONFIG_VFIO_NOIOMMU
	    - CONFIG_VFIO_PCI
	    - CONFIG_VFIO_PCI_MMAP
	    - CONFIG_HUGETLBFS
	    - CONFIG_HUGETLB_PAGE
	    - CONFIG_PROC_PAGE_MONITOR

	  For x86 only, the following can also be useful:
	    - CONFIG_HPET
	    - CONFIG_HPET_MMAP

if BR2_PACKAGE_DPDK

config BR2_PACKAGE_DPDK_EXAMPLES
	bool "Install examples"

config BR2_PACKAGE_DPDK_TESTS
	bool "Install tests"

config BR2_PACKAGE_DPDK_DRIVERS_LIST
	string "List of enabled drivers"
	help
	  Controls which DPDK drivers are built.

	  Values:
	   (empty): use DPDK defaults
	   none   : build no drivers
	   list   : e.g. "net/virtio,net/intel/ixgbe"

	  To list possible drivers found in the DPDK source tree:
	    find drivers -mindepth 2 -maxdepth 3 -type d \
	    ! -printf '%P\n' | sort

	  Note: providing manually a list of dpdk drivers to enable
	  does not automatically enable its dependencies (internal or
	  external). It is the user responsiblity to add internal dpdk
	  dependencies in this list, and/or select the relevant
	  Buildroot packages for external dependencies. DPDK
	  configuration will fail in case of missing dependencies.

config BR2_PACKAGE_DPDK_LIBS_LIST
	string "List of enabled libraries"
	help
	  Controls which DPDK libraries are built.

	  Values:
	    (empty): use DPDK defaults
	    none   : build no libraries
	    list   : e.g. "hash,fib,rib"

	  To list all libraries found in the DPDK source tree:
	    find lib -mindepth 2 -maxdepth 2 -type f -name meson.build \
	      -printf '%h\n' | xargs -n1 basename | sort -u

	  Note: providing manually a list of dpdk libraries to enable
	  does not automatically enable its dependencies (internal or
	  external). It is the user responsiblity to add internal dpdk
	  dependencies in this list, and/or select the relevant
	  Buildroot packages for external dependencies. DPDK
	  configuration will fail in case of missing dependencies.

config BR2_PACKAGE_DPDK_APPS_LIST
	string "List of enabled applications"
	help
	  Controls which DPDK applications are built.

	  Values:
	    (empty): use DPDK defaults
	    none   : build no apps
	    list   : e.g. "test-cmdline,test-pmd"

	  To list all applications found in the DPDK source tree:
	    find app -mindepth 2 -maxdepth 2 -type f -name meson.build \
	      -printf '%h\n' | xargs -n1 basename | sort -u

	  Note: providing manually a list of dpdk libraries to enable
	  does not automatically enable its dependencies (internal or
	  external). It is the user responsiblity to add internal dpdk
	  dependencies in this list, and/or select the relevant
	  Buildroot packages for external dependencies. DPDK
	  configuration will fail in case of missing dependencies.

endif

comment "dpdk needs a glibc toolchain w/ threads, gcc >= 4.9, headers >= 4.19"
	depends on BR2_USE_MMU # pthread() memory mappings
	depends on BR2_PACKAGE_DPDK_ARCH_SUPPORTS
	depends on !BR2_TOOLCHAIN_HAS_THREADS || \
		!BR2_TOOLCHAIN_USES_GLIBC || \
		!BR2_TOOLCHAIN_GCC_AT_LEAST_4_9 || \
		!BR2_TOOLCHAIN_HEADERS_AT_LEAST_4_19
```

## package/dracut/Config.in.host
```kconfig
config BR2_PACKAGE_HOST_DRACUT
	bool
	select BR2_PACKAGE_HOST_KMOD
	help
	  dracut-ng is used to create an initramfs image by
	  copying tools and files from an installed system
	  and combining it with the dracut framework.
	  dracut-ng is a drop-in replacement for the legacy
	  dracut project.

	  https://github.com/dracut-ng/dracut-ng/wiki
```

## package/drm-info/Config.in
```kconfig
config BR2_PACKAGE_DRM_INFO
	bool "drm_info"
	depends on BR2_TOOLCHAIN_HAS_THREADS # libdrm
	select BR2_PACKAGE_JSON_C
	select BR2_PACKAGE_LIBDRM
	help
	  Small utility to dump info about DRM devices.

	  https://gitlab.freedesktop.org/emersion/drm_info

comment "drm_info needs a toolchain w/ threads"
	depends on !BR2_TOOLCHAIN_HAS_THREADS
```

## package/dsgccclient/Config.in
```kconfig
config BR2_PACKAGE_DSGCCCLIENT
    bool "DsgccClient"
    help
       WPE Platform Dsgcc Client plugin
```

## package/dtbocfg/Config.in
```kconfig
config BR2_PACKAGE_DTBOCFG
	bool "dtbocfg"
	depends on BR2_LINUX_KERNEL
	help
	  dtbocfg, which stands for Device Tree Blob Overlay
	  Configuration File System, was developed to serve
	  as a userspace API of Device Tree Overlay.

	  https://github.com/ikwzm/dtbocfg

comment "dtbocfg needs a Linux kernel to be built"
	depends on !BR2_LINUX_KERNEL
```
