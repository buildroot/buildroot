## package/wpa_supplicant/Config.in
```kconfig
menuconfig BR2_PACKAGE_WPA_SUPPLICANT
	bool "wpa_supplicant"
	depends on BR2_USE_MMU # fork()
	select BR2_PACKAGE_LIBOPENSSL_ENABLE_DES if BR2_PACKAGE_LIBOPENSSL
	select BR2_PACKAGE_LIBOPENSSL_ENABLE_MD4 if BR2_PACKAGE_LIBOPENSSL
	help
	  WPA supplicant for secure wireless networks

	  http://w1.fi/wpa_supplicant/

if BR2_PACKAGE_WPA_SUPPLICANT

config BR2_PACKAGE_WPA_SUPPLICANT_NL80211
	bool "Enable nl80211 support"
	default y
	depends on BR2_TOOLCHAIN_HAS_THREADS # libnl
	select BR2_PACKAGE_LIBNL
	help
	  Enable support for nl80211.  This is the current wireless
	  API for Linux, supported by all wireless drivers in vanilla
	  Linux, but may not be supported by some out-of-tree Linux
	  wireless drivers.  wpa_supplicant will still fall back to
	  using the Wireless Extensions (wext) API with these drivers.

	  If this option is disabled, then only the deprecated wext
	  API will be supported, with far less features.  Linux may
	  supports using wext with modern drivers using a
	  compatibility layer, but it must be enabled in the kernel
	  configuration.

comment "nl80211 support needs a toolchain w/ threads"
	depends on !BR2_TOOLCHAIN_HAS_THREADS

config BR2_PACKAGE_WPA_SUPPLICANT_WEXT
	bool "Enable wext (deprecated)"
	default y if !BR2_TOOLCHAIN_HAS_THREADS
	help
	  Enable support for wext.  This is the historic wireless API
	  for Linux, which is now deprecated and in maintenance-only in
	  the kernel.  It may still be required by out-of-tree drivers.

config BR2_PACKAGE_WPA_SUPPLICANT_WIRED
	bool "Enable wired support"
	depends on BR2_TOOLCHAIN_HAS_THREADS # libnl
	depends on BR2_TOOLCHAIN_HEADERS_AT_LEAST_4_6
	select BR2_PACKAGE_LIBNL
	select BR2_PACKAGE_WPA_SUPPLICANT_EAP
	help
	  Include the "wired" driver, so the internal IEEE 802.1x
	  supplicant can be used with Ethernet.  This also enables
	  support for MACSEC.

comment "wired macsec support needs a toolchain w/ headers >= 4.6"
	depends on !BR2_TOOLCHAIN_HEADERS_AT_LEAST_4_6

comment "wired support needs a toolchain w/ threads"
	depends on !BR2_TOOLCHAIN_HAS_THREADS

comment "wpa_supplicant will be useless without at least one driver"
	depends on !BR2_PACKAGE_WPA_SUPPLICANT_NL80211 && \
		!BR2_PACKAGE_WPA_SUPPLICANT_WEXT && \
		!BR2_PACKAGE_WPA_SUPPLICANT_WIRED

config BR2_PACKAGE_WPA_SUPPLICANT_IBSS_RSN
	bool "Enable IBSS RSN"
	depends on BR2_PACKAGE_WPA_SUPPLICANT_NL80211
	help
	  Enable support for RSN/WPA2 in Ad-Hoc mode.

config BR2_PACKAGE_WPA_SUPPLICANT_AP_SUPPORT
	bool "Enable AP mode"
	depends on BR2_PACKAGE_WPA_SUPPLICANT_NL80211
	help
	  With this option enabled, wpa_supplicant can act as an
	  access point much like hostapd does with a limited feature
	  set.  This links in parts of hostapd functionality into
	  wpa_supplicant, making it bigger but dispensing the need for
	  a separate hostapd binary in some applications hence being
	  smaller overall.  It also enables support for Wi-Fi Direct.

config BR2_PACKAGE_WPA_SUPPLICANT_WIFI_DISPLAY
	bool "Enable Wi-Fi Display"
	depends on BR2_PACKAGE_WPA_SUPPLICANT_AP_SUPPORT
	help
	  Enable support for Wi-Fi Display

config BR2_PACKAGE_WPA_SUPPLICANT_MESH_NETWORKING
	bool "Enable mesh networking"
	depends on BR2_PACKAGE_WPA_SUPPLICANT_AP_SUPPORT
	select BR2_PACKAGE_OPENSSL
	select BR2_PACKAGE_OPENSSL_FORCE_LIBOPENSSL
	help
	  Enable support for open and secured mesh networking
	  (IEEE 802.11s)

config BR2_PACKAGE_WPA_SUPPLICANT_OVERRIDES
	bool "Enable HT/VHT/HE overrides"
	help
	  Enable wpa_supplicant overrides for HT, VHT and HE (disable
	  HT/HT40, mask MCS rates, etc.) in wpa_supplicant
	  configuration file.

config BR2_PACKAGE_WPA_SUPPLICANT_AUTOSCAN
	bool "Enable autoscan"
	help
	  Enable support for the autoscan feature (allow periodic scan)

config BR2_PACKAGE_WPA_SUPPLICANT_EAP
	bool "Enable EAP"
	help
	  Enable support for EAP, 802.1x/WPA-Enterprise and FILS.

config BR2_PACKAGE_WPA_SUPPLICANT_HOTSPOT
	bool "Enable HS20"
	select BR2_PACKAGE_WPA_SUPPLICANT_EAP
	help
	  Enable Hotspot 2.0 and IEEE 802.11u interworking
	  functionality.

config BR2_PACKAGE_WPA_SUPPLICANT_DEBUG_SYSLOG
	bool "Enable syslog support"
	help
	  Enable support for sending debug messages to syslog.

config BR2_PACKAGE_WPA_SUPPLICANT_WPS
	bool "Enable WPS"
	help
	  Enable support for Wi-Fi Protected Setup (WPS).

config BR2_PACKAGE_WPA_SUPPLICANT_WPA3
	bool "Enable WPA3 support"
	select BR2_PACKAGE_OPENSSL
	select BR2_PACKAGE_OPENSSL_FORCE_LIBOPENSSL
	help
	  Enable WPA3 support including OWE, SAE, DPP

config BR2_PACKAGE_WPA_SUPPLICANT_CLI
	bool "Install wpa_cli binary"
	select BR2_PACKAGE_WPA_SUPPLICANT_CTRL_IFACE
	help
	  Install wpa_cli command line utility

config BR2_PACKAGE_WPA_SUPPLICANT_WPA_CLIENT_SO
	bool "Install wpa_client shared library"
	depends on !BR2_STATIC_LIBS
	help
	  Install libwpa_client.so.

comment "wpa_client library needs a toolchain w/ dynamic library"
	depends on BR2_STATIC_LIBS

config BR2_PACKAGE_WPA_SUPPLICANT_PASSPHRASE
	bool "Install wpa_passphrase binary"
	help
	  Install wpa_passphrase command line utility.

config BR2_PACKAGE_WPA_SUPPLICANT_CTRL_IFACE
	bool "Enable the Unix-socket control interface"
	help
	  Enable support for the Unix-socket-based API.

config BR2_PACKAGE_WPA_SUPPLICANT_DBUS
	bool "Enable support for the DBus control interface"
	depends on BR2_TOOLCHAIN_HAS_THREADS # dbus
	select BR2_PACKAGE_DBUS
	help
	  Enable support for the DBus control interface.

comment "dbus support needs a toolchain w/ threads"
	depends on !BR2_TOOLCHAIN_HAS_THREADS

config BR2_PACKAGE_WPA_SUPPLICANT_DBUS_INTROSPECTION
	bool "Introspection support"
	depends on BR2_PACKAGE_WPA_SUPPLICANT_DBUS
	help
	  Add introspection support for the DBus control interface.

config BR2_PACKAGE_WPA_SUPPLICANT_SMARTCARD
	bool "Smartcard support"
	select BR2_PACKAGE_OPENSSL
	select BR2_PACKAGE_OPENSSL_FORCE_LIBOPENSSL
	help
	  Enable the smart card support. Required for OpenSSL engines
	  to work using PKCS11 and 802.1x

config BR2_PACKAGE_WPA_SUPPLICANT_WEP
	bool "Enable WEP support (deprecated)"
	help
	  Enable support for WEP. WEP support is deprecated due to
	  security concerns, but some systems may want to support WEP
	  networks.

endif
```

## package/wpe-launcher/Config.in
```kconfig
config BR2_PACKAGE_WPE_LAUNCHER
	bool "wpe-launcher"
	depends on BR2_PACKAGE_WPE
	help
	  WPE launcher app.
```

## package/wpe/Config.in
```kconfig
# WPE Framework
source "package/wpe/wpeframework/Config.in"

# WPE Framework Generators
source "package/wpe/wpeframework-tools/Config.in"

# WPE WebKit
source "package/wpe/wpewebkit/Config.in"

if BR2_PACKAGE_WPEWEBKIT
source "package/wpe/wpebackend/Config.in"
source "package/wpe/wpebackend-rdk/Config.in"
endif
```

## package/wpe/wpebackend-rdk/Config.in
```kconfig
config BR2_PACKAGE_WPEBACKEND_RDK
	bool "wpebackend-rdk"
    select BR2_PACKAGE_WAYLAND_EGL_BNXS if BR2_PACKAGE_HAS_NEXUS && BR2_PACKAGE_WESTEROS
	help
	  RDK-specific implementations of the WPEBackend interfaces.

if BR2_PACKAGE_WPEBACKEND_RDK

config BR2_PACKAGE_WPEBACKEND_RDK_ADDITIONAL_PATCHES
    bool "wpebackend-rdk additional patches"
    default n

config BR2_PACKAGE_WPEBACKEND_RDK_INPUT_VIRTUALKBD
	bool
	default y if !BR2_PACKAGE_WPEBACKEND_RDK_BACK_WPEFRAMEWORK && \
		(BR2_PACKAGE_GLUELOGIC_VIRTUAL_KEYBOARD || BR2_PACKAGE_WPEFRAMEWORK_VIRTUALINPUT)

choice
    prompt Backend

config BR2_PACKAGE_WPEBACKEND_RDK_BACK_BCM_NEXUS
	bool "bcm-nexus"
	depends on BR2_PACKAGE_HAS_NEXUS
	depends on !BR2_PACKAGE_BCM_WESTON
	select BR2_PACKAGE_LIBINPUT if !BR2_PACKAGE_WPEFRAMEWORK_VIRTUALINPUT

config BR2_PACKAGE_WPEBACKEND_RDK_BACK_BCM_NEXUS_WAYLAND
	bool "bcm-nexus-wayland"
	depends on BR2_PACKAGE_HAS_NEXUS
	depends on BR2_PACKAGE_BCM_WESTON

config BR2_PACKAGE_WPEBACKEND_RDK_BACK_BCM_RPI
	bool "bcm-rpi"
	depends on BR2_PACKAGE_RPI_USERLAND
	depends on !BR2_PACKAGE_HAS_NEXUS
	select BR2_PACKAGE_LIBINPUT if !BR2_PACKAGE_WPEFRAMEWORK_VIRTUALINPUT

config BR2_PACKAGE_WPEBACKEND_RDK_BACK_INTEL_CE
	bool "intel-ce"
	depends on BR2_PACKAGE_HORIZON_SDK || BR2_PACKAGE_INTELCE_SDK

config BR2_PACKAGE_WPEBACKEND_RDK_BACK_WAYLAND_EGL
	bool "wayland-egl"
	depends on BR2_PACKAGE_KYLIN_GRAPHICS

config BR2_PACKAGE_WPEBACKEND_RDK_BACK_WESTEROS
	bool "westeros"
	depends on !BR2_PACKAGE_WPEFRAMEWORK_COMPOSITORCLIENT
	depends on BR2_PACKAGE_WESTEROS

config BR2_PACKAGE_WPEBACKEND_RDK_BACK_WPEFRAMEWORK
	bool "wpeframework"
	depends on BR2_PACKAGE_WPEFRAMEWORK_COMPOSITORCLIENT

endchoice

endif
```

## package/wpe/wpebackend/Config.in
```kconfig
comment "libwpe needs a toolchain w/ C++, dynamic library and an OpenEGL-capable backend"
	depends on !BR2_PACKAGE_HAS_LIBEGL || !BR2_INSTALL_LIBSTDCPP || BR2_STATIC_LIBS

config BR2_PACKAGE_WPEBACKEND_LIBWPE_VERSION
	string
	default "1.6.0" if BR2_PACKAGE_WPEWEBKIT2_28
	default "1.14.0" if BR2_PACKAGE_WPEWEBKIT2_38

config BR2_PACKAGE_WPEBACKEND
	bool "wpebackend"
	depends on !BR2_STATIC_LIBS # dlfcn.h
	depends on BR2_INSTALL_LIBSTDCPP
	depends on BR2_PACKAGE_HAS_LIBEGL
	select BR2_PACKAGE_LIBXKBCOMMON
	help
	  Base library for the WPE port of WebKit.

	  https://wpewebkit.org/
```

## package/wpe/wpeframework-amazon/Config.in
```kconfig
menuconfig BR2_PACKAGE_WPEFRAMEWORK_AMAZON
    depends on BR2_PACKAGE_AMAZON_IGNITION 
	bool "Amazon"
	help
	   WPE Platform plugins that supports Amazon prime video service.

if BR2_PACKAGE_WPEFRAMEWORK_AMAZON
# options for the plugin
menu "Box Configuration"
config BR2_PACKAGE_WPEFRAMEWORK_AMAZON_DTID
	string "DTID"
	default "UnknownDTID"
    help
        DTID will be provided by amazon, test DTID's can be found in docs on the partner central

config BR2_PACKAGE_WPEFRAMEWORK_AMAZON_MODEL
	string "model name"
	default "UnknownModel"

config BR2_PACKAGE_WPEFRAMEWORK_AMAZON_MANUFACTURER
	string "manufacturer"
	default "UnknownManufacturer"

config BR2_PACKAGE_WPEFRAMEWORK_AMAZON_CHIPSET
	string "chipset"
	default "UnknownChipset"

config BR2_PACKAGE_WPEFRAMEWORK_AMAZON_USER
	string "user"
    help
        The user that amazon prime should use (root is not allowed)

config BR2_PACKAGE_WPEFRAMEWORK_AMAZON_GROUP
	string "group"
	default BR2_PACKAGE_WPEFRAMEWORK_AMAZON_USER
    help
        The group that amazon prime user should use (root is not allowed)

config BR2_PACKAGE_WPEFRAMEWORK_AMAZON_CA_BUNDLE_PATH
	string "ca bundle path"
    help
        Path where ca-certificate.crt is located

config BR2_PACKAGE_WPEFRAMEWORK_AMAZON_FRAGMENT_CACHE_SIZE
	string "Fragment cache size (MB)"
    help
        Fragment cache size in MB
        
endmenu

config BR2_PACKAGE_WPEFRAMEWORK_AMAZON_AUTOSTART
    depends on BR2_PACKAGE_WPEFRAMEWORK_AMAZON
    bool "autostart"
    default n

config BR2_PACKAGE_WPEFRAMEWORK_AMAZON_INSTALL_PATH_OVERRIDE
	string "override instalation path in config"
	default ""
    help
        Override the installation path of ignition binaries in the configuration json.
        leave empty to use path set by amazon-ignition
        
config BR2_PACKAGE_WPEFRAMEWORK_AMAZON_LOG_LEVEL
	string "Default log level"
	default "ALL:ERROR"
    help
        Default log level 
        
        '<category>:<level>,<category>:<level>,...'
        
        Category values
        Category values are those listed in the LogCategory enum but WITHOUT the LOG_CAT_ prefix. 
        Below are a few valid category values for examples 
        
        DOWNLOADER | RESOURCE_MANAGER | DISK_STORAGE | ALL

        Level values
        CRITICAL | ERROR | WARNING | INFO | DEBUG.
        
        e.g "DOWNLOADER:INFO,AVPK:DEBUG"
        
        INFO and DEBUG only enable if BR2_PACKAGE_AMAZON_IGNITION_DEVELOPER_MODE is set
endif
```

## package/wpe/wpeframework-avnclient/Config.in
```kconfig
config BR2_PACKAGE_WPEFRAMEWORK_AVNCLIENT
	bool "AVNClient"
	depends on BR2_PACKAGE_AVN_CLIENT
	help
	   WPE Platform AVNClient plugin
```

## package/wpe/wpeframework-avs/Config.in
```kconfig
menuconfig BR2_PACKAGE_WPEFRAMEWORK_AVS
  bool "AVS"
  select BR2_PACKAGE_AVS_DEVICE_SDK
  select BR2_PACKAGE_AVS_DEVICE_SDK_BUILD_GST_MEDIA_PLAYER
  help
    Thunder Alexa Voice Service Plugin

if BR2_PACKAGE_WPEFRAMEWORK_AVS
  config BR2_PACKAGE_WPEFRAMEWORK_AVS_PLUGIN_NAME
    string "Plugin Name"
    default "AVS"
    help
      The plugin name

  config BR2_PACKAGE_WPEFRAMEWORK_AVS_AUTOSTART
    bool "Autostart"
    help
      Autostart the AVS plugin

  choice BR2_PACKAGE_WPEFRAMEWORK_AVS_PLATFORM
    bool "Platform"
    default BR2_PACKAGE_WPEFRAMEWORK_AVS_PLATFORM_RPI3
      config BR2_PACKAGE_WPEFRAMEWORK_AVS_PLATFORM_RPI3
        bool "rpi3"
      config BR2_PACKAGE_WPEFRAMEWORK_AVS_PLATFORM_CUSTOM
        bool "Custom"

  endchoice

  if BR2_PACKAGE_WPEFRAMEWORK_AVS_PLATFORM_CUSTOM
    config BR2_PACKAGE_WPEFRAMEWORK_AVS_PLATFORM_CUSTOM_VALUE
      string "Custom platform"
      help
        Name of the custom platform

  endif

  config BR2_PACKAGE_WPEFRAMEWORK_AVS_DATA_PATH
    string "Data path"
    default BR2_PACKAGE_WPEFRAMEWORK_DATA_PATH
    help
      Path where AVS read only data will be stored

  config BR2_PACKAGE_WPEFRAMEWORK_AVS_CUSTOM_ALEXA_CLIENT_CONFIG
    string "Custom Alexa Client Config"
    help
      Custom path to configuration file for the Alexa Client

  config BR2_PACKAGE_WPEFRAMEWORK_AVS_CUSTOM_SMART_SCREEN_CONFIG
    string "Custom Smart Screen Config"
    help
      Custom path to configuration file for the Smart Screen

  choice BR2_PACKAGE_WPEFRAMEWORK_AVS_LOG_LEVEL
    bool "Log level"
    default BR2_PACKAGE_WPEFRAMEWORK_AVS_LOG_LEVEL_CRITICAL
      config BR2_PACKAGE_WPEFRAMEWORK_AVS_LOG_LEVEL_NONE
        bool "None"
      config BR2_PACKAGE_WPEFRAMEWORK_AVS_LOG_LEVEL_CRITICAL
        bool "Critical"
      config BR2_PACKAGE_WPEFRAMEWORK_AVS_LOG_LEVEL_ERROR
        bool "Error"
      config BR2_PACKAGE_WPEFRAMEWORK_AVS_LOG_LEVEL_WARN
        bool "Warning"
      config BR2_PACKAGE_WPEFRAMEWORK_AVS_LOG_LEVEL_DEBUG0
        bool "Debug0"
      config BR2_PACKAGE_WPEFRAMEWORK_AVS_LOG_LEVEL_DEBUG9
        bool "Debug9"
  endchoice

  config BR2_PACKAGE_WPEFRAMEWORK_AVS_ENABLE_PORTAUDIO_SUPPORT
    bool "Enable Portaudio support"
    select BR2_PACKAGE_PORTAUDIO
    default n
    help
      Compile in support for the Portaudio input

  choice BR2_PACKAGE_WPEFRAMEWORK_AVS_AUDIOSOURCE
    bool "Audiosource"
    default BR2_PACKAGE_WPEFRAMEWORK_AVS_AUDIOSOURCE_PORTAUDIO
      config BR2_PACKAGE_WPEFRAMEWORK_AVS_AUDIOSOURCE_PORTAUDIO
        bool "Portaudio"
      config BR2_PACKAGE_WPEFRAMEWORK_AVS_AUDIOSOURCE_BLRC
        bool "BluetoothRemoteControl"
      config BR2_PACKAGE_WPEFRAMEWORK_AVS_AUDIOSOURCE_CUSTOM
        bool "Custom"
  endchoice

  if BR2_PACKAGE_WPEFRAMEWORK_AVS_AUDIOSOURCE_CUSTOM
    config BR2_PACKAGE_WPEFRAMEWORK_AVS_AUDIOSOURCE_CUSTOM_VALUE
      string "Custom Audiosource value"
  endif

  config BR2_PACKAGE_WPEFRAMEWORK_AVS_ENABLE_SMART_SCREEN_SUPPORT
    bool "Enable Smart Screen Support"
    select BR2_PACKAGE_ALEXA_SMART_SCREEN_SDK
    default y
    help
      Compile in the Smart Screen support

  if BR2_PACKAGE_WPEFRAMEWORK_AVS_ENABLE_SMART_SCREEN_SUPPORT
    config BR2_PACKAGE_WPEFRAMEWORK_AVS_ENABLE_SMART_SCREEN
      bool "Enable Smart Screen in runtime"
      default n
      help
        Enables the Smart Screen in the runtime
  endif

  config BR2_PACKAGE_WPEFRAMEWORK_AVS_ENABLE_KWD_SUPPORT
    bool "Enable KWD Support"
    select BR2_PACKAGE_ALEXA_PRYON_KWD
    default n
    help
      Compile in the Keyword Detection engine support

  if BR2_PACKAGE_WPEFRAMEWORK_AVS_ENABLE_KWD_SUPPORT
    config BR2_PACKAGE_WPEFRAMEWORK_AVS_ENABLE_KWD
      bool "Enable KWD in runtime"
      default n
      help
        Enables the Keyword Detection engine in the runtime

    config BR2_PACKAGE_WPEFRAMEWORK_AVS_CUSTOM_KWD_MODELS_PATH
      string "Custom KWD models path"
      help
        Custom path to the models directory for KWD
  endif

endif
```
