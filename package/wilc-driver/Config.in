## package/wpe/wpeframework-cdmi/Config.in
```kconfig
if BR2_PACKAGE_HAS_NEXUS_SAGE
config	BR2_PACKAGE_WPEFRAMEWORK_CDMI_SOFTWARE_OVERRIDE
	bool "software decryption"
        depends on BR2_PACKAGE_HAS_NEXUS_SAGE || BR2_PACKAGE_VSS_SDK
	default y
	help
	  By default, if a secure path is available on the platform, the DRM module capable of 
          decrypting in the TEE is selected. Selecting this option will always, if available,
          select a software decryption DRM module, over the TEE version. 
          NOTE: Software and TEE DRM module can *NOT* be used together.
endif

if !BR2_PACKAGE_HAS_NEXUS_SAGE && !BR2_PACKAGE_VSS_SDK
config	BR2_PACKAGE_WPEFRAMEWORK_CDMI_SOFTWARE_OVERRIDE
	default y
	bool
endif

source "package/wpe/wpeframework-cdmi/ClearkeyConfig.in"
source "package/wpe/wpeframework-cdmi/PlayreadyConfig.in"
source "package/wpe/wpeframework-cdmi/WidevineConfig.in"
source "package/wpe/wpeframework-cdmi/NagraConfig.in"
source "package/wpe/wpeframework-cdmi/NCASConfig.in"
```

## package/wpe/wpeframework-cdmi/wpeframework-cdmi-broadcom/Config.in
```kconfig
config BR2_PACKAGE_WPEFRAMEWORK_CDMI_BROADCOM
	bool "broadcom"
	select BR2_PACKAGE_WPEFRAMEWORK_PLUGINS
	select BR2_PACKAGE_WPEFRAMEWORK_CDM
	default n
	help
	  Broadcom
```

## package/wpe/wpeframework-cdmi/wpeframework-cdmi-clearkey/Config.in
```kconfig
config BR2_PACKAGE_WPEFRAMEWORK_CDMI_CLEARKEY
	bool "clearkey"
	select BR2_PACKAGE_WPEFRAMEWORK_PLUGINS
	select BR2_PACKAGE_WPEFRAMEWORK_CDM
	help
	  Clearkey
```

## package/wpe/wpeframework-cdmi/wpeframework-cdmi-nagra/Config.in
```kconfig
config BR2_PACKAGE_WPEFRAMEWORK_CDMI_NAGRA
	bool "nagra"
	select BR2_PACKAGE_WPEFRAMEWORK_PLUGINS
	select BR2_PACKAGE_WPEFRAMEWORK_CDM
	default n
	help
	 Nagra 
```

## package/wpe/wpeframework-cdmi/wpeframework-cdmi-ncas/Config.in
```kconfig
config BR2_PACKAGE_WPEFRAMEWORK_CDMI_NCAS
	bool "ncas"
	select BR2_PACKAGE_WPEFRAMEWORK_PLUGINS
	select BR2_PACKAGE_WPEFRAMEWORK_CDM
	default n
	help
	  Downloadable Native CAS
```

## package/wpe/wpeframework-cdmi/wpeframework-cdmi-playready-nexus-svp/Config.in
```kconfig
config BR2_PACKAGE_WPEFRAMEWORK_CDMI_PLAYREADY_NEXUS_SVP
	bool "broadcom svp/sage"
	select BR2_PACKAGE_WPEFRAMEWORK_PLUGINS
	select BR2_PACKAGE_WPEFRAMEWORK_CDM
        select BR2_PACKAGE_HAS_PLAYREADY
        depends on BR2_PACKAGE_BCM_REFSW || BR2_PACKAGE_HAS_NEXUS
        depends on BR2_PACKAGE_BCM_REFSW_SAGE || BR2_PACKAGE_HAS_NEXUS_SAGE
	default n
	help
	  Broadcom Playready SVP SAGE implementation

if BR2_PACKAGE_WPEFRAMEWORK_CDMI_PLAYREADY_NEXUS_SVP

config BR2_PACKAGE_WPEFRAMEWORK_CDMI_PLAYREADY_NEXUS_SVP_ENABLE
    bool "Use SVP"
    default y
    depends on BR2_PACKAGE_BCM_REFSW_SAGE || BR2_PACKAGE_HAS_NEXUS_SAGE
    help
      Use SVP enabled

endif
```

## package/wpe/wpeframework-cdmi/wpeframework-cdmi-playready-nexus/Config.in
```kconfig
config BR2_PACKAGE_WPEFRAMEWORK_CDMI_PLAYREADY_NEXUS
	bool "playready"
	select BR2_PACKAGE_WPEFRAMEWORK_PLUGINS
	select BR2_PACKAGE_WPEFRAMEWORK_CDM
	default n
	help
	  Broadcom Playready DRM
```
