## package/wilc-driver/Config.in
```kconfig
config BR2_PACKAGE_WILC_DRIVER
	bool "wilc kernel module"
	depends on BR2_LINUX_KERNEL
	help
	  External kernel module for WILC1000/3000 devices.

	  wilc kernel driver source as found in Microchip's at91-linux
	  kernel tree with added Kbuild file to be built as a generic
	  external module.

	  The wilc1000 driver currently maintained in Linux kernel does
	  not support BLE of the WILC3000 hardware. This package is
	  meant to bridge that gap until Microchip can get WILC3000
	  support upstream.

	  Supports both SDIO and SPI modes.

	  https://github.com/embeddedTS/wilc3000-external-module

comment "wilc kernel module needs a Linux kernel to be built"
	depends on !BR2_LINUX_KERNEL

if BR2_PACKAGE_WILC_DRIVER

config BR2_PACKAGE_WILC_DRIVER_SPI
	bool "SPI"
	help
	  This module adds support for the SPI interface of adapters
	  using WILC1000/3000 chipset. The WILC1000/3000 has a Serial
	  Peripheral Interface (SPI) that operates as an SPI slave.
	  This SPI interface can be used for control and for serial
	  I/O of 802.11 data. The SPI is a full-duplex slave
	  synchronous serial interface that is available immediately
	  following reset when pin 9 (SDIO_SPI_CFG) is tied to VDDIO.
	  Select this if your platform is using the SPI bus.

config BR2_PACKAGE_WILC_DRIVER_SDIO
	bool "SDIO"
	help
	  This module adds support for the SDIO interface of adapters
	  using WILC1000/3000 chipset. The WILC1000/3000 SDIO is a full
	  speed interface. It meets SDIO card specification version 2.0.
	  The interface supports the 1-bit/4-bit SD transfer mode at the
	  clock range of 0-50 MHz. The host can use this interface to
	  read and write from any register within the chip as well as
	  configure the WILC1000/3000 for data DMA. To use this
	  interface, pin9 (SDIO_SPI_CFG) must be grounded. Select this
	  if your platform is using the SDIO bus.

if BR2_PACKAGE_WILC_DRIVER_SDIO

config BR2_PACKAGE_WILC_DRIVER_SDIO_OOB
	bool "Enable out-of-band interrupt"
	help
	  This option enables out-of-band interrupt support for the
	  WILC1000/3000 chipset. This OOB interrupt is intended to
	  provide a faster interrupt mechanism for SDIO host controllers
	  that don't support SDIO interrupt. Select this option If the
	  SDIO host controller in your platform doesn't support SDIO
	  time division interrupt.
endif
endif
```

## package/wilc-firmware/Config.in
```kconfig
config BR2_PACKAGE_WILC_FIRMWARE
	bool
	help
	  Provider package for WILC1000_FIRMWARE & WILC3000_FIRMWARE

config BR2_PACKAGE_WILC1000_FIRMWARE
	bool "wilc1000-firmware"
	select BR2_PACKAGE_WILC_FIRMWARE
	help
	  Firmware for Microchip WILC1000 wireless device

	  These binary blobs are provided directly from Microchip.
	  Ideally, the firmware version should match driver version.
	  Generally, the latest firmware would be acceptable regardless
	  of driver version.

	  These will be installed to /lib/firmware/mchp/

	  https://github.com/linux4wilc/firmware

config BR2_PACKAGE_WILC3000_FIRMWARE
	bool "wilc3000-firmware"
	select BR2_PACKAGE_WILC_FIRMWARE
	help
	  Firmware for Microchip WILC3000 wireless device

	  These binary blobs are provided directly from Microchip.
	  Ideally, the firmware version should match driver version.
	  Generally, the latest firmware would be acceptable regardless
	  of driver version.

	  These will be installed to /lib/firmware/mchp/

	  https://github.com/linux4wilc/firmware
```

## package/wilc1000-firmware/Config.in
```kconfig
config BR2_PACKAGE_WILC1000_FIRMWARE
	bool "wilc1000-firmware"
	help
	  Firmware for Microchip WILC1000 wireless device

	  These binary blobs are provided directly from Microchip.
	  Ideally, the firmware version should match driver version.
	  Generally, the latest firmware would be acceptible regardless
	  of driver version.

	  These will be installed to /lib/firmware/mchp/

	  https://github.com/linux4wilc/firmware

if BR2_PACKAGE_WILC1000_FIRMWARE
config BR2_PACKAGE_WILC3000_FIRMWARE
	bool "wilc3000-firmware"
	help
	  Firmware for Microchip WILC3000 wireless device

	  These binary blobs are provided directly from Microchip.
	  Ideally, the firmware version should match driver version.
	  Generally, the latest firmware would be acceptible regardless
	  of driver version.

	  These will be installed to /lib/firmware/mchp/

	  https://github.com/linux4wilc/firmware
endif
```

## package/wireless_tools/Config.in
```kconfig
config BR2_PACKAGE_WIRELESS_TOOLS
	bool "wireless tools"
	select BR2_PACKAGE_WIRELESS_TOOLS_IWCONFIG if \
		!BR2_PACKAGE_WIRELESS_TOOLS_IFRENAME && \
		!BR2_PACKAGE_WIRELESS_TOOLS_LIB
	help
	  A collection of tools to configure wireless lan cards.

	  https://hewlettpackard.github.io/wireless-tools/

if BR2_PACKAGE_WIRELESS_TOOLS

config BR2_PACKAGE_WIRELESS_TOOLS_IWCONFIG
	bool "Install tools"
	default y
	help
	  Build and install the iwconfig, iwlist, iwspy, iwpriv, and
	  iwgetid tools.

config BR2_PACKAGE_WIRELESS_TOOLS_IFRENAME
	bool "Install ifrename"
	help
	  Build and install the ifrename tool

config BR2_PACKAGE_WIRELESS_TOOLS_LIB
	bool "Install shared library"
	depends on !BR2_STATIC_LIBS
	help
	  The shared library of wireless tools

endif
```

## package/wireplumber/Config.in
```kconfig
config BR2_PACKAGE_WIREPLUMBER
	bool "wireplumber"
	depends on BR2_PACKAGE_PIPEWIRE
	depends on BR2_PACKAGE_LUA_5_3 || BR2_PACKAGE_LUA_5_4
	depends on BR2_USE_WCHAR # libglib2
	depends on BR2_TOOLCHAIN_HAS_THREADS # libglib2
	depends on BR2_USE_MMU # libglib2
	select BR2_PACKAGE_LIBGLIB2
	help
	  WirePlumber is a modular session / policy manager for
	  PipeWire and a GObject-based high-level library that
	  wraps PipeWire’s API, providing convenience for writing
	  the daemon’s modules as well as external tools for
	  managing PipeWire.

	  https://pipewire.pages.freedesktop.org/wireplumber/

comment "wireplumber needs a toolchain w/ wchar, threads and Lua >= 5.3"
	depends on BR2_PACKAGE_PIPEWIRE
	depends on BR2_USE_MMU
	depends on !BR2_USE_WCHAR || !BR2_TOOLCHAIN_HAS_THREADS || \
		(!BR2_PACKAGE_LUA_5_3 && !BR2_PACKAGE_LUA_5_4)
```

## package/wiringnp/Config.in
```kconfig
config BR2_PACKAGE_WIRINGNP
	bool "wiringnp"
	depends on !BR2_STATIC_LIBS
	depends on BR2_USE_MMU # fork()
	depends on BR2_TOOLCHAIN_HAS_THREADS
	help
	  wiringNP libraries (and gpio command)

	  https://github.com/friendlyarm/WiringNP

comment "wiringnp needs a toolchain w/ threads, dynamic library"
	depends on BR2_USE_MMU
	depends on BR2_STATIC_LIBS || !BR2_TOOLCHAIN_HAS_THREADS
```

## package/wlr-randr/Config.in
```kconfig
config BR2_PACKAGE_WLR_RANDR
	bool "wlr-randr"
	depends on BR2_PACKAGE_WAYLAND # wayland-client
	help
	  Utility to manage outputs of a Wayland compositor.

	  https://gitlab.freedesktop.org/emersion/wlr-randr
```

## package/wlroots/Config.in
```kconfig
comment "wlroots needs udev, EGL w/ Wayland backend and OpenGL ES support"
	depends on !BR2_PACKAGE_HAS_LIBEGL || \
		!BR2_PACKAGE_HAS_LIBEGL_WAYLAND || \
		!BR2_PACKAGE_HAS_LIBGLES || \
		!BR2_PACKAGE_HAS_UDEV

comment "wlroots needs a toolchain w/ threads, dynamic library"
	depends on !BR2_TOOLCHAIN_HAS_THREADS || \
		BR2_STATIC_LIBS

config BR2_PACKAGE_WLROOTS
	bool "wlroots"
	depends on !BR2_STATIC_LIBS # wayland
	depends on BR2_TOOLCHAIN_HAS_THREADS # libdrm, wayland
	depends on BR2_PACKAGE_HAS_UDEV # libinput
	depends on BR2_PACKAGE_HAS_LIBEGL
	depends on BR2_PACKAGE_HAS_LIBEGL_WAYLAND
	depends on BR2_PACKAGE_HAS_LIBGLES
	select BR2_PACKAGE_LIBDRM
	select BR2_PACKAGE_LIBINPUT
	select BR2_PACKAGE_LIBXKBCOMMON
	select BR2_PACKAGE_PIXMAN
	select BR2_PACKAGE_SEATD
	select BR2_PACKAGE_WAYLAND
	select BR2_PACKAGE_WAYLAND_PROTOCOLS
	help
	  wlroots is a modular Wayland library for building compositors
	  which implements many of their common features.

	  https://gitlab.freedesktop.org/wlroots/wlroots

if BR2_PACKAGE_WLROOTS

config BR2_PACKAGE_WLROOTS_X11
	bool "X11 backend"
	depends on BR2_PACKAGE_XORG7
	select BR2_PACKAGE_LIBXCB
	select BR2_PACKAGE_XCB_UTIL_RENDERUTIL
	select BR2_PACKAGE_XCB_UTIL_WM
	select BR2_PACKAGE_XLIB_LIBX11
	help
	  Support Wayland sessions nested inside a X11 window

config BR2_PACKAGE_WLROOTS_XWAYLAND
	bool "XWayland support"
	depends on BR2_PACKAGE_XORG7 # libxcb, xcb-util-wm, xwayland
	depends on BR2_USE_MMU # xwayland
	depends on !BR2_STATIC_LIBS # xwayland
	depends on BR2_TOOLCHAIN_HAS_THREADS # xwayland
	depends on !BR2_RISCV_32 # xwayland -> xlib_libxshmfence
	depends on BR2_TOOLCHAIN_HAS_SYNC_4 # xwayland -> xlib_libxshmfence
	select BR2_PACKAGE_LIBXCB
	select BR2_PACKAGE_XCB_UTIL_WM
	select BR2_PACKAGE_XWAYLAND
	help
	  Support for running X11 applications under wayland

comment "XWayland support needs X.org enabled"
	depends on !BR2_PACKAGE_XORG7

comment "XWayland support needs a toolchain w/ threads, dynamic library"
	depends on BR2_USE_MMU
	depends on !BR2_RISCV_32
	depends on BR2_TOOLCHAIN_HAS_SYNC_4
	depends on !BR2_TOOLCHAIN_HAS_THREADS || BR2_STATIC_LIBS

endif
```

## package/wolfssl/Config.in
```kconfig
config BR2_PACKAGE_WOLFSSL_ASM_SUPPORTS
	bool
	default y if BR2_aarch64
	default y if BR2_arm || BR2_armeb
	default y if BR2_powerpc
	default y if BR2_powerpc64 || BR2_powerpc64le
	default y if BR2_mips64 && !BR2_MIPS_CPU_MIPS32R6
	default y if BR2_mips64el && !BR2_MIPS_CPU_MIPS32R6
	default y if BR2_mips || BR2_mipsel
	default y if BR2_riscv && BR2_RISCV_ISA_RVM
	default y if BR2_s390x

config BR2_PACKAGE_WOLFSSL
	bool "wolfssl"
	depends on BR2_TOOLCHAIN_HAS_THREADS
	help
	  The wolfSSL embedded SSL library (formerly CyaSSL) is a
	  lightweight, portable, C-language-based SSL/TLS library
	  targeted at IoT, embedded, and RTOS environments primarily
	  because of its size, speed, and feature set.

	  https://www.wolfssl.com/

if BR2_PACKAGE_WOLFSSL

config BR2_PACKAGE_WOLFSSL_ALL
	bool "enable all features, except SSLv3"
	depends on !BR2_STATIC_LIBS
	help
	  Enable all wolfSSL features, except SSL version 3.0 support.

comment "all features, except SSLv3 needs a toolchain w/ dynamic library"
	depends on BR2_STATIC_LIBS

config BR2_PACKAGE_WOLFSSL_SSLV3
	bool "enable SSLv3"
	help
	  Enable SSL version 3.0 support.

endif

comment "wolfssl needs a toolchain w/ threads"
	depends on !BR2_TOOLCHAIN_HAS_THREADS
```

## package/wolftpm/Config.in
```kconfig
config BR2_PACKAGE_WOLFTPM
	bool "wolftpm"
	help
	  wolfTPM is a portable, open-source TPM 2.0 stack with
	  backward API compatibility, designed for embedded use.
	  No external dependencies, compact code size with low
	  resource usage.

	  https://www.wolfssl.com/

if BR2_PACKAGE_WOLFTPM

config BR2_PACKAGE_WOLFTPM_WOLFCRYPT
	bool "wolfCrypt hooks"
	default y
	depends on BR2_TOOLCHAIN_HAS_THREADS # wolfssl
	depends on !BR2_STATIC_LIBS # wolfssl-all
	select BR2_PACKAGE_WOLFSSL
	# not mandatory, but needed to get all features
	select BR2_PACKAGE_WOLFSSL_ALL
	help
	  Enable wolfCrypt hooks for RNG, Auth Sessions and Parameter
	  encryption. Disabling this option is not recommended as it
	  could create a security breach in most environments.

comment "wolfCrypt hooks need a toolchain w/ threads, dynamic library"
	depends on !BR2_TOOLCHAIN_HAS_THREADS || BR2_STATIC_LIBS

config BR2_PACKAGE_WOLFTPM_ST33
	bool "ST33 extra functionality"
	help
	  Enable support of TPM 2.0 extra functionality offered by the
	  STMicroelectronics ST33 chip.

config BR2_PACKAGE_WOLFTPM_NUVOTON
	bool "NPCT750 extra functionality"
	help
	  Enable support of TPM 2.0 extra functionality offered by the
	  Nuvoton NPCT750 chip.

config BR2_PACKAGE_WOLFTPM_DEBUG
	bool "Debug output"
	help
	  Enable debug messages in wolfTPM.

endif
```
