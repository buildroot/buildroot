## package/libheif/Config.in
```kconfig
config BR2_PACKAGE_LIBHEIF
	bool "libheif"
	depends on !BR2_TOOLCHAIN_HAS_BINUTILS_BUG_30730
	depends on BR2_INSTALL_LIBSTDCPP
	depends on BR2_TOOLCHAIN_GCC_AT_LEAST_10 # C++20
	depends on BR2_TOOLCHAIN_HAS_THREADS
	help
	  libheif is an HEIF and AVIF file format decoder and encoder.

	  https://github.com/strukturag/libheif

comment "libheif needs a toolchain w/ C++, threads, gcc >= 10"
	depends on !BR2_TOOLCHAIN_HAS_BINUTILS_BUG_30730
	depends on !BR2_INSTALL_LIBSTDCPP || !BR2_TOOLCHAIN_GCC_AT_LEAST_10 || \
		!BR2_TOOLCHAIN_HAS_THREADS
```

## package/libilbc/Config.in
```kconfig
config BR2_PACKAGE_LIBILBC
	bool "libilbc"
	help
	  iLBC (internet Low Bitrate Codec) is a FREE speech codec
	  suitable for robust voice communication over IP.

	  https://github.com/freeswitch/libilbc
```

## package/libinput/Config.in
```kconfig
config BR2_PACKAGE_LIBINPUT
	bool "libinput"
	depends on BR2_PACKAGE_HAS_UDEV
	select BR2_PACKAGE_LIBEVDEV
	select BR2_PACKAGE_MTDEV
	help
	  libinput is a library to handle input devices in Wayland
	  compositors and to provide a generic X.Org input driver.
	  It provides device detection, device handling, input device
	  event processing and abstraction so minimize the amount of
	  custom input code compositors need to provide the common
	  set of functionality that users expect.

	  http://freedesktop.org/wiki/Software/libinput/

if BR2_PACKAGE_LIBINPUT

config BR2_PACKAGE_LIBINPUT_PYTHON_TOOLS
	bool "install python tools "
	depends on BR2_PACKAGE_PYTHON3
	select BR2_PACKAGE_PYTHON_LIBEVDEV # runtime
	select BR2_PACKAGE_PYTHON_PYUDEV # runtime
	select BR2_PACKAGE_PYTHON_PYYAML # runtime
	help
	  Install python tools:
	  libinput-analyze-per-slot-delta,
	  libinput-analyze-recording,
	  libinput-analyze-touch-down-state,
	  libinput-measure-fuzz,
	  libinput-measure-touchpad-pressure,
	  libinput-measure-touchpad-size,
	  libinput-measure-touchpad-tap,
	  libinput-measure-touch-size,
	  libinput-replay

endif

comment "libinput needs udev /dev management"
	depends on !BR2_PACKAGE_HAS_UDEV
```

## package/libjcat/Config.in
```kconfig
config BR2_PACKAGE_LIBJCAT
	bool "libjcat"
	depends on BR2_USE_WCHAR # libglib2
	depends on BR2_TOOLCHAIN_HAS_THREADS # libglib2
	depends on BR2_USE_MMU # libglib2
	select BR2_PACKAGE_JSON_GLIB
	select BR2_PACKAGE_LIBGLIB2
	help
	  Library for reading and writing Jcat files.

	  https://github.com/hughsie/libjcat

comment "libjcat needs a toolchain w/ wchar, threads"
	depends on BR2_USE_MMU
	depends on !BR2_USE_WCHAR || !BR2_TOOLCHAIN_HAS_THREADS
```

## package/libjwt/Config.in
```kconfig
config BR2_PACKAGE_LIBJWT
	bool "libjwt"
	select BR2_PACKAGE_OPENSSL if !BR2_PACKAGE_GNUTLS
	select BR2_PACKAGE_JANSSON
	help
	  JSON Web Tokens are an open, industry standard RFC 7519
	  method for representing claims securely between two parties.

	  https://github.com/benmcollins/libjwt
```

## package/libjxl/Config.in
```kconfig
config BR2_PACKAGE_LIBJXL
	bool "libjxl"
	depends on BR2_TOOLCHAIN_GCC_AT_LEAST_7 # highway
	depends on BR2_TOOLCHAIN_HAS_ATOMIC # highway
	depends on BR2_TOOLCHAIN_HAS_THREADS
	depends on BR2_INSTALL_LIBSTDCPP # highway
	# libjxl fail to link statically due to libatomic issue
	depends on !BR2_STATIC_LIBS
	depends on !BR2_TOOLCHAIN_HAS_GCC_BUG_81426
	select BR2_PACKAGE_BROTLI
	select BR2_PACKAGE_HIGHWAY
	select BR2_PACKAGE_LCMS2
	help
	  libjxl is the reference implementation of JPEG XL (encoder
	  and decoder).

	  https://github.com/libjxl/libjxl

comment "libjxl needs a toolchain with C++, threads, gcc >= 7, dynamic library"
	depends on BR2_TOOLCHAIN_HAS_ATOMIC
	depends on !BR2_TOOLCHAIN_HAS_GCC_BUG_81426
	depends on !BR2_TOOLCHAIN_GCC_AT_LEAST_7 || \
		!BR2_INSTALL_LIBSTDCPP || \
		!BR2_TOOLCHAIN_HAS_THREADS || \
		BR2_STATIC_LIBS
```

## package/libkcapi/Config.in
```kconfig
config BR2_PACKAGE_LIBKCAPI
	bool "libkcapi"
	depends on BR2_TOOLCHAIN_HAS_SYNC_4
	help
	  Linux Kernel Crypto API userspace interface library

	  http://www.chronox.de/libkcapi.html

if BR2_PACKAGE_LIBKCAPI

config BR2_PACKAGE_LIBKCAPI_ASYM
	bool "build asymmetric ciphers library"
	help
	  Using this library requires the Linux kernel to be patched
	  with libkcapi Linux kernel patches found in libkcapi
	  kernel-patches/ directory.

config BR2_PACKAGE_LIBKCAPI_DGSTAPP
	bool "build dgst application"

config BR2_PACKAGE_LIBKCAPI_ENCAPP
	bool "build enc application"

config BR2_PACKAGE_LIBKCAPI_HASHER
	bool "build hasher application"
	depends on !BR2_STATIC_LIBS # dlfcn.h

comment "hasher application needs a toolchain w/ dynamic library"
	depends on BR2_STATIC_LIBS

config BR2_PACKAGE_LIBKCAPI_KPP
	bool "build KPP library"
	help
	  Using this library requires the Linux kernel to be patched
	  with libkcapi Linux kernel patches found in libkcapi
	  kernel-patches/ directory.

config BR2_PACKAGE_LIBKCAPI_RNGAPP
	bool "build rng read application"

config BR2_PACKAGE_LIBKCAPI_SPEED
	bool "build speed-test program"

config BR2_PACKAGE_LIBKCAPI_TEST
	bool "build test program"
	depends on BR2_USE_MMU # fork()

endif
```

## package/libks/Config.in
```kconfig
config BR2_PACKAGE_LIBKS
	bool "libks"
	depends on BR2_INSTALL_LIBSTDCPP
	depends on !BR2_STATIC_LIBS # dlfcn.h
	depends on BR2_TOOLCHAIN_HAS_THREADS
	select BR2_PACKAGE_OPENSSL
	select BR2_PACKAGE_UTIL_LINUX
	select BR2_PACKAGE_UTIL_LINUX_LIBUUID
	help
	  Foundational support for signalwire C products

	  https://github.com/signalwire/libks

comment "libks needs a toolchain w/ C++, threads, dynamic library"
	depends on BR2_STATIC_LIBS || !BR2_INSTALL_LIBSTDCPP \
		|| !BR2_TOOLCHAIN_HAS_THREADS
```

## package/libldns/Config.in
```kconfig
config BR2_PACKAGE_LIBLDNS
	bool "libldns"
	select BR2_PACKAGE_OPENSSL
	help
	  The goal of ldns is to simplify DNS programming, it supports
	  recent RFCs like the DNSSEC documents, and allows developers
	  to easily create software conforming to current RFCs, and
	  experimental software for current Internet Drafts.

	  http://www.nlnetlabs.nl/projects/ldns

if BR2_PACKAGE_LIBLDNS

config BR2_PACKAGE_LIBLDNS_DRILL
	bool "drill binary"
	depends on !BR2_STATIC_LIBS
	help
	  Install the drill binary

comment "drill needs a toolchain w/ dynamic library"
	depends on BR2_STATIC_LIBS

endif # BR2_PACKAGE_LIBLDNS
```

## package/liblockfile/Config.in
```kconfig
config BR2_PACKAGE_LIBLOCKFILE
	bool "liblockfile"
	depends on BR2_USE_MMU # fork()
	help
	  NFS-safe locking library.

	  https://github.com/miquels/liblockfile
```

## package/libmanette/Config.in
```kconfig
config BR2_PACKAGE_LIBMANETTE
	bool "libmanette"
	depends on BR2_USE_MMU # libglib2
	depends on BR2_USE_WCHAR # libglib2 -> gettext
	depends on BR2_PACKAGE_HAS_UDEV # hidapi
	depends on BR2_TOOLCHAIN_HAS_THREADS_NPTL # hidapi
	depends on BR2_TOOLCHAIN_HEADERS_AT_LEAST_4_16
	depends on BR2_TOOLCHAIN_GCC_AT_LEAST_4_9 # hidapi -> libusb
	select BR2_PACKAGE_HIDAPI
	select BR2_PACKAGE_LIBEVDEV
	select BR2_PACKAGE_LIBGLIB2
	help
	  GObject library which provides access to game controllers.

	  https://gitlab.gnome.org/GNOME/libmanette

comment "libmanette needs a toolchain w/ wchar, NPTL threads, gcc >= 4.9, headers >= 4.16, udev"
	depends on BR2_USE_MMU
	depends on !BR2_USE_WCHAR || !BR2_TOOLCHAIN_HAS_THREADS_NPTL || \
		!BR2_TOOLCHAIN_GCC_AT_LEAST_4_9 || \
		!BR2_TOOLCHAIN_HEADERS_AT_LEAST_4_16 || \
		!BR2_PACKAGE_HAS_UDEV
```

## package/libmatroska/Config.in
```kconfig
config BR2_PACKAGE_LIBMATROSKA
	bool "libmatroska"
	depends on BR2_INSTALL_LIBSTDCPP
	depends on BR2_USE_WCHAR
	depends on BR2_TOOLCHAIN_GCC_AT_LEAST_4_9 # C++14
	select BR2_PACKAGE_LIBEBML
	help
	  Extensible open standard audio/video container format access
	  library.

	  http://matroska.org

comment "libmatroska needs a toolchain w/ C++, wchar, gcc >= 4.9"
	depends on !BR2_INSTALL_LIBSTDCPP || !BR2_USE_WCHAR || \
		!BR2_TOOLCHAIN_GCC_AT_LEAST_4_9
```

## package/libmd/Config.in
```kconfig
config BR2_PACKAGE_LIBMD
	bool "libmd"
	help
	  This library provides message digest functions found on BSD
	  systems either on their libc (NetBSD, OpenBSD) or libmd
	  (FreeBSD, DragonflyBSD, macOS, Solaris) libraries and lacking
	  on others like GNU systems.

	  https://www.hadrons.org/software/libmd/
```

## package/libmemcached/Config.in
```kconfig
config BR2_PACKAGE_LIBMEMCACHED
	bool "libmemcached"
	depends on BR2_INSTALL_LIBSTDCPP
	depends on BR2_TOOLCHAIN_HAS_THREADS
	help
	  libMemcached is an open source C/C++ client library and tools
	  for the memcached server.
	  It has been designed to be light on memory usage, thread safe,
	  and provide full access to server side methods.

	  https://awesomized.github.io/libmemcached

comment "libmemcached needs a toolchain w/ C++, threads"
	depends on !BR2_INSTALL_LIBSTDCPP || !BR2_TOOLCHAIN_HAS_THREADS
```

## package/libmnl/Config.in
```kconfig
config BR2_PACKAGE_LIBMNL
	bool "libmnl"
	help
	  libmnl is a minimalistic user-space library oriented
	  to Netlink developers.

	  http://netfilter.org/projects/libmnl/

if BR2_PACKAGE_LIBMNL

config BR2_PACKAGE_LIBMNL_EXAMPLES
	bool "install examples"
	depends on BR2_TOOLCHAIN_HEADERS_AT_LEAST_4_11
	help
	  Install binary examples.

comment "examples needs a toolchain w/ headers >= 4.11"
	depends on !BR2_TOOLCHAIN_HEADERS_AT_LEAST_4_11

endif
```

## package/libmodsecurity/Config.in
```kconfig
config BR2_PACKAGE_LIBMODSECURITY
	bool "libmodsecurity"
	depends on BR2_INSTALL_LIBSTDCPP
	depends on BR2_TOOLCHAIN_HAS_THREADS
	# libmodsecurity embeds several mbedtls source files, causing
	# various issues when static linking and other dependencies of
	# libmodsecurity in turn use mbedtls
	depends on !BR2_STATIC_LIBS
	select BR2_PACKAGE_PCRE2
	help
	  Libmodsecurity is one component of the ModSecurity
	  v3 project. The library codebase serves as an
	  interface to ModSecurity Connectors taking in web
	  traffic and applying traditional ModSecurity
	  processing. In general, it provides the capability
	  to load/interpret rules written in the ModSecurity
	  SecRules format and apply them to HTTP content
	  provided by your application via Connectors.

	  https://github.com/SpiderLabs/ModSecurity

comment "libmodsecurity needs a toolchain w/ C++, threads, dynamic library"
	depends on !BR2_INSTALL_LIBSTDCPP || \
		!BR2_TOOLCHAIN_HAS_THREADS || BR2_STATIC_LIBS
```

## package/libmpsse/Config.in
```kconfig
config BR2_PACKAGE_LIBMPSSE
	bool "libmpsse"
	select BR2_PACKAGE_LIBFTDI
    help
	  Open source library for SPI/I2C control via FTDI chips
```

## package/libnet/Config.in
```kconfig
config BR2_PACKAGE_LIBNET
	bool "libnet"
	help
	  libnet provides a portable framework for low-level network
	  packet construction.

	  https://github.com/libnet/libnet
```

## package/libnetfilter_acct/Config.in
```kconfig
config BR2_PACKAGE_LIBNETFILTER_ACCT
	bool "libnetfilter_acct"
	select BR2_PACKAGE_LIBMNL
	help
	  libnetfilter_acct is the userspace library providing interface
	  to extended accounting infrastructure.

	  https://www.netfilter.org/projects/libnetfilter_acct/
```

## package/libnetfilter_log/Config.in
```kconfig
config BR2_PACKAGE_LIBNETFILTER_LOG
	bool "libnetfilter_log"
	select BR2_PACKAGE_LIBMNL
	select BR2_PACKAGE_LIBNFNETLINK
	help
	  libnetfilter_log is a userspace library providing interface
	  to packets that have been logged by the kernel packet filter.

	  https://www.netfilter.org/projects/libnetfilter_log/
```

## package/libnss-ato/Config.in
```kconfig
config BR2_PACKAGE_LIBNSS_ATO
	bool "libnss-ato"
	depends on BR2_TOOLCHAIN_USES_GLIBC
	help
	  Library to map every nss request for unknown user to a
	  single predefined user.

	  https://github.com/donapieppo/libnss-ato

comment "libnss-ato needs a glibc toolchain"
	depends on !BR2_TOOLCHAIN_USES_GLIBC
```

## package/libnvme/Config.in
```kconfig
config BR2_PACKAGE_LIBNVME
	bool "libnvme"
	depends on BR2_USE_MMU # malloc_usable_size()
	help
	  libnvme provides type definitions for NVMe specification
	  and utilities for nvme devices handling in Linux.

	  https://github.com/linux-nvme/libnvme
```

## package/libopenaptx/Config.in
```kconfig
config BR2_PACKAGE_LIBOPENAPTX
	bool "libopenaptx"
	# unconditionallly builds a shared lib
	depends on !BR2_STATIC_LIBS
	help
	  This is Open Source implementation of Audio Processing
	  Technology codec (aptX) originally derived from ffmpeg 4.0
	  project and licensed under GPLv3+. This codec is mainly used
	  in Bluetooth A2DP profile.

	  https://github.com/pali/libopenaptx

comment "libopenaptx needs a toolchain w/ dynamic library"
	depends on BR2_STATIC_LIBS
```

## package/libopenmpt/Config.in
```kconfig
config BR2_PACKAGE_LIBOPENMPT
	bool "libopenmpt"
	# See: https://lib.openmpt.org/doc/dependencies.html
	depends on BR2_INSTALL_LIBSTDCPP
	depends on BR2_TOOLCHAIN_GCC_AT_LEAST_7
	depends on BR2_TOOLCHAIN_HAS_THREADS
	help
	  libopenmpt is a cross-platform C++ and C library to decode
	  tracked music files (modules) into a raw PCM audio stream.

	  openmpt123 is a cross-platform command-line or terminal
	  based module file player.

	  https://lib.openmpt.org/libopenmpt

if BR2_PACKAGE_LIBOPENMPT

config BR2_PACKAGE_LIBOPENMPT_OPENMPT123
	bool "openmpt123"
	help
	  Install the openmpt123 command line tool.

endif

comment "libopenmpt needs a toolchain w/ threads, C++, gcc >= 7"
	depends on !BR2_INSTALL_LIBSTDCPP || \
		!BR2_TOOLCHAIN_GCC_AT_LEAST_7 || \
		!BR2_TOOLCHAIN_HAS_THREADS
```
