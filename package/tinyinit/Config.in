## package/tinyinit/Config.in
```kconfig
config BR2_PACKAGE_TINYINIT
	bool "tinyinit"
	depends on BR2_INIT_TINYINIT
	help
	  A Linux tiny initialization script suitable for resource
	  limited systems, which can be used as an alternative to the
	  one provided by Busybox.
```

## package/tio/Config.in
```kconfig
config BR2_PACKAGE_TIO
	bool "tio"
	depends on BR2_TOOLCHAIN_HAS_THREADS
	depends on BR2_USE_MMU # glib2
	depends on BR2_USE_WCHAR # glib2
	depends on BR2_PACKAGE_HAS_LUAINTERPRETER
	depends on !BR2_PACKAGE_LUAJIT
	help
	  "tio" is a simple TTY terminal application which features a
	  straightforward commandline interface to easily connect to
	  TTY devices for basic input/output.

	  https://tio.github.io/

comment "tio needs a toolchain w/ threads, wchar"
	depends on BR2_USE_MMU
	depends on !BR2_sparc64 && !BR2_sparc
	depends on !BR2_TOOLCHAIN_HAS_THREADS || !BR2_USE_WCHAR

comment "tio needs lua (but not luajit)"
	depends on BR2_USE_MMU
	depends on BR2_TOOLCHAIN_HAS_THREADS
	depends on BR2_USE_WCHAR
	depends on !BR2_PACKAGE_HAS_LUAINTERPRETER || BR2_PACKAGE_LUAJIT
```

## package/tipidee/Config.in
```kconfig
config BR2_PACKAGE_TIPIDEE
	bool "tipidee"
	depends on BR2_USE_MMU # skalibs
	select BR2_PACKAGE_SKALIBS
	select BR2_PACKAGE_HOST_TIPIDEE if BR2_PACKAGE_TIPIDEE_CONFIG_FILE != ""
	help
	  tipidee is a web server. It supports HTTP 1.0 and 1.1. It aims
	  to be compliant with RFC 9112: while it only implements a very
	  limited subset of the optional functionality in HTTP 1.1, it
	  implements all the mandatory parts. It is usable with both
	  HTTP and HTTPS.

	  It runs under a super-server, e.g. inetd, s6-tcpserver, or
	  s6-tlsserver (for HTTPS). Traditionally, inetd-mode web
	  servers aren't considered performant, but tipidee aims to eke
	  out every single drop of performance that is attainable with
	  its programming model.

	  https://skarnet.org/software/tipidee/

if BR2_PACKAGE_TIPIDEE

config BR2_PACKAGE_TIPIDEE_CONFIG_FILE
	string "configuration source file"
	default ""
	help
	  The configuration file in source (text) format, documented at:

	  https://skarnet.org/software/tipidee/tipidee.conf.html

endif
```

## package/tipidee/Config.in.host
```kconfig
config BR2_PACKAGE_HOST_TIPIDEE
	bool "host tipidee"
	depends on BR2_USE_MMU # skalibs
	select BR2_PACKAGE_SKALIBS
	help
	  This package builds the tipidee-config tool for the host.

	  https://skarnet.org/software/tipidee/
```

## package/tl-expected/Config.in
```kconfig
config BR2_PACKAGE_TL_EXPECTED
	bool "tl-expected"
	depends on BR2_INSTALL_LIBSTDCPP
	depends on BR2_TOOLCHAIN_GCC_AT_LEAST_4_8 # C++11
	help
	  C++11/14/17 std::expected with functional-style extensions and
	  reference support.

	  https://github.com/TartanLlama/expected

comment "tl-expected needs a toolchain w/ C++, gcc >= 4.8"
	depends on !BR2_INSTALL_LIBSTDCPP || !BR2_TOOLCHAIN_GCC_AT_LEAST_4_8
```

## package/tllist/Config.in
```kconfig
config BR2_PACKAGE_TLLIST
	bool "tllist"
	help
	  A C header file only implementation of a typed linked list.

	  https://codeberg.org/dnkl/tllist
```

## package/toybox/Config.in
```kconfig
config BR2_PACKAGE_TOYBOX
	bool "Toybox (busybox replacement)"

config BR2_PACKAGE_TOYBOX_CONFIG
	string "Toybox configuration file to use?"
	default "package/toybox/toybox.config"
```

## package/tpm2-openssl/Config.in
```kconfig
config BR2_PACKAGE_TPM2_OPENSSL
	bool "tpm2-openssl"
	depends on !BR2_STATIC_LIBS # tpm2-tss
	depends on BR2_TOOLCHAIN_HAS_THREADS
	select BR2_PACKAGE_OPENSSL
	select BR2_PACKAGE_TPM2_TSS
	help
	  Provider for integration of TPM 2.0 to OpenSSL 3.0.

	  tpm2-openssl is based on a major refactoring of the
	  tpm2-tss-engine. The code is still there, but largely
	  reshuffled to match the new OpenSSL API.

	  https://github.com/tpm2-software/tpm2-openssl

comment "tpm2-openssl needs a toolchain w/ dynamic library, threads"
	depends on BR2_STATIC_LIBS || !BR2_TOOLCHAIN_HAS_THREADS
```

## package/tpm2-pkcs11/Config.in
```kconfig
config BR2_PACKAGE_TPM2_PKCS11
	bool "tpm2-pkcs11"
	depends on !BR2_STATIC_LIBS # tpm2-tss
	depends on BR2_TOOLCHAIN_HAS_THREADS
	select BR2_PACKAGE_LIBYAML
	select BR2_PACKAGE_OPENSSL
	select BR2_PACKAGE_SQLITE
	select BR2_PACKAGE_TPM2_TSS
	help
	  A PKCS#11 interface for TPM2 hardware

	  https://github.com/tpm2-software/tpm2-pkcs11

if BR2_PACKAGE_TPM2_PKCS11

config BR2_PACKAGE_TPM2_PKCS11_PYTHON_TOOLS
	bool "Install python tools (tpm2_ptool)"
	depends on BR2_PACKAGE_HOST_RUSTC_TARGET_ARCH_SUPPORTS # python-bcrypt, python-cryptography
	depends on BR2_PACKAGE_PYTHON3
	select BR2_PACKAGE_PYTHON_BCRYPT # runtime
	select BR2_PACKAGE_PYTHON_CRYPTOGRAPHY # runtime
	select BR2_PACKAGE_PYTHON_PYASN1 # runtime
	select BR2_PACKAGE_PYTHON_PYASN1_MODULES # runtime
	select BR2_PACKAGE_PYTHON_PYYAML # runtime
	select BR2_PACKAGE_PYTHON_TPM2_PYTSS # runtime
	select BR2_PACKAGE_PYTHON3_SQLITE # runtime
	help
	  Enable Python-related tools (tpm2_ptool)

comment "python tools needs python3"
	depends on !BR2_PACKAGE_PYTHON3
	depends on BR2_PACKAGE_HOST_RUSTC_TARGET_ARCH_SUPPORTS

endif

comment "tpm2-pkcs11 needs a toolchain w/ dynamic library, threads"
	depends on BR2_STATIC_LIBS || !BR2_TOOLCHAIN_HAS_THREADS
```

## package/trace-cmd/Config.in
```kconfig
config BR2_PACKAGE_TRACE_CMD
	bool "trace-cmd"
	# pthread_setaffinity_np
	depends on BR2_TOOLCHAIN_HAS_THREADS_NPTL
	depends on BR2_USE_MMU # fork()
	depends on !BR2_STATIC_LIBS # dlopen()
	help
	  Command line reader for ftrace.

	  To use this profiling tool, you should enable ftrace in your
	  kernel configuration. This command collect traces on your
	  target.  You can analyse these traces on the target or on
	  the host via the gui "kernel shark"

	  http://git.kernel.org/cgit/linux/kernel/git/rostedt/trace-cmd.git

comment "trace-cmd needs a toolchain w/ NPTL, dynamic library"
	depends on BR2_USE_MMU
	depends on !BR2_TOOLCHAIN_HAS_THREADS_NPTL || BR2_STATIC_LIBS
```

## package/transmission/Config.in
```kconfig
config BR2_PACKAGE_TRANSMISSION
	bool "transmission"
	depends on !BR2_BINFMT_FLAT # libnatpmp
	depends on BR2_INSTALL_LIBSTDCPP # libutp
	depends on !BR2_STATIC_LIBS # libnatpmp
	depends on BR2_TOOLCHAIN_GCC_AT_LEAST_7 # C++17
	depends on BR2_TOOLCHAIN_HAS_THREADS
	depends on BR2_USE_MMU # fork()
	depends on BR2_USE_WCHAR # libpsl
	select BR2_PACKAGE_DHT
	select BR2_PACKAGE_LIBB64
	select BR2_PACKAGE_LIBCURL
	select BR2_PACKAGE_LIBDEFLATE
	select BR2_PACKAGE_LIBEVENT
	select BR2_PACKAGE_LIBMINIUPNPC
	select BR2_PACKAGE_LIBNATPMP
	select BR2_PACKAGE_LIBPSL
	select BR2_PACKAGE_LIBUTP
	select BR2_PACKAGE_OPENSSL
	select BR2_PACKAGE_ZLIB
	help
	  Transmission is a cross-platform BitTorrent client.

	  http://www.transmissionbt.com/

if BR2_PACKAGE_TRANSMISSION

config BR2_PACKAGE_TRANSMISSION_CLI
	bool "transmission-cli"
	help
	  Install transmission command line interface.

config BR2_PACKAGE_TRANSMISSION_DAEMON
	bool "transmission-daemon"
	help
	  Install transmission daemon.

config BR2_PACKAGE_TRANSMISSION_GTK
	bool "transmission-gtk"
	depends on BR2_TOOLCHAIN_HAS_SYNC_4 # pangomm, libgtk3 -> pango -> harfbuzz -> gtkmm3
	depends on BR2_PACKAGE_LIBGTK3 && BR2_SYSTEM_ENABLE_NLS
	select BR2_PACKAGE_GTKMM3
	help
	  Install transmission GTK-based GUI interface.

comment "transmission-gtk needs libgtk3 and a toolchain with NLS enabled"
	depends on BR2_TOOLCHAIN_HAS_SYNC_4
	depends on BR2_PACKAGE_LIBGTK3 && !BR2_SYSTEM_ENABLE_NLS
endif

comment "transmission needs a toolchain w/ dynamic library, threads, C++, gcc >= 7"
	depends on BR2_USE_MMU
	depends on !BR2_BINFMT_FLAT
	depends on !BR2_TOOLCHAIN_HAS_THREADS || !BR2_INSTALL_LIBSTDCPP || \
		!BR2_TOOLCHAIN_GCC_AT_LEAST_7 || BR2_STATIC_LIBS
```

## package/trower-base64/Config.in
```kconfig
config BR2_PACKAGE_TROWER_BASE64
    bool "trower-base64"
    default n
    help
      C implementation of base64 encode/decode
```

## package/tvheadend/Config.in
```kconfig
comment "tvheadend needs a toolchain w/ NPTL, headers >= 3.2, dynamic library"
	depends on !BR2_TOOLCHAIN_HAS_THREADS_NPTL || \
		!BR2_TOOLCHAIN_HEADERS_AT_LEAST_3_2 || BR2_STATIC_LIBS
	depends on BR2_TOOLCHAIN_HAS_SYNC_4

menuconfig BR2_PACKAGE_TVHEADEND
	bool "tvheadend"
	depends on !BR2_STATIC_LIBS # dladdr()
	depends on BR2_TOOLCHAIN_HAS_THREADS_NPTL
	depends on BR2_TOOLCHAIN_HEADERS_AT_LEAST_3_2
	depends on BR2_TOOLCHAIN_HAS_SYNC_4
	select BR2_PACKAGE_DTV_SCAN_TABLES
	select BR2_PACKAGE_LIBICONV if !BR2_ENABLE_LOCALE
	select BR2_PACKAGE_OPENSSL
	select BR2_PACKAGE_LIBOPENSSL_ENABLE_DES if BR2_PACKAGE_LIBOPENSSL
	help

	  Tvheadend is a TV streaming server for Linux supporting
	  DVB-S, DVB-S2, DVB-C, DVB-T, ATSC, IPTV, and Analog video
	  (V4L) as input sources.

	  https://www.lonelycoder.com/redmine/projects/tvheadend/

	  Note:
	    - on first run, tvheadend will start in wizard mode; the
	      webUI is available on port 9981.
	    - if you want Avahi support, you'll need to enable:
	          Avahi, D-Bus, libdaemon

if BR2_PACKAGE_TVHEADEND

config BR2_PACKAGE_TVHEADEND_DESCRAMBLER
	bool "descrambler support"
	default y
	help
	  Enable support for various descrambler modules.

config BR2_PACKAGE_TVHEADEND_IPTV
	bool "IPTV support"
	default y
	help
	  Enable IPTV support.

	  Note that some IPTV streams will need to be piped through
	  ffmpeg (the commandline tool), so you may have to enable it
	  with:
	    BR2_PACKAGE_FFMPEG=y
	    BR2_PACKAGE_FFMPEG_FFMPEG=y

config BR2_PACKAGE_TVHEADEND_SATIP
	bool "SAT>IP support"
	default y
	help
	  Enable SAT>IP support.

config BR2_PACKAGE_TVHEADEND_TIMESHIFT
	bool "timeshift support"
	default y
	help
	  Enable timeshift support.

config BR2_PACKAGE_TVHEADEND_TRANSCODING
	bool "transcoding support"
	depends on BR2_PACKAGE_FFMPEG_ARCH_SUPPORTS
	select BR2_PACKAGE_FFMPEG
	select BR2_PACKAGE_FFMPEG_AVRESAMPLE
	select BR2_PACKAGE_FFMPEG_GPL # needed for x264 support
	select BR2_PACKAGE_FFMPEG_SWSCALE
	# vp8 encoder needs c++
	select BR2_PACKAGE_LIBVPX if BR2_INSTALL_LIBSTDCPP
	select BR2_PACKAGE_X264
	help
	  Enable transcoding support.

endif
```

## package/tzdata/Config.in
```kconfig
# This package is not meant to be user-visible.
# It gets selected by BR2_TARGET_TZ in system/Config.in

config BR2_PACKAGE_TZDATA
	bool
	help
	  Time zone database

	  https://data.iana.org/time-zones/tz-link.html
```

## package/uboot-bootcount/Config.in
```kconfig
config BR2_PACKAGE_UBOOT_BOOTCOUNT
	bool "uboot-bootcount"
	help
	  U-Boot implements a boot count scheme that can be used to
	  detect multiple failed attempts to boot Linux. This tool
	  allows to read and write bootcount from userspace for some
	  platforms (TI AM335X or STM32MP1) or from I2C EEPROM.

	  https://github.com/VoltServer/uboot-bootcount
```

## package/ucresolv/Config.in
```kconfig
config BR2_PACKAGE_UCRESOLV
    bool "ucresolv"
    default n
    help
       Recipe to build library for uclibc resolver missing features
```

## package/udisks/Config.in
```kconfig
config BR2_PACKAGE_UDISKS
	bool "udisks"
	depends on BR2_ENABLE_LOCALE # libblockdev, parted
	depends on BR2_PACKAGE_HAS_UDEV
	depends on BR2_TOOLCHAIN_GCC_AT_LEAST_7 # polkit -> C++17
	depends on BR2_TOOLCHAIN_HAS_THREADS # polkit
	depends on BR2_USE_WCHAR # dbus-glib -> glib2
	depends on BR2_TOOLCHAIN_HAS_SYNC_4 # libblockdev -> cryptsetup -> json-c
	depends on !BR2_STATIC_LIBS # polkit -> duktape
	depends on !BR2_OPTIMIZE_FAST # polkit -> duktape
	select BR2_PACKAGE_DBUS
	select BR2_PACKAGE_DBUS_GLIB
	select BR2_PACKAGE_LIBATASMART
	select BR2_PACKAGE_LIBBLOCKDEV
	select BR2_PACKAGE_LIBBLOCKDEV_CRYPTO
	select BR2_PACKAGE_LIBBLOCKDEV_FS
	select BR2_PACKAGE_LIBBLOCKDEV_LOOP
	select BR2_PACKAGE_LIBBLOCKDEV_MDRAID
	select BR2_PACKAGE_LIBBLOCKDEV_PART
	select BR2_PACKAGE_LIBBLOCKDEV_SWAP
	select BR2_PACKAGE_LIBGUDEV
	select BR2_PACKAGE_PARTED
	select BR2_PACKAGE_POLKIT
	select BR2_PACKAGE_SG3_UTILS
	select BR2_PACKAGE_UTIL_LINUX
	select BR2_PACKAGE_UTIL_LINUX_LIBMOUNT
	help
	  The udisks project provides

	   o A storage daemon that implements well-defined D-Bus
	     interfaces that can be used to query and manipulate
	     storage devices.

	   o a command-line tool, udisksctl(1), that can be used to
	     query and use the daemon

	  http://www.freedesktop.org/wiki/Software/udisks

comment "udisks needs udev /dev management"
	depends on BR2_USE_MMU
	depends on !BR2_PACKAGE_HAS_UDEV

comment "udisks needs a toolchain with dynamic library, locale, wchar, threads, gcc >= 7"
	depends on BR2_USE_MMU
	depends on BR2_TOOLCHAIN_HAS_SYNC_4
	depends on BR2_STATIC_LIBS || !BR2_ENABLE_LOCALE || \
		!BR2_USE_WCHAR || !BR2_TOOLCHAIN_HAS_THREADS || \
		!BR2_TOOLCHAIN_GCC_AT_LEAST_7

comment "udisks can't be built with Optimize for fast"
	depends on BR2_OPTIMIZE_FAST
```

## package/uefisettings/Config.in
```kconfig
config BR2_PACKAGE_UEFISETTINGS
	bool "uefisettings"
	depends on BR2_ARCH_IS_64
	depends on BR2_PACKAGE_HOST_RUSTC_TARGET_ARCH_SUPPORTS
	select BR2_PACKAGE_HOST_RUSTC
	help
	  The tool to read/get/extract and write/change/modify
	  BIOS/UEFI settings from Linux terminal.

	  https://github.com/linuxboot/uefisettings
```

## package/ufs-utils/Config.in
```kconfig
config BR2_PACKAGE_UFS_UTILS
	bool "ufs-utils"
	depends on BR2_TOOLCHAIN_HEADERS_AT_LEAST_5_1
	help
	  UFS utils is a set of utilities for managing Universal
	  Flash Storage (UFS) devices.

	  https://github.com/SanDisk-Open-Source/ufs-utils.git

comment "ufs-utils needs a toolchain w/ headers >= 5.1"
	depends on !BR2_TOOLCHAIN_HEADERS_AT_LEAST_5_1
```

## package/uftrace/Config.in
```kconfig
config BR2_PACKAGE_UFTRACE_ARCH_SUPPORTS
	bool
	default y if BR2_ARM_CPU_ARMV6 || BR2_ARM_CPU_ARMV7A
	default y if BR2_aarch64
	default y if BR2_i386
	default y if BR2_x86_64

config BR2_PACKAGE_UFTRACE
	bool "uftrace"
	depends on BR2_PACKAGE_UFTRACE_ARCH_SUPPORTS
	depends on BR2_TOOLCHAIN_HAS_THREADS
	depends on !BR2_STATIC_LIBS
	select BR2_PACKAGE_ARGP_STANDALONE if \
	       BR2_TOOLCHAIN_USES_UCLIBC || \
	       BR2_TOOLCHAIN_USES_MUSL
	help
	  The uftrace tool is to trace and analyze execution of a
	  program written in C/C++. It was heavily inspired by the
	  ftrace framework of the Linux kernel (especially function
	  graph tracer) and supports userspace programs.
	  It supports various kind of commands and filters to help
	  analysis of the program execution and performance.

	  https://github.com/namhyung/uftrace

comment "uftrace needs a toolchain w/ threads, dynamic library"
	depends on BR2_PACKAGE_UFTRACE_ARCH_SUPPORTS
	depends on !BR2_TOOLCHAIN_HAS_THREADS || BR2_STATIC_LIBS
```

## package/ugetty/Config.in
```kconfig
config BR2_PACKAGE_UGETTY
	bool "ugetty"
	depends on BR2_TOOLCHAIN_GCC_AT_LEAST_8 # std=c17
	help
	  A minimal getty for embedded Linux that auto-detects the
	  client and dispatches incoming serial connections to a login
	  prompt, a PPP session, or the local SSH server as
	  appropriate.

	  https://github.com/ryancdotorg/ugetty
```

## package/ulog/Config.in
```kconfig
config BR2_PACKAGE_ULOG
	bool "ulog"
	depends on BR2_INSTALL_LIBSTDCPP
	depends on BR2_TOOLCHAIN_HAS_THREADS
	help
	  This is a minimalistic logging library derived from
	  Android logger.

	  https://github.com/Parrot-Developers/ulog

comment "ulog needs a toolchain w/ C++, threads"
	depends on !BR2_INSTALL_LIBSTDCPP || !BR2_TOOLCHAIN_HAS_THREADS
```

## package/uma-sdk/Config.in
```kconfig
config BR2_PACKAGE_UMA_SDK
	bool "uma-sdk"
	depends on BR2_arm
	help
	  Pre-compiled binaries for a platform

if BR2_PACKAGE_UMA_SDK

choice
        prompt "Box type"
        default BR2_PACKAGE_UMA_SDK_V1
        help
                Select the version you wish to use

	config BR2_PACKAGE_UMA_SDK_V1
	bool "UMA v1"

	config BR2_PACKAGE_UMA_SDK_V2
	bool "UMA v2"

endchoice

endif
```
