## package/midori/Config.in
```kconfig
config BR2_PACKAGE_MIDORI_ARCH_SUPPORTS
	bool
	default y
	depends on BR2_USE_MMU
	depends on BR2_PACKAGE_HOST_RUSTC_ARCH_SUPPORTS
	depends on BR2_PACKAGE_GOBJECT_INTROSPECTION_ARCH_SUPPORTS
	depends on BR2_PACKAGE_LIBGPG_ERROR_ARCH_SUPPORTS # gcr -> libgcrypt -> libgpg-error
	depends on BR2_PACKAGE_WEBKITGTK_ARCH_SUPPORTS
	depends on !BR2_BINFMT_FLAT # webkitgtk -> icu

comment "midori needs a glibc toolchain w/ C++, wchar, threads, dynamic library, gcc >= 7, host gcc >= 8"
	depends on BR2_PACKAGE_MIDORI_ARCH_SUPPORTS
	depends on !BR2_INSTALL_LIBSTDCPP || \
		!BR2_TOOLCHAIN_GCC_AT_LEAST_7 || \
		!BR2_HOST_GCC_AT_LEAST_8 || \
		!BR2_TOOLCHAIN_USES_GLIBC || !BR2_TOOLCHAIN_HAS_THREADS || \
		BR2_STATIC_LIBS || !BR2_USE_WCHAR

comment "midori needs libgtk3 w/ X11 or wayland backend"
	depends on BR2_PACKAGE_MIDORI_ARCH_SUPPORTS
	depends on !BR2_PACKAGE_LIBGTK3_X11 && \
		!BR2_PACKAGE_LIBGTK3_WAYLAND

config BR2_PACKAGE_MIDORI
	bool "midori"
	depends on BR2_PACKAGE_MIDORI_ARCH_SUPPORTS
	depends on !BR2_STATIC_LIBS # webkitgtk
	depends on BR2_INSTALL_LIBSTDCPP # webkitgtk
	depends on BR2_HOST_GCC_AT_LEAST_8 # gobject-introspection
	depends on BR2_TOOLCHAIN_GCC_AT_LEAST_7 # webkitgtk
	depends on BR2_TOOLCHAIN_USES_GLIBC # webkitgtk
	depends on BR2_TOOLCHAIN_HAS_THREADS # libglib2
	depends on BR2_TOOLCHAIN_HAS_SYNC_4 # libgtk3
	depends on BR2_USE_WCHAR # granite, gcr, libsoup, libpeas, gobject-introspection
	depends on BR2_PACKAGE_LIBGTK3
	depends on BR2_PACKAGE_LIBGTK3_X11 || BR2_PACKAGE_LIBGTK3_WAYLAND
	select BR2_PACKAGE_GCR
	select BR2_PACKAGE_GRANITE
	select BR2_PACKAGE_JSON_GLIB
	select BR2_PACKAGE_LIBARCHIVE
	select BR2_PACKAGE_LIBPEAS
	select BR2_PACKAGE_LIBPEAS_WIDGETS
	select BR2_PACKAGE_LIBSOUP
	select BR2_PACKAGE_LIBXML2
	select BR2_PACKAGE_PYTHON3 # gobject-introspection
	select BR2_PACKAGE_SQLITE
	select BR2_PACKAGE_WEBKITGTK
	select BR2_PACKAGE_LIBICONV if !BR2_ENABLE_LOCALE
	help
	  Midori is a lightweight web browser based on WebKit

	  https://github.com/midori-browser/core
```

## package/minetest/Config.in
```kconfig
config BR2_PACKAGE_MINETEST
	bool "minetest"
	depends on BR2_INSTALL_LIBSTDCPP # irrlichtMt (bundled)
	depends on BR2_TOOLCHAIN_GCC_AT_LEAST_5 # C++11
	depends on BR2_TOOLCHAIN_HAS_THREADS
	depends on BR2_PACKAGE_XORG7 # irrlichtMt (bundled)
	depends on BR2_PACKAGE_HAS_LIBGL # irrlichtMt (bundled)
	depends on BR2_PACKAGE_LUAJIT
	select BR2_PACKAGE_GMP
	select BR2_PACKAGE_JSONCPP
	select BR2_PACKAGE_SQLITE
	select BR2_PACKAGE_ZLIB
	select BR2_PACKAGE_ZSTD
	# At least one option must be enabled
	select BR2_PACKAGE_MINETEST_CLIENT if !BR2_PACKAGE_MINETEST_SERVER
	help
	  Minetest is a near-infinite-world block sandbox game and a
	  game engine, inspired by InfiniMiner, Minecraft, and the
	  like.

	  http://www.minetest.net

if BR2_PACKAGE_MINETEST

config BR2_PACKAGE_MINETEST_CLIENT
	bool "minetest client"
	select BR2_PACKAGE_BZIP2
	select BR2_PACKAGE_FREETYPE
	select BR2_PACKAGE_LIBPNG
	select BR2_PACKAGE_JPEG
	select BR2_PACKAGE_XLIB_LIBXI
	help
	  Build Minetest client.

config BR2_PACKAGE_MINETEST_SERVER
	bool "minetest server"
	help
	  Build Minetest server.

config BR2_PACKAGE_MINETEST_SOUND
	bool "enable sound"
	depends on BR2_PACKAGE_MINETEST_CLIENT
	depends on BR2_PACKAGE_OPENAL_ARCH_SUPPORTS
	depends on BR2_TOOLCHAIN_HAS_THREADS_NPTL # openal
	select BR2_PACKAGE_LIBVORBIS
	select BR2_PACKAGE_OPENAL

comment "sound support needs a toolchain w/ threads NPTL"
	depends on BR2_PACKAGE_MINETEST_CLIENT
	depends on BR2_PACKAGE_OPENAL_ARCH_SUPPORTS
	depends on !BR2_TOOLCHAIN_HAS_THREADS_NPTL

endif

comment "minetest needs a toolchain w/ C++, gcc >= 5.1, threads"
	depends on BR2_PACKAGE_LUAJIT_ARCH_SUPPORTS
	depends on !BR2_INSTALL_LIBSTDCPP \
		|| !BR2_TOOLCHAIN_GCC_AT_LEAST_5 \
		|| !BR2_TOOLCHAIN_HAS_THREADS

comment "minetest needs X11 and an OpenGL provider"
	depends on (BR2_INSTALL_LIBSTDCPP \
		&& BR2_TOOLCHAIN_GCC_AT_LEAST_5 \
		&& BR2_TOOLCHAIN_HAS_THREADS)
	depends on !BR2_PACKAGE_HAS_LIBGL || !BR2_PACKAGE_XORG7
```

## package/minisign/Config.in
```kconfig
config BR2_PACKAGE_MINISIGN
	bool "minisign"
	depends on BR2_TOOLCHAIN_HAS_THREADS
	select BR2_PACKAGE_LIBSODIUM
	select BR2_PACKAGE_LIBSODIUM_FULL
	help
	  Minisign is a dead simple tool to sign files and verify
	  signatures.

	  https://github.com/jedisct1/minisign

comment "minisign needs a toolchain w/ threads"
	depends on !BR2_TOOLCHAIN_HAS_THREADS
```

## package/minisign/Config.in.host
```kconfig
config BR2_PACKAGE_HOST_MINISIGN
	bool "host minisign"
	help
	  Minisign is a dead simple tool to sign files and verify
	  signatures.

	  https://github.com/jedisct1/minisign
```

## package/minizip-zlib/Config.in
```kconfig
config BR2_PACKAGE_MINIZIP_ZLIB
	bool "minizip-zlib"
	select BR2_PACKAGE_ZLIB
	help
	  Legacy minizip provided in contrib/minizip of zlib.

	  https://www.winimage.com/zLibDll/minizip.html
```
