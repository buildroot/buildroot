## package/lzma-alone/Config.in.host
```kconfig
config BR2_PACKAGE_HOST_LZMA_ALONE
	bool "host lzma-alone"
	help
	  LZMA has two well-known command-line tools:
	  1. lzma from LZMA SDK
	  2. lzma from XZ Utils (previously LZMA Utils)

	  This package provides the former one which:
	  1. Gives more control over compression parameters
	  2. Gets named lzma_alone to allow coexistence

	  This tool may be used to prepare firmwares for bootloaders
	  with limited LZMA support.
	  E.g. Broadcom's CFE bootloader for MIPS BCM47xx devices is
	  known to fail to boot images using LZMA compression with
	  dictionary.

	  https://www.7-zip.org/sdk.html
```

## package/makedumpfile/Config.in
```kconfig
comment "makedumpfile needs a uClibc or glibc toolchain w/ wchar, dynamic library"
	depends on !BR2_USE_WCHAR || BR2_STATIC_LIBS \
		|| !(BR2_TOOLCHAIN_USES_UCLIBC || BR2_TOOLCHAIN_USES_GLIBC)

config BR2_PACKAGE_MAKEDUMPFILE
	bool "makedumpfile"
	depends on BR2_TOOLCHAIN_HAS_THREADS
	depends on !BR2_STATIC_LIBS # dlopen
	depends on BR2_USE_WCHAR
	depends on BR2_TOOLCHAIN_USES_UCLIBC || BR2_TOOLCHAIN_USES_GLIBC
	select BR2_PACKAGE_BZIP2
	select BR2_PACKAGE_ELFUTILS
	select BR2_PACKAGE_XZ
	select BR2_PACKAGE_ZLIB
	help
	  Makes a small dumpfile of kdump.

	  https://github.com/makedumpfile/makedumpfile
```

## package/mali-driver/Config.in
```kconfig
comment "mali-driver needs a Linux kernel to be built"
	depends on !BR2_LINUX_KERNEL

config BR2_PACKAGE_MALI_DRIVER
	bool "mali-driver"
	depends on BR2_LINUX_KERNEL
	help
	  This package builds and installs the Linux kernel driver for
	  the Mali Midgard/Bifrost GPU, compatible with recent Linux
	  kernels (>= 5.4). Note that it should be installed together
	  with the corresponding userspace OpenGL libraries, which are
	  usually provided as binaries only by hardware vendors.

	  mali-driver requires a Linux kernel >= 5.4.
```

## package/mariadb/Config.in
```kconfig
config BR2_PACKAGE_MARIADB
	bool "mariadb"
	depends on BR2_INSTALL_LIBSTDCPP # fmt
	depends on !BR2_STATIC_LIBS
	depends on BR2_USE_MMU # fork()
	depends on BR2_TOOLCHAIN_HAS_THREADS
	depends on BR2_TOOLCHAIN_HAS_ATOMIC || BR2_TOOLCHAIN_HAS_SYNC_8
	depends on BR2_USE_WCHAR # fmt
	select BR2_PACKAGE_LIBAIO
	select BR2_PACKAGE_LIBXML2
	select BR2_PACKAGE_FMT
	select BR2_PACKAGE_NCURSES
	select BR2_PACKAGE_OPENSSL
	select BR2_PACKAGE_LIBOPENSSL_ENABLE_DES if BR2_PACKAGE_LIBOPENSSL
	select BR2_PACKAGE_LIBOPENSSL_ENABLE_RMD160 if BR2_PACKAGE_LIBOPENSSL
	select BR2_PACKAGE_PCRE2
	# HAVE_SYSTEM_LIBFMT cmake < 3.30 check TRY_RUN issue
	select BR2_HOST_CMAKE_AT_LEAST_3_30
	help
	  MariaDB is one of the most popular database servers in the
	  world.  It's made by the original developers of MySQL and
	  guaranteed to stay open source.

	  http://www.mariadb.org/

if BR2_PACKAGE_MARIADB

config BR2_PACKAGE_MARIADB_SERVER
	bool "mariadb server"
	help
	  Install the mariadb server on the target.

config BR2_PACKAGE_MARIADB_SERVER_EMBEDDED
	bool "mariadb embedded server"
	depends on BR2_PACKAGE_MARIADB_SERVER
	help
	  Install the mariadb embedded server on the target.

endif

comment "mariadb needs a toolchain w/ dynamic library, C++, threads, wchar"
	depends on BR2_STATIC_LIBS || !BR2_INSTALL_LIBSTDCPP \
		|| !BR2_TOOLCHAIN_HAS_THREADS || !BR2_USE_WCHAR
	depends on BR2_TOOLCHAIN_HAS_ATOMIC || BR2_TOOLCHAIN_HAS_SYNC_8
```

## package/mawk/Config.in
```kconfig
config BR2_PACKAGE_MAWK
	bool "mawk"
	help
	  Interpreter for the AWK Programming Language.

	  http://invisible-island.net/mawk/mawk.html
```

## package/mbedtls/Config.in
```kconfig
config BR2_PACKAGE_MBEDTLS
	bool "mbedtls"
	help
	  mbed TLS (formerly known as PolarSSL) makes it trivially easy
	  for developers to include cryptographic and SSL/TLS
	  capabilities in their (embedded) products, facilitating this
	  functionality with a minimal coding footprint.

	  https://tls.mbed.org/

if BR2_PACKAGE_MBEDTLS

config BR2_PACKAGE_MBEDTLS_PROGRAMS
	bool "mbedtls programs"
	depends on BR2_USE_MMU # fork()
	help
	  This option enables the installation and the build of
	  mbed TLS companion programs.

config BR2_PACKAGE_MBEDTLS_DTLS_SRTP
	bool "enable DTLS-SRTP support"
	help
	  Enable support for negotiation of DTLS-SRTP (RFC 5764)
	  through the use_srtp extension.

endif
```

## package/mbpoll/Config.in
```kconfig
config BR2_PACKAGE_MBPOLL
	bool "mbpoll"
	select BR2_PACKAGE_LIBMODBUS
	help
	  mbpoll is a command line utility to communicate with ModBus
	  slave (RTU or TCP).

	  https://github.com/epsilonrt/mbpoll
```

## package/mbw/Config.in
```kconfig
config BR2_PACKAGE_MBW
	bool "mbw"
	help
	  MBW is a memory bandwidth benchmarking tool.
	  MBW determines the "copy" memory bandwidth available
	  to userspace programs.

	  https://github.com/raas/mbw
```

## package/mdadm/Config.in
```kconfig
config BR2_PACKAGE_MDADM
	bool "mdadm"
	depends on !BR2_STATIC_LIBS # dlfcn.h
	depends on BR2_USE_MMU # fork()
	depends on BR2_TOOLCHAIN_HEADERS_AT_LEAST_4_10 # MD_DISK_FAILFAST
	help
	  Utility for managing Linux Software RAID arrays.

	  https://raid.wiki.kernel.org/index.php/A_guide_to_mdadm

comment "mdadm needs a toolchain w/ dynamic library"
	depends on BR2_STATIC_LIBS
	depends on BR2_USE_MMU

comment "mdadm needs kernel headers >= 4.10"
	depends on !BR2_TOOLCHAIN_HEADERS_AT_LEAST_4_10
```

## package/mdio-tools/Config.in
```kconfig
comment "mdio-tools needs a Linux kernel to be built"
	depends on BR2_USE_MMU
	depends on !BR2_LINUX_KERNEL

comment "mdio-tools needs a toolchain w/ headers >= 5.1"
	depends on BR2_USE_MMU
	depends on BR2_LINUX_KERNEL
	depends on !BR2_TOOLCHAIN_HEADERS_AT_LEAST_5_1

config BR2_PACKAGE_MDIO_TOOLS
	bool "mdio-tools"
	depends on BR2_USE_MMU # fork()
	depends on BR2_LINUX_KERNEL
	depends on BR2_TOOLCHAIN_HEADERS_AT_LEAST_5_1
	select BR2_PACKAGE_LIBMNL
	help
	  Low-level debug tools for MDIO devices.

	  https://github.com/wkz/mdio-tools
```

## package/mdnsd/Config.in
```kconfig
config BR2_PACKAGE_MDNSD
	bool "mdnsd"
	depends on BR2_USE_MMU # fork()
	help
	  Small mDNS-SD daemon for advertising services and device
	  discovery, similar to Avahi and Bonjour, at fraction of
	  the size, ~90 kB.

	  By default, mdnsd acts as a responder on all interfaces
	  that support multicast.  It works with both IPv4 & IPv6,
	  advertising services from /etc/mdns.d/*.service (common
	  services included below).  To override defaults, e.g.,
	  path to services, TTL of multicast frames, hostname, or
	  default interface, set MDNSD_ARGS in /etc/default/mdnsd

	  https://github.com/troglobit/mdnsd

if BR2_PACKAGE_MDNSD

config BR2_PACKAGE_MDNSD_MQUERY
	bool "mquery"
	help
	  Scan a LAN for mDNS capable devices, or query specific
	  records, similar to the mdns-scan and avahi-browse tools.
	  Useful for verifying multicast connectivity or locating
	  neighbors with link-local address.

comment "Services to advertise"

config BR2_PACKAGE_MDNSD_FTP_SERVICE
	bool "FTP service"

config BR2_PACKAGE_MDNSD_HTTP_SERVICE
	bool "HTTP service"

config BR2_PACKAGE_MDNSD_IPP_SERVICE
	bool "IPP service"

config BR2_PACKAGE_MDNSD_PRINTER_SERVICE
	bool "Printer service"

config BR2_PACKAGE_MDNSD_SSH_SERVICE
	bool "SSH service"
	default y if BR2_PACKAGE_DROPBEAR
	default y if BR2_PACKAGE_OPENSSH
	default y if BR2_PACKAGE_LIBSSH_SERVER

endif
```

## package/memtest86/Config.in
```kconfig
config BR2_PACKAGE_MEMTEST86
	bool "memtest86"
	depends on BR2_i386 || BR2_x86_64
	help
	  Memtest86+ is a bootable standalone memory test program.

	  Buildroot does not support packages with a '+' sign in their
	  name, which explains why it is named memtest86 and not
	  memtest86+.

	  Memtest86+ is a utility designed to test whether your memory
	  is in working order. It repeatedly writes an enormous amount
	  of different patterns to all memory locations and reads them
	  back again and verifies whether the result of the read is the
	  same as what was written to memory.

	  Memtest86+ will only work on 32-bit or 64-bit x86 targets. It
	  boots and autodetects hardware. Refer README.md for boot
	  options.

	  It can be loaded and run either directly by a PC BIOS (legacy
	  or UEFI) or via an intermediate bootloader that supports the
	  Linux 16-bit, 32-bit, 64-bit, or EFI handover boot protocol.

	  It can be added to the grub2 boot menu by adding the following
	  lines to the bottom of grub.cfg

	  Example for legacy BIOS using the Linux 16-bit boot protocol,
	  with built-in support for USB keyboards or running on a serial
	  line:

	  menuentry "Start Memtest86+ (USB keyboards)" {
	      linux16 /boot/memtest.bin keyboard=both
	  }
	  menuentry "Start Memtest86+ (serial line)" {
	      linux16 /boot/memtest.bin console=ttyS0,115200
	  }

	  Or for UEFI BIOS using the Linux 32-bit or 64-bit boot
	  protocols, using USB keyboard:

	  menuentry "Start Memtest86+ (USB keyboards)" {
	      linux /EFI/BOOT/memtest.efi keyboard=both
	  }

	  Other boot loaders will have similar requirements.

	  http://www.memtest.org
```

## package/mender-connect/Config.in
```kconfig
config BR2_PACKAGE_MENDER_CONNECT
	bool "mender-connect"
	depends on BR2_PACKAGE_HOST_GO_TARGET_ARCH_SUPPORTS
	depends on BR2_PACKAGE_HOST_GO_TARGET_CGO_LINKING_SUPPORTS
	depends on BR2_TOOLCHAIN_HAS_THREADS # libglib2, mender
	depends on BR2_USE_WCHAR # libglib2 -> gettext
	depends on BR2_USE_MMU # dbus -> fork()
	select BR2_PACKAGE_DBUS # runtime
	select BR2_PACKAGE_HOST_GO
	select BR2_PACKAGE_LIBGLIB2
	select BR2_PACKAGE_MENDER # runtime
	select BR2_PACKAGE_OPENSSL
	help
	  mender-connect is a daemon responsible for handling
	  bidirectional (websocket) communication with the Mender
	  server. The daemon is responsible for implementing a range of
	  troubleshooting features to the device as well as several
	  enhancement to the mender-client.

	  Mender Connect is loosely coupled with the Mender Client. The
	  main information passed between mender-client and
	  mender-connect is the device authorization status. Since only
	  accepted devices can interact with the Mender Server, the
	  Mender Client passes over DBus the authorization token which
	  Mender Connect uses to establish a Websocket connection to the
	  server.

	  https://github.com/mendersoftware/mender-connect

comment "mender-connect needs a toolchain w/ threads, wchar"
	depends on BR2_PACKAGE_HOST_GO_TARGET_ARCH_SUPPORTS
	depends on BR2_PACKAGE_HOST_GO_TARGET_CGO_LINKING_SUPPORTS
	depends on BR2_USE_MMU
	depends on !BR2_TOOLCHAIN_HAS_THREADS || !BR2_USE_WCHAR
```

## package/mender-grubenv/Config.in
```kconfig
config BR2_PACKAGE_MENDER_GRUBENV
	bool "mender-grubenv"
	depends on BR2_TARGET_GRUB2_ARCH_SUPPORTS
	depends on BR2_PACKAGE_MENDER # runtime
	depends on BR2_TARGET_GRUB2
	depends on !(BR2_TARGET_GRUB2_HAS_LEGACY_BOOT && BR2_TARGET_GRUB2_HAS_EFI_BOOT)
	help
	  Contains the boot scripts and tools used by Mender to
	  integrate with the GRUB bootloader.

	  The following Grub modules must be selected for this package:
	  loadenv hashsum echo halt gcry_sha256 test regexp

	  https://github.com/mendersoftware/grub-mender-grubenv

if BR2_PACKAGE_MENDER_GRUBENV

config BR2_PACKAGE_MENDER_GRUBENV_DEFINES
	string "path to grubenv defines"
	help
	  Specify a path to the mender grubenv defines file.
	  If no path is specified, the example file in the source
	  directory will be used.

	  The example file in the source directory sets the following:
	  mender_rootfsa_part=2
	  mender_rootfsb_part=3
	  mender_kernel_root_base=/dev/mmcblk0p
	  mender_grub_storage_device=hd0
	  kernel_imagetype=bzImage

endif

comment "mender-grubenv needs a grub2 bootloader"
	depends on BR2_TARGET_GRUB2_ARCH_SUPPORTS
	depends on BR2_PACKAGE_MENDER
	depends on !BR2_TARGET_GRUB2

comment "mender-grubenv does not support both legacy and EFI grub2 bootloaders at the same time"
	depends on BR2_PACKAGE_MENDER
	depends on BR2_TARGET_GRUB2_HAS_LEGACY_BOOT && BR2_TARGET_GRUB2_HAS_EFI_BOOT
```
