## package/ftxui/Config.in
```kconfig
config BR2_PACKAGE_FTXUI
	bool "ftxui"
	depends on BR2_INSTALL_LIBSTDCPP
	depends on BR2_TOOLCHAIN_HAS_THREADS
	depends on BR2_USE_WCHAR # std::wstring()
	help
	  FTXUI is a simple cross-platform C++ library
	  for terminal based user interfaces

	  https://arthursonzogni.github.io/FTXUI/

comment "ftxui needs a toolchain w/ C++, wchar and threads"
	depends on !BR2_INSTALL_LIBSTDCPP || !BR2_TOOLCHAIN_HAS_THREADS || \
		!BR2_USE_WCHAR
```

## package/fwts/Config.in
```kconfig
config BR2_PACKAGE_FWTS_ARCH_SUPPORTS
	bool
	default y if BR2_aarch64
	default y if BR2_arm
	default y if BR2_i386
	default y if BR2_RISCV_64
	default y if BR2_x86_64

config BR2_PACKAGE_FWTS
	bool "fwts"
	depends on BR2_PACKAGE_FWTS_ARCH_SUPPORTS
	depends on BR2_PACKAGE_LIBBSD_ARCH_SUPPORTS # libbsd
	depends on BR2_USE_MMU # libglib2
	depends on BR2_USE_WCHAR # libglib2, libbsd
	depends on BR2_TOOLCHAIN_HAS_THREADS # libglib2, libbsd
	depends on !BR2_STATIC_LIBS # libbsd
	depends on BR2_TOOLCHAIN_USES_GLIBC # execinfo.h
	select BR2_PACKAGE_LIBGLIB2
	select BR2_PACKAGE_LIBBSD
	help
	  Firmware Test Suite (FWTS) is a test suite that performs
	  sanity checks on firmware. It is intended to identify BIOS and
	  ACPI errors and if appropriate it will try to explain the
	  errors and give advice to help workaround or fix firmware
	  bugs.

	  dtc (libfdt) is an optional dependency for fdt related tests.

	  For testing EFI runtime services, the Kernel config must
	  have CONFIG_EFI_TEST=y (since Kernel v4.9).

	  https://wiki.ubuntu.com/FirmwareTestSuite

comment "fwts needs a glibc toolchain w/ wchar, threads, dynamic library"
	depends on BR2_PACKAGE_FWTS_ARCH_SUPPORTS
	depends on BR2_PACKAGE_LIBBSD_ARCH_SUPPORTS # libbsd
	depends on BR2_USE_MMU
	depends on !BR2_USE_WCHAR || !BR2_TOOLCHAIN_HAS_THREADS || \
		!BR2_TOOLCHAIN_USES_GLIBC || BR2_STATIC_LIBS
```

## package/fwupd-efi/Config.in
```kconfig
config BR2_PACKAGE_FWUPD_EFI
	bool "fwupd-efi"
	depends on BR2_PACKAGE_GNU_EFI_ARCH_SUPPORTS
	select BR2_PACKAGE_GNU_EFI
	select BR2_PACKAGE_HOST_PYTHON_USWID
	help
	  EFI Application used by uefi-capsule plugin in fwupd.

	  https://github.com/fwupd/fwupd-efi
```

## package/fwupd/Config.in
```kconfig
config BR2_PACKAGE_FWUPD
	bool "fwupd"
	depends on !BR2_STATIC_LIBS # libxmlb
	depends on BR2_USE_WCHAR # libglib2
	depends on BR2_TOOLCHAIN_HAS_THREADS # libglib2, libusb
	depends on BR2_TOOLCHAIN_GCC_AT_LEAST_4_9 # libusb
	depends on BR2_USE_MMU # libglib2
	select BR2_PACKAGE_LIBGLIB2
	select BR2_PACKAGE_LIBJCAT
	select BR2_PACKAGE_LIBXMLB
	select BR2_PACKAGE_LIBUSB
	select BR2_PACKAGE_ZLIB
	help
	  Fwupd is a simple daemon to allow session software
	  to update device firmware on your local machine.

	  https://fwupd.org/

comment "fwupd needs a toolchain w/ wchar, threads, dynamic library, gcc >= 4.9"
	depends on BR2_USE_MMU
	depends on !BR2_USE_WCHAR || !BR2_TOOLCHAIN_HAS_THREADS || \
		BR2_STATIC_LIBS || !BR2_TOOLCHAIN_GCC_AT_LEAST_4_9
```

## package/fxdiv/Config.in
```kconfig
config BR2_PACKAGE_FXDIV
	bool "fxdiv"
	help
	  Header-only library for division via fixed-point
	  multiplication by inverse.

	  https://github.com/Maratyszcza/FXdiv
```

## package/gcc/Config.in.host
```kconfig
comment "GCC Options"

choice
	prompt "GCC compiler Version"
	default BR2_GCC_VERSION_ARC if BR2_GCC_VERSION_4_8_ARC # legacy
	default BR2_GCC_VERSION_ARC if BR2_arc
	default BR2_GCC_VERSION_POWERPC_SPE if BR2_POWERPC_CPU_HAS_SPE
	default BR2_GCC_VERSION_13_X
	help
	  Select the version of gcc you wish to use.

config BR2_GCC_VERSION_ARC
	bool "gcc arc (13.1)"
	# Only supported architecture
	depends on BR2_arc
	select BR2_TOOLCHAIN_GCC_AT_LEAST_13

config BR2_GCC_VERSION_POWERPC_SPE
	bool "gcc powerpc spe"
	# powerpc spe support has been deprecated since gcc 8.x.
	# https://gcc.gnu.org/ml/gcc/2018-04/msg00102.html
	depends on BR2_POWERPC_CPU_HAS_SPE
	select BR2_TOOLCHAIN_GCC_AT_LEAST_8

config BR2_GCC_VERSION_12_X
	bool "gcc 12.x"
	depends on !BR2_ARCH_NEEDS_GCC_AT_LEAST_13
	# powerpc spe support has been deprecated since gcc 8.x.
	# https://gcc.gnu.org/ml/gcc/2018-04/msg00102.html
	depends on !BR2_POWERPC_CPU_HAS_SPE
	# ARC HS48 rel 31 only supported by gcc arc fork.
	depends on !BR2_archs4x_rel31
	select BR2_TOOLCHAIN_GCC_AT_LEAST_12

config BR2_GCC_VERSION_13_X
	bool "gcc 13.x"
	depends on !BR2_ARCH_NEEDS_GCC_AT_LEAST_14
	# powerpc spe support has been deprecated since gcc 8.x.
	# https://gcc.gnu.org/ml/gcc/2018-04/msg00102.html
	depends on !BR2_POWERPC_CPU_HAS_SPE
	select BR2_TOOLCHAIN_GCC_AT_LEAST_13

config BR2_GCC_VERSION_14_X
	bool "gcc 14.x"
	depends on !BR2_ARCH_NEEDS_GCC_AT_LEAST_15
	# powerpc spe support has been deprecated since gcc 8.x.
	# https://gcc.gnu.org/ml/gcc/2018-04/msg00102.html
	depends on !BR2_POWERPC_CPU_HAS_SPE
	# Severely broken on Microblaze
	# https://gcc.gnu.org/bugzilla/show_bug.cgi?id=118280
	depends on !BR2_microblaze
	select BR2_TOOLCHAIN_GCC_AT_LEAST_14

endchoice

config BR2_GCC_SUPPORTS_DLANG
	bool
	default y if BR2_aarch64
	default y if BR2_arm
	default y if BR2_i386
	default y if BR2_mips || BR2_mipsel
	default y if BR2_mips64 || BR2_mips64el
	default y if BR2_powerpc || BR2_powerpc64 || BR2_powerpc64le
	default y if BR2_x86_64
	default y if BR2_riscv && !BR2_RISCV_64
	depends on BR2_TOOLCHAIN_GCC_AT_LEAST_9
	depends on BR2_TOOLCHAIN_USES_GLIBC
	# "The D front-end is now itself written in D, in order to build GDC, you
	# will need a working GDC compiler (GCC version 9.1 or later)."
	# https://gcc.gnu.org/git/?p=gcc.git;a=commitdiff;h=5fee5ec362f7a243f459e6378fd49dfc89dc9fb5
	depends on !BR2_TOOLCHAIN_GCC_AT_LEAST_12

config BR2_GCC_VERSION
	string
	default "8.4.0"     if BR2_GCC_VERSION_POWERPC_SPE
	default "12.4.0"    if BR2_GCC_VERSION_12_X
	default "13.4.0"    if BR2_GCC_VERSION_13_X
	default "14.3.0"    if BR2_GCC_VERSION_14_X
	default "arc-2023.09-release" if BR2_GCC_VERSION_ARC

config BR2_EXTRA_GCC_CONFIG_OPTIONS
	string "Additional gcc options"
	default ""
	help
	  Any additional gcc configure options you may want to
	  include. Those options are applied for all of the gcc
	  initial, gcc intermediate and gcc final passes.

config BR2_TOOLCHAIN_BUILDROOT_CXX
	bool "Enable C++ support"
	select BR2_INSTALL_LIBSTDCPP
	help
	  Enable this option if you want your toolchain to support the
	  C++ language and you want C++ libraries to be installed on
	  your target system.

comment "Fortran support needs a toolchain w/ wchar"
	depends on BR2_TOOLCHAIN_HAS_LIBQUADMATH
	depends on !BR2_USE_WCHAR # libquadmath

config BR2_TOOLCHAIN_BUILDROOT_FORTRAN
	bool "Enable Fortran support"
	# on architecture building libquadmath, wchar is required
	depends on !BR2_TOOLCHAIN_HAS_LIBQUADMATH || \
		(BR2_TOOLCHAIN_HAS_LIBQUADMATH && BR2_USE_WCHAR)
	# internal compiler error: in gen_reg_rtx, at emit-rtl.cc:1167
	# fixed in gcc 14.x, so disable gcc 12.x/13.x
	depends on !(BR2_microblaze && \
		(BR2_GCC_VERSION_12_X || BR2_GCC_VERSION_13_X))
	select BR2_TOOLCHAIN_HAS_FORTRAN
	help
	  Enable this option if you want your toolchain to support the
	  Fortran language and you want Fortran libraries to be
	  installed on your target system.

config BR2_TOOLCHAIN_BUILDROOT_DLANG
	bool "Enable D language support"
	depends on BR2_GCC_SUPPORTS_DLANG
	select BR2_TOOLCHAIN_HAS_DLANG
	help
	  Enable this option if you want your toolchain to support the
	  D language and you want D libraries to be installed on your
	  target system.

config BR2_GCC_ENABLE_OPENMP
	bool "Enable compiler OpenMP support"
	depends on !BR2_PTHREADS_NONE && !BR2_arc && !BR2_microblaze
	select BR2_TOOLCHAIN_HAS_OPENMP
	help
	  Enable OpenMP support for the compiler

config BR2_GCC_ENABLE_GRAPHITE
	bool "Enable graphite support"
	help
	  This option enables the graphite optimizations in the
	  compiler.
```

## package/gcr/Config.in
```kconfig
config BR2_PACKAGE_GCR
	bool "gcr"
	depends on BR2_PACKAGE_LIBGPG_ERROR_ARCH_SUPPORTS # libgcrypt -> libgpg-error
	depends on BR2_USE_WCHAR # libglib2
	depends on BR2_TOOLCHAIN_HAS_THREADS # libglib2
	depends on BR2_USE_MMU # libglib2
	depends on !BR2_STATIC_LIBS # p11-kit
	select BR2_PACKAGE_GNUPG2 if BR2_PACKAGE_GNUPG2_DEPENDS && !BR2_PACKAGE_GNUPG # runtime
	select BR2_PACKAGE_GNUPG if !BR2_PACKAGE_GNUPG2_DEPENDS # runtime
	select BR2_PACKAGE_LIBGCRYPT
	select BR2_PACKAGE_LIBGLIB2
	select BR2_PACKAGE_P11_KIT
	help
	  Library for cryptographic UIs and accessing PKCS#11 modules.

	  https://developer.gnome.org/gcr/

comment "gcr needs a toolchain w/ wchar, threads, dynamic library"
	depends on BR2_PACKAGE_LIBGPG_ERROR_ARCH_SUPPORTS
	depends on BR2_USE_MMU
	depends on !BR2_USE_WCHAR || !BR2_TOOLCHAIN_HAS_THREADS || \
		BR2_STATIC_LIBS
```

## package/gdal/Config.in
```kconfig
config BR2_PACKAGE_GDAL
	bool "gdal"
	depends on BR2_TOOLCHAIN_HAS_SYNC_4 # json-c
	depends on BR2_INSTALL_LIBSTDCPP # proj
	# configure can't find proj, when linking statically
	depends on !BR2_STATIC_LIBS
	depends on BR2_TOOLCHAIN_GCC_AT_LEAST_4_7 # C++11, proj
	depends on !BR2_TOOLCHAIN_HAS_BINUTILS_BUG_27597
	depends on BR2_TOOLCHAIN_HAS_THREADS # proj
	depends on BR2_USE_WCHAR # proj
	select BR2_PACKAGE_JPEG
	select BR2_PACKAGE_JSON_C
	select BR2_PACKAGE_LIBGEOTIFF
	select BR2_PACKAGE_LIBPNG
	select BR2_PACKAGE_PROJ
	select BR2_PACKAGE_ZLIB
	help
	  GDAL is a translator library for raster and vector geospatial
	  data formats. As a library, it presents a single raster
	  abstract data model and single vector abstract data model to
	  the calling application for all supported formats. It also
	  comes with a variety of useful command line utilities for data
	  translation and processing.

	  https://gdal.org/

comment "gdal needs a toolchain w/ C++, dynamic library, gcc >= 4.7, not binutils bug 27597, threads, wchar"
	depends on BR2_TOOLCHAIN_HAS_SYNC_4
	depends on !BR2_INSTALL_LIBSTDCPP || BR2_STATIC_LIBS || \
		!BR2_TOOLCHAIN_GCC_AT_LEAST_4_7 || \
		BR2_TOOLCHAIN_HAS_BINUTILS_BUG_27597 || \
		!BR2_TOOLCHAIN_HAS_THREADS || !BR2_USE_WCHAR
```

## package/gdbm/Config.in
```kconfig
config BR2_PACKAGE_GDBM
	bool "gdbm"
	depends on BR2_USE_MMU # fork()
	depends on BR2_USE_WCHAR
	help
	  GNU dbm is a set of database routines that use extensible
	  hashing. It works similar to the standard UNIX dbm routines.

	  https://www.gnu.org/software/gdbm/gdbm.html

comment "gdbm needs a toolchain w/ wchar"
	depends on BR2_USE_MMU
	depends on !BR2_USE_WCHAR
```

## package/gdk-pixbuf-xlib/Config.in
```kconfig
config BR2_PACKAGE_GDK_PIXBUF_XLIB
	bool "gdk-pixbuf-xlib"
	depends on BR2_PACKAGE_XORG7
	depends on BR2_USE_MMU # gdk-pixbuf -> glib2
	depends on BR2_USE_WCHAR # gdk-pixbuf -> glib2
	depends on BR2_TOOLCHAIN_HAS_THREADS # gdk-pixbuf -> glib2
	select BR2_PACKAGE_GDK_PIXBUF
	select BR2_PACKAGE_XLIB_LIBX11
	help
	  Deprecated Xlib integration for GdkPixbuf.

	  https://gitlab.gnome.org/Archive/gdk-pixbuf-xlib

comment "gdk-pixbuf-xlib needs a toolchain w/ wchar, threads"
	depends on BR2_PACKAGE_XORG7
	depends on BR2_USE_MMU
	depends on !BR2_USE_WCHAR || !BR2_TOOLCHAIN_HAS_THREADS
```

## package/gemmlowp/Config.in
```kconfig
config BR2_PACKAGE_GEMMLOWP
	bool "gemmlowp"
	depends on BR2_INSTALL_LIBSTDCPP
	depends on BR2_TOOLCHAIN_GCC_AT_LEAST_4_8 # C++11
	help
	  Low-precision matrix multiplication.

	  https://github.com/google/gemmlowp

comment "gemmlowp needs a toolchain w/ C++11"
	depends on !BR2_INSTALL_LIBSTDCPP || \
		!BR2_TOOLCHAIN_GCC_AT_LEAST_4_8
```

## package/gitlab-runner/Config.in
```kconfig
config BR2_PACKAGE_GITLAB_RUNNER
	bool "gitlab-runner"
	depends on BR2_PACKAGE_HOST_GO_TARGET_ARCH_SUPPORTS
	depends on BR2_PACKAGE_HOST_GO_TARGET_CGO_LINKING_SUPPORTS
	depends on BR2_TOOLCHAIN_HAS_THREADS
	depends on BR2_USE_MMU # git
	depends on BR2_USE_WCHAR # tar
	select BR2_PACKAGE_BASH # runtime, shells/bash.go probably want to support bashism.
	select BR2_PACKAGE_BUSYBOX_SHOW_OTHERS # bash
	select BR2_PACKAGE_CA_CERTIFICATES # runtime
	select BR2_PACKAGE_GIT # runtime
	select BR2_PACKAGE_HOST_GO
	select BR2_PACKAGE_LIBCURL # runtime
	select BR2_PACKAGE_LIBCURL_CURL # runtime
	select BR2_PACKAGE_LIBCURL_FORCE_TLS # runtime
	select BR2_PACKAGE_OPENSSL # runtime
	select BR2_PACKAGE_OPENSSL_FORCE_LIBOPENSSL # runtime
	select BR2_PACKAGE_LIBOPENSSL_BIN # runtime
	select BR2_PACKAGE_TAR # runtime
	help
	  GitLab Runner is the open source project that is used to run
	  your jobs and send the results back to GitLab. It is used in
	  conjunction with GitLab CI/CD, the open-source continuous
	  integration service included with GitLab that coordinates the
	  jobs.

	  https://docs.gitlab.com/runner/

comment "gitlab-runner needs a toolchain w/ threads"
	depends on BR2_PACKAGE_HOST_GO_TARGET_ARCH_SUPPORTS
	depends on BR2_PACKAGE_HOST_GO_TARGET_CGO_LINKING_SUPPORTS
	depends on !BR2_TOOLCHAIN_HAS_THREADS
```
