## package/freeradius-server/Config.in
```kconfig
config BR2_PACKAGE_FREERADIUS_SERVER
	bool "freeradius-server"
	depends on BR2_USE_MMU # fork()
	depends on !BR2_STATIC_LIBS # libtalloc
	depends on BR2_TOOLCHAIN_HAS_THREADS
	depends on BR2_TOOLCHAIN_USES_GLIBC
	select BR2_PACKAGE_LIBOPENSSL_ENABLE_MD4 if BR2_PACKAGE_LIBOPENSSL
	select BR2_PACKAGE_LIBTALLOC
	select BR2_PACKAGE_LIBXCRYPT if BR2_TOOLCHAIN_USES_GLIBC
	help
	  FreeRADIUS is an open source server which implements
	  a protocol for remote user Authorization, Authentication
	  and Accounting.

	  http://wiki.freeradius.org/

comment "freeradius-server needs a glibc toolchain w/ threads"
	depends on BR2_USE_MMU
	depends on !BR2_TOOLCHAIN_HAS_THREADS || \
		!BR2_TOOLCHAIN_USES_GLIBC
```

## package/freescale-imx/firmware-ele-imx/Config.in
```kconfig
comment "firmware-ele-imx needs an i.MX platform with EdgeLock Secure Enclave"
	depends on !BR2_PACKAGE_FREESCALE_IMX_HAS_ELE

config BR2_PACKAGE_FIRMWARE_ELE_IMX
	bool "firmware-ele-imx"
	depends on BR2_PACKAGE_FREESCALE_IMX_HAS_ELE
	help
	  Firmware blobs for the EdgeLock Secure Enclave (ELE)
	  present on i.MX8ULP and i.MX9 SoCs.

	  This library is provided by NXP as-is and doesn't have an
	  upstream.

if BR2_PACKAGE_FIRMWARE_ELE_IMX

config BR2_PACKAGE_FIRMWARE_ELE_IMX_AHAB_CONTAINER_IMAGE
	string
	default "mx8ulpa0-ahab-container.img" if BR2_PACKAGE_FREESCALE_IMX_PLATFORM_IMX8ULPA0
	default "mx8ulpa1-ahab-container.img" if BR2_PACKAGE_FREESCALE_IMX_PLATFORM_IMX8ULPA1
	default "mx8ulpa2-ahab-container.img" if BR2_PACKAGE_FREESCALE_IMX_PLATFORM_IMX8ULPA2
	default "mx93a0-ahab-container.img" if BR2_PACKAGE_FREESCALE_IMX_PLATFORM_IMX93A0
	default "mx93a1-ahab-container.img" if BR2_PACKAGE_FREESCALE_IMX_PLATFORM_IMX93A1
	default "mx91a0-ahab-container.img" if BR2_PACKAGE_FREESCALE_IMX_PLATFORM_IMX91A0

endif # BR2_PACKAGE_FIRMWARE_ELE_IMX
```

## package/freescale-imx/firmware-imx/Config.in
```kconfig
config BR2_PACKAGE_FIRMWARE_IMX
	bool "firmware-imx"
	depends on BR2_arm || BR2_aarch64 # Only relevant for i.MX
	help
	  Firmware blobs for the Freescale i.MX SoCs.

	  It contains blobs for SDMA, VPU, HDMI, EDPC, and DDR
	  training.

	  This library is provided by Freescale as-is and doesn't have
	  an upstream.

if BR2_PACKAGE_FIRMWARE_IMX

config BR2_PACKAGE_FIRMWARE_IMX_NEEDS_SDMA_FW
	bool
	default y if BR2_PACKAGE_FREESCALE_IMX_PLATFORM_IMX25_3STACK
	default y if BR2_PACKAGE_FREESCALE_IMX_PLATFORM_IMX27ADS
	default y if BR2_PACKAGE_FREESCALE_IMX_PLATFORM_IMX51
	default y if BR2_PACKAGE_FREESCALE_IMX_PLATFORM_IMX53
	default y if BR2_PACKAGE_FREESCALE_IMX_PLATFORM_IMX6Q
	default y if BR2_PACKAGE_FREESCALE_IMX_PLATFORM_IMX7

config BR2_PACKAGE_FIRMWARE_IMX_NEEDS_VPU_FW
	bool
	default y if BR2_PACKAGE_FREESCALE_IMX_PLATFORM_IMX27ADS
	default y if BR2_PACKAGE_FREESCALE_IMX_PLATFORM_IMX51
	default y if BR2_PACKAGE_FREESCALE_IMX_PLATFORM_IMX53
	default y if BR2_PACKAGE_FREESCALE_IMX_PLATFORM_IMX6Q
	default y if BR2_PACKAGE_FREESCALE_IMX_PLATFORM_IMX8
	default y if BR2_PACKAGE_FREESCALE_IMX_PLATFORM_IMX8X

config BR2_PACKAGE_FIRMWARE_IMX_NEEDS_HDMI_FW
	bool
	default y if BR2_PACKAGE_FREESCALE_IMX_PLATFORM_IMX8M

config BR2_PACKAGE_FIRMWARE_IMX_NEEDS_EPDC_FW
	bool
	default y if BR2_PACKAGE_FREESCALE_IMX_PLATFORM_IMX6Q
	default y if BR2_PACKAGE_FREESCALE_IMX_PLATFORM_IMX6S

config BR2_PACKAGE_FIRMWARE_IMX_NEEDS_DDR_FW
	bool
	default y if BR2_PACKAGE_FREESCALE_IMX_PLATFORM_IMX8M
	default y if BR2_PACKAGE_FREESCALE_IMX_PLATFORM_IMX8MM
	default y if BR2_PACKAGE_FREESCALE_IMX_PLATFORM_IMX8MN

if BR2_PACKAGE_FIRMWARE_IMX_NEEDS_DDR_FW

choice
	bool "DDR training binaries"
	default BR2_PACKAGE_FIRMWARE_IMX_LPDDR4
	help
	  Choose the DDR training binaries to be used depending on the
	  kind of memory that is available on the target board (DDR4,
	  LPDDR4, etc...).

config BR2_PACKAGE_FIRMWARE_IMX_LPDDR4
	bool "lpddr4"
	help
	  Use LPDDR4 binaries (i.e.: lpddr4_pmu_train_*.bin)

config BR2_PACKAGE_FIRMWARE_IMX_DDR4
	bool "DDR4"
	help
	  Use DDR4 binaries (i.e.: ddr4_*_201810.bin).

endchoice # DDR training FW

endif # BR2_PACKAGE_FIRMWARE_IMX_NEEDS_DDR_FW

endif # BR2_PACKAGE_FIRMWARE_IMX
```

## package/freescale-imx/firmware-upower/Config.in
```kconfig
comment "firmware-upower needs an i.MX platform with uPower"
	depends on !BR2_PACKAGE_FREESCALE_IMX_HAS_UPOWER

config BR2_PACKAGE_FIRMWARE_UPOWER
	bool "firmware-upower"
	depends on BR2_PACKAGE_FREESCALE_IMX_HAS_UPOWER
	help
	  NXP i.MX uPower firmware present on i.MX 8ULP SoC.

	  This library is provided by NXP as-is and doesn't have an
	  upstream.

if BR2_PACKAGE_FIRMWARE_UPOWER

config BR2_PACKAGE_FIRMWARE_UPOWER_UPOWER_FIRMWARE_NAME
	string
	default "upower_a0.bin" if BR2_PACKAGE_FREESCALE_IMX_PLATFORM_IMX8ULPA0
	default "upower_a1.bin" if \
		BR2_PACKAGE_FREESCALE_IMX_PLATFORM_IMX8ULPA1 || \
		BR2_PACKAGE_FREESCALE_IMX_PLATFORM_IMX8ULPA2

endif # BR2_PACKAGE_FIRMWARE_UPOWER
```

## package/freescale-imx/imx-gpu-viv/Config.in
```kconfig
comment "imx-gpu-viv needs a glibc toolchain with armhf enabled"
	depends on BR2_arm
	depends on !BR2_TOOLCHAIN_USES_GLIBC || !BR2_ARM_EABIHF

comment "imx-gpu-viv needs a glibc toolchain"
	depends on BR2_aarch64
	depends on !BR2_TOOLCHAIN_USES_GLIBC

config BR2_PACKAGE_IMX_GPU_VIV
	bool "imx-gpu-viv"
	# Pre-built binaries only available for ARM EABIhf
	depends on (BR2_arm && BR2_ARM_EABIHF) || BR2_aarch64
	# Library binaries are linked against libc.so.6
	depends on BR2_TOOLCHAIN_USES_GLIBC
	# Library binaries are linked against libdrm.so.2, except framebuffer
	# output on ARM
	select BR2_PACKAGE_LIBDRM if !(BR2_arm && BR2_PACKAGE_IMX_GPU_VIV_OUTPUT_FB)
	select BR2_PACKAGE_HAS_LIBEGL
	select BR2_PACKAGE_HAS_LIBGLES
	# gbm is only available in the aarch64 blobs
	select BR2_PACKAGE_HAS_LIBGBM if BR2_aarch64
	select BR2_PACKAGE_LIBGBM_HAS_FEATURE_DMA_BUF if BR2_aarch64
	select BR2_PACKAGE_LIBGBM_HAS_FEATURE_FORMAT_MODIFIER_PLANE_COUNT if BR2_aarch64
	select BR2_PACKAGE_HAS_LIBOPENCL
	select BR2_PACKAGE_HAS_LIBOPENVG
	help
	  Userspace libraries for Vivante GPU on i.MX platforms

	  It contains libraries and headers for GLES, OpenCL, and
	  OpenVG. It also contains a plugin for DirectFB-1.4.0, but
	  that doesn't work together with buildroot's DirectFB
	  version.

	  This library is provided by Freescale as-is and doesn't have
	  an upstream.

if BR2_PACKAGE_IMX_GPU_VIV

choice
	prompt "Output option"
	help
	  There are two versions of this library: one for
	  direct framebuffer access, one for wayland rendering.
	  Choose here which version to install.

config BR2_PACKAGE_IMX_GPU_VIV_OUTPUT_FB
	bool "Framebuffer"
	# The i.MX8 blob doesn't support FB output
	depends on !BR2_PACKAGE_FREESCALE_IMX_PLATFORM_IMX8M

config BR2_PACKAGE_IMX_GPU_VIV_OUTPUT_WL
	bool "Wayland"
	select BR2_PACKAGE_WAYLAND
	select BR2_PACKAGE_HAS_LIBEGL_WAYLAND

endchoice

config BR2_PACKAGE_IMX_GPU_VIV_OUTPUT
	string
	default "fb" if BR2_PACKAGE_IMX_GPU_VIV_OUTPUT_FB
	default "wayland" if BR2_PACKAGE_IMX_GPU_VIV_OUTPUT_WL

config BR2_PACKAGE_PROVIDES_LIBEGL
	default "imx-gpu-viv"

config BR2_PACKAGE_PROVIDES_LIBGLES
	default "imx-gpu-viv"

config BR2_PACKAGE_PROVIDES_LIBOPENCL
	default "imx-gpu-viv"

config BR2_PACKAGE_PROVIDES_LIBOPENVG
	default "imx-gpu-viv"

if BR2_aarch64

config BR2_PACKAGE_PROVIDES_LIBGBM
	default "imx-gpu-viv"

config BR2_PACKAGE_IMX_GPU_VIV_PLATFORM
	string
	default "mx8mn" if BR2_PACKAGE_FREESCALE_IMX_PLATFORM_IMX8MN
	default "mx8mp" if BR2_PACKAGE_FREESCALE_IMX_PLATFORM_IMX8MP
	default "mx8mq" if BR2_PACKAGE_FREESCALE_IMX_PLATFORM_IMX8M
	default "mx8qm" if BR2_PACKAGE_FREESCALE_IMX_PLATFORM_IMX8
	default "mx8qxp" if BR2_PACKAGE_FREESCALE_IMX_PLATFORM_IMX8X

endif

config BR2_PACKAGE_IMX_GPU_VIV_EXAMPLES
	bool "install examples"
	# example binaries are linked against libstdc++.so.6
	depends on BR2_INSTALL_LIBSTDCPP
	help
	  Copy the Vivante examples to the target.

	  Warning: examples take approximately 150 MB of disk space.

comment "imx-gpu-viv-examples need a toolchain w/ C++ support"
	depends on !BR2_INSTALL_LIBSTDCPP

config BR2_PACKAGE_IMX_GPU_VIV_GMEM_INFO
	bool "install gmem_info tool"
	help
	  Copy the gmem_info tool to the target which provides
	  information about GPU memory consumption.

endif
```

## package/freescale-imx/imx-kobs/Config.in
```kconfig
config BR2_PACKAGE_IMX_KOBS
	bool "imx-kobs"
	depends on BR2_arm # Only relevant for i.MX
	help
	  The imx-kobs tool is used for writing images to NAND on i.MX
	  platforms.

	  https://github.com/NXPmicro/imx-kobs
```

## package/freescale-imx/imx-seco/Config.in
```kconfig
config BR2_PACKAGE_IMX_SECO
	bool "imx-seco"
	depends on BR2_PACKAGE_FREESCALE_IMX_PLATFORM_IMX8 || \
		BR2_PACKAGE_FREESCALE_IMX_PLATFORM_IMX8X || \
		BR2_PACKAGE_FREESCALE_IMX_PLATFORM_IMX8DXL
	help
	  Firmware file for the i.MX8 and i.MX8X Security Controller.

	  This library is provided by Freescale as-is and doesn't have
	  an upstream.

if BR2_PACKAGE_IMX_SECO

choice
	prompt "i.MX Seco Firmware Release"
	default BR2_PACKAGE_IMX_SECO_MX8QMB0 if BR2_PACKAGE_FREESCALE_IMX_PLATFORM_IMX8
	default BR2_PACKAGE_IMX_SECO_MX8QXC0 if BR2_PACKAGE_FREESCALE_IMX_PLATFORM_IMX8X
	default BR2_PACKAGE_IMX_SECO_MX8DXLB0 if BR2_PACKAGE_FREESCALE_IMX_PLATFORM_IMX8DXL
	help
	  Select the appropriate ahab container image to install
	  to match the iMX asics revision.

	  Note - mismatches result in a failure to boot

config BR2_PACKAGE_IMX_SECO_MX8DXLA0
	bool "imx-seco-mx8dxla0"
	depends on BR2_PACKAGE_FREESCALE_IMX_PLATFORM_IMX8X

config BR2_PACKAGE_IMX_SECO_MX8DXLA1
	bool "imx-seco-mx8dxla1"
	depends on BR2_PACKAGE_FREESCALE_IMX_PLATFORM_IMX8X

config BR2_PACKAGE_IMX_SECO_MX8DXLB0
	bool "imx-seco-mx8dxlb0"
	depends on BR2_PACKAGE_FREESCALE_IMX_PLATFORM_IMX8DXL

config BR2_PACKAGE_IMX_SECO_MX8QMB0
	bool "imx-seco-mx8qmb0"
	depends on BR2_PACKAGE_FREESCALE_IMX_PLATFORM_IMX8

config BR2_PACKAGE_IMX_SECO_MX8QXB0
	bool "imx-seco-mx8qxb0"
	depends on BR2_PACKAGE_FREESCALE_IMX_PLATFORM_IMX8X

config BR2_PACKAGE_IMX_SECO_MX8QXC0
	bool "imx-seco-mx8qxc0"
	depends on BR2_PACKAGE_FREESCALE_IMX_PLATFORM_IMX8X

endchoice

config BR2_PACKAGE_IMX_SECO_AHAB_CONTAINER_IMAGE
	string
	default "mx8dxla0-ahab-container.img" if BR2_PACKAGE_IMX_SECO_MX8DXLA0
	default "mx8dxla1-ahab-container.img" if BR2_PACKAGE_IMX_SECO_MX8DXLA1
	default "mx8dxlb0-ahab-container.img" if BR2_PACKAGE_IMX_SECO_MX8DXLB0
	default "mx8qmb0-ahab-container.img" if BR2_PACKAGE_IMX_SECO_MX8QMB0
	default "mx8qxb0-ahab-container.img" if BR2_PACKAGE_IMX_SECO_MX8QXB0
	default "mx8qxc0-ahab-container.img" if BR2_PACKAGE_IMX_SECO_MX8QXC0

endif
```

## package/freescale-imx/imx-vpu-hantro-daemon/Config.in
```kconfig
comment "imx-vpu-hantro-daemon needs an i.MX-specific Linux kernel to be built"
	depends on !BR2_LINUX_KERNEL

comment "imx-vpu-hantro-daemon needs an i.MX platform with Hantro VPU"
	depends on BR2_LINUX_KERNEL
	depends on !BR2_PACKAGE_FREESCALE_IMX_HAS_VPU_HANTRO

config BR2_PACKAGE_IMX_VPU_HANTRO_DAEMON
	bool "imx-vpu-hantro-daemon"
	depends on BR2_LINUX_KERNEL
	depends on BR2_PACKAGE_FREESCALE_IMX_HAS_VPU_HANTRO
	select BR2_PACKAGE_IMX_VPU_HANTRO
	select BR2_PACKAGE_IMX_VPU_HANTRO_VC if BR2_PACKAGE_FREESCALE_IMX_PLATFORM_IMX8MP
	help
	  i.MX Hantro V4L2 Daemon specific for the NXP i.MX SoC
	  integrating a Hantro Video Processing Unit (VPU) such as the
	  i.MX8MQ/i.MX8MM/i.MX8MP.
```

## package/freescale-imx/imx-vpu-hantro-vc/Config.in
```kconfig
comment "imx-vpu-hantro-vc needs an i.MX-specific Linux kernel to be built"
	depends on !BR2_LINUX_KERNEL

comment "imx-vpu-hantro-vc needs an i.MX platform with Hantro VPU"
	depends on BR2_LINUX_KERNEL
	depends on !BR2_PACKAGE_FREESCALE_IMX_HAS_VPU_HANTRO

config BR2_PACKAGE_IMX_VPU_HANTRO_VC
	bool "imx-vpu-hantro-vc"
	depends on BR2_LINUX_KERNEL
	depends on BR2_PACKAGE_FREESCALE_IMX_HAS_VPU_HANTRO
	help
	  i.MX VC8000E Encoder library. Intended for the i.MX 8M Plus
	  processor.
```

## package/freeswitch/Config.in
```kconfig
config BR2_PACKAGE_FREESWITCH
	bool "freeswitch"
	depends on BR2_INSTALL_LIBSTDCPP
	depends on !BR2_STATIC_LIBS # apr, included in freeswitch source
	depends on BR2_TOOLCHAIN_HAS_THREADS
	depends on BR2_USE_MMU # apr, included in freeswitch source
	depends on BR2_USE_WCHAR # uses wchar_t
	select BR2_PACKAGE_FFMPEG_SWSCALE if BR2_PACKAGE_FFMPEG
	select BR2_PACKAGE_LIBCURL
	select BR2_PACKAGE_LIBXCRYPT if BR2_TOOLCHAIN_USES_GLIBC
	select BR2_PACKAGE_JPEG
	select BR2_PACKAGE_OPENSSL
	select BR2_PACKAGE_PCRE
	select BR2_PACKAGE_SOFIA_SIP
	select BR2_PACKAGE_SPANDSP
	select BR2_PACKAGE_SPEEX
	select BR2_PACKAGE_SPEEXDSP
	select BR2_PACKAGE_SQLITE
	select BR2_PACKAGE_TIFF
	select BR2_PACKAGE_UTIL_LINUX
	select BR2_PACKAGE_UTIL_LINUX_LIBUUID
	select BR2_PACKAGE_ZLIB
	help
	  FreeSWITCH is a scalable open source cross-platform
	  telephony platform designed to route and interconnect
	  popular communication protocols using audio, video, text or
	  any other form of media.

	  https://www.freeswitch.org

config BR2_PACKAGE_FREESWITCH_OPENCV4
	bool
	default y
	depends on BR2_PACKAGE_OPENCV4
	depends on !BR2_TOOLCHAIN_USES_UCLIBC # objdetect
	depends on BR2_PACKAGE_PROTOBUF_ARCH_SUPPORTS # objdetect
	depends on BR2_TOOLCHAIN_GCC_AT_LEAST_8 # objdetect
	# src/mod/applications/mod_cv/mod_cv.cpp includes
	# highgui.h, imgproc.hpp & objdetect.hpp
	select BR2_PACKAGE_OPENCV4_LIB_HIGHGUI
	select BR2_PACKAGE_OPENCV4_LIB_IMGPROC
	select BR2_PACKAGE_OPENCV4_LIB_OBJDETECT

comment "freeswitch needs a toolchain w/ C++, dynamic library, threads, wchar"
	depends on BR2_USE_MMU
	depends on !BR2_INSTALL_LIBSTDCPP || BR2_STATIC_LIBS \
		|| !BR2_TOOLCHAIN_HAS_THREADS || !BR2_USE_WCHAR
```

## package/frotz/Config.in
```kconfig
config BR2_PACKAGE_FROTZ
	bool "frotz"
	select BR2_PACKAGE_NCURSES
	help
	  Frotz is an interpreter for old Infocom adventure games and
	  other Z-code games. Note that frotz cannot be run as root.
	  You must add a normal user to your buildroot configuration to
	  be able to use it.

	  https://661.org/proj/if/frotz/
```

## package/frr/Config.in
```kconfig
config BR2_PACKAGE_FRR
	bool "frr"
	depends on BR2_TOOLCHAIN_HAS_THREADS # protobuf-c
	depends on !BR2_STATIC_LIBS # libyang
	depends on BR2_USE_MMU # fork()
	depends on BR2_TOOLCHAIN_HAS_SYNC_4 # json-c, libyang
	depends on BR2_INSTALL_LIBSTDCPP # protobuf-c
	depends on BR2_PACKAGE_HOST_PROTOBUF_ARCH_SUPPORTS # protobuf-c
	depends on BR2_HOST_GCC_AT_LEAST_7 # protobuf-c
	select BR2_PACKAGE_BASH
	select BR2_PACKAGE_BUSYBOX_SHOW_OTHERS # bash
	select BR2_PACKAGE_LIBXCRYPT if BR2_TOOLCHAIN_USES_GLIBC
	select BR2_PACKAGE_LIBYANG
	select BR2_PACKAGE_READLINE
	select BR2_PACKAGE_JSON_C
	select BR2_PACKAGE_PROTOBUF_C
	help
	  The FRRouting Protocol Suite.

	  FRR is free software that implements and manages various
	  IPv4 and IPv6 routing protocols.

	  https://frrouting.org

if BR2_PACKAGE_FRR

config BR2_PACKAGE_FRR_BFD
	bool "BFD protocol"
	default y
	depends on BR2_TOOLCHAIN_HEADERS_AT_LEAST_4_10
	help
	  Build Bidirectional Forwarding Detection daemon.

config BR2_PACKAGE_FRR_BMP
	bool "BMP protocol"
	select BR2_PACKAGE_C_ARES
	help
	  Build BGP Monitoring Protocol daemon.

config BR2_PACKAGE_FRR_NHRPD
	bool "NHRPD protocol"
	select BR2_PACKAGE_C_ARES
	help
	  Build Next Hop Routing Protocol daemon.

endif

comment "frr needs a toolchain w/ threads, dynamic library, C++, host gcc >= 7"
	depends on BR2_PACKAGE_HOST_PROTOBUF_ARCH_SUPPORTS
	depends on BR2_TOOLCHAIN_HAS_SYNC_4
	depends on BR2_USE_MMU
	depends on !BR2_TOOLCHAIN_HAS_THREADS || BR2_STATIC_LIBS || \
		!BR2_INSTALL_LIBSTDCPP || !BR2_HOST_GCC_AT_LEAST_7
```
