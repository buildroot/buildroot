## package/nxp-bt-wifi-firmware/Config.in
```kconfig
config BR2_PACKAGE_NXP_BT_WIFI_FIRMWARE
	bool "nxp-bt-wifi-firmware"
	help
	  Firmwares for NXP Bluetooth / WiFi chipsets based modules

	  https://github.com/nxp-imx/imx-firmware

if BR2_PACKAGE_NXP_BT_WIFI_FIRMWARE

config BR2_PACKAGE_NXP_BT_WIFI_FIRMWARE_8987
	bool "8987 (SD)"
	help
	  NXP 8987 module firmware files.

config BR2_PACKAGE_NXP_BT_WIFI_FIRMWARE_9098
	bool "9098"
	help
	  NXP 9098 module firmware files.

if BR2_PACKAGE_NXP_BT_WIFI_FIRMWARE_9098

choice
	prompt "9098 WiFi interface"

config BR2_PACKAGE_NXP_BT_WIFI_FIRMWARE_9098_SD
	bool "SD"

config BR2_PACKAGE_NXP_BT_WIFI_FIRMWARE_9098_PCIE
	bool "PCIe"

endchoice

endif

config BR2_PACKAGE_NXP_BT_WIFI_FIRMWARE_IW416
	bool "IW416 (SD)"
	help
	  NXP IW416 module firmware files.

config BR2_PACKAGE_NXP_BT_WIFI_FIRMWARE_IW610_SD
	bool "IW610 (SD)"
	help
	  NXP IW610 module firmware files.

config BR2_PACKAGE_NXP_BT_WIFI_FIRMWARE_IW610_USB
	bool "IW610 (USB)"
	help
	  NXP IW610 module firmware files.

config BR2_PACKAGE_NXP_BT_WIFI_FIRMWARE_IW612
	bool "IW612 (SD)"
	help
	  NXP IW612 module firmware files.

endif
```

## package/open62541/Config.in
```kconfig
config BR2_PACKAGE_OPEN62541
	bool "open62541"
	help
	  open62541 is an open source and free implementation of OPC UA.

	  https://open62541.org/

if BR2_PACKAGE_OPEN62541

choice
	prompt "encryption"
	default BR2_PACKAGE_OPEN62541_ENCRYPTION_NONE
	help
	  Encryption support

config BR2_PACKAGE_OPEN62541_ENCRYPTION_NONE
	bool "none"

config BR2_PACKAGE_OPEN62541_ENCRYPTION_MBEDTLS
	bool "mbedtls"
	select BR2_PACKAGE_MBEDTLS

config BR2_PACKAGE_OPEN62541_ENCRYPTION_OPENSSL
	bool "openssl"
	select BR2_PACKAGE_OPENSSL
	select BR2_PACKAGE_OPENSSL_FORCE_LIBOPENSSL

endchoice

choice
	prompt "namespace zero nodes"
	help
	  Namespace zero contains the standard-defined nodes. The full
	  namespace zero may not be required for all applications.

config BR2_PACKAGE_OPEN62541_UA_NAMESPACE_ZERO_DEFAULT
	bool "default"
	help
	  Use the default namespace zero contents.

config BR2_PACKAGE_OPEN62541_UA_NAMESPACE_ZERO_MINIMAL
	bool "minimal"
	help
	  A barebones namespace zero that is compatible with most
	  clients.  But this namespace 0 is so small that it does not
	  pass the CTT (Conformance Testing Tools of the OPC
	  Foundation).

config BR2_PACKAGE_OPEN62541_UA_NAMESPACE_ZERO_REDUCED
	bool "reduced"
	help
	  Small namespace zero that passes the CTT.

config BR2_PACKAGE_OPEN62541_UA_NAMESPACE_ZERO_FULL
	bool "full"
	help
	  Full namespace zero generated from the official XML
	  definitions.

endchoice

config BR2_PACKAGE_OPEN62541_HISTORIZING
	bool "historizing"
	help
	  Enable basic support for historical access (client and server)

config BR2_PACKAGE_OPEN62541_DISCOVERY
	bool "discovery"
	help
	  Enable Discovery Service (LDS)

config BR2_PACKAGE_OPEN62541_JSON_ENCODING
	bool "json encoding"
	default y
	help
	  Enable JSON encoding. This is also needed for event
	  monitoring support.

config BR2_PACKAGE_OPEN62541_PUBSUB
	bool "publish/subscribe"
	help
	  Enable the OPC UA PubSub support.

if BR2_PACKAGE_OPEN62541_PUBSUB

config BR2_PACKAGE_OPEN62541_PUBSUB_INFORMATIONMODEL
	bool "publish/subscribe information model"
	depends on BR2_PACKAGE_OPEN62541_UA_NAMESPACE_ZERO_REDUCED || \
		BR2_PACKAGE_OPEN62541_UA_NAMESPACE_ZERO_FULL
	help
	  Enable the information model representation of the PubSub
	  configuration.

endif # BR2_PACKAGE_OPEN62541_PUBSUB

endif
```

## package/openscap/Config.in
```kconfig
config BR2_PACKAGE_OPENSCAP
	bool "openscap"
	depends on BR2_PACKAGE_LIBGPG_ERROR_ARCH_SUPPORTS  # libgcrypt
	depends on !BR2_STATIC_LIBS # dlfcn.h
	depends on BR2_TOOLCHAIN_HAS_THREADS_NPTL
	depends on BR2_TOOLCHAIN_GCC_AT_LEAST_7 # libxmlsec1
	depends on BR2_TOOLCHAIN_HAS_ATOMIC # libxmlsec1
	select BR2_PACKAGE_LIBCURL
	# In theory should build without crypto, but in practice it
	# doesn't: https://github.com/OpenSCAP/openscap/issues/2310
	select BR2_PACKAGE_LIBGCRYPT if !BR2_PACKAGE_LIBNSS
	select BR2_PACKAGE_LIBXML2
	select BR2_PACKAGE_LIBXSLT
	select BR2_PACKAGE_LIBXMLSEC1
	select BR2_PACKAGE_MUSL_FTS if !BR2_TOOLCHAIN_USES_GLIBC
	select BR2_PACKAGE_PCRE2
	help
	  The purpose of this project is to create security policy
	  content for various platforms

	  https://www.open-scap.org/
	  https://github.com/OpenSCAP/openscap

comment "openscap needs a toolchain w/ dynamic library, NPTL, gcc >= 7"
	depends on BR2_PACKAGE_LIBGPG_ERROR_ARCH_SUPPORTS
	depends on BR2_TOOLCHAIN_HAS_ATOMIC
	depends on BR2_STATIC_LIBS || !BR2_TOOLCHAIN_HAS_THREADS_NPTL || \
		!BR2_TOOLCHAIN_GCC_AT_LEAST_7
```

## package/perl-cgi-session/Config.in
```kconfig
config BR2_PACKAGE_PERL_CGI_SESSION
	bool "perl-cgi-session"
	depends on !BR2_STATIC_LIBS
	select BR2_PACKAGE_PERL_CGI # runtime
	help
	  Persistent session data in CGI applications.

	  https://metacpan.org/release/CGI-Session

comment "perl-cgi-session needs a toolchain w/ dynamic library"
	depends on BR2_STATIC_LIBS
```

## package/perl-log-message-simple/Config.in
```kconfig
config BR2_PACKAGE_PERL_LOG_MESSAGE_SIMPLE
	bool "perl-log-message-simple"
	select BR2_PACKAGE_PERL_LOG_MESSAGE # runtime
	help
	  Simplified interface to Log::Message.

	  https://metacpan.org/release/Log-Message-Simple
```

## package/perl-log-message/Config.in
```kconfig
config BR2_PACKAGE_PERL_LOG_MESSAGE
	bool "perl-log-message"
	help
	  Powerful and flexible message logging mechanism.

	  https://metacpan.org/release/Log-Message
```

## package/perl-switch/Config.in
```kconfig
config BR2_PACKAGE_PERL_SWITCH
	bool "perl-switch"
	help
	  A switch statement for Perl, do not use if you can use
	  given/when.

	  https://metacpan.org/release/Switch
```

## package/perl-time-parsedate/Config.in
```kconfig
config BR2_PACKAGE_PERL_TIME_PARSEDATE
	bool "perl-time-parsedate"
	help
	  date parsing both relative and absolute.

	  https://metacpan.org/release/Time-ParseDate
```

## package/perl-timedate/Config.in
```kconfig
config BR2_PACKAGE_PERL_TIMEDATE
	bool "perl-timedate"
	help
	  Date and time formatting subroutines.

	  https://metacpan.org/release/TimeDate
```

## package/plutovg/Config.in
```kconfig
config BR2_PACKAGE_PLUTOVG
	bool "plutovg"
	help
	  plutovg is a standalone 2D vector graphics library, providing
	  path filling and stroking, gradients, and text rendering.

	  https://github.com/sammycage/plutovg
```

## package/python-cbor2/Config.in
```kconfig
config BR2_PACKAGE_PYTHON_CBOR2
	bool "python-cbor2"
	depends on BR2_PACKAGE_HOST_RUSTC_TARGET_ARCH_SUPPORTS
	help
	  CBOR (de)serializer with extensive tag support.

	  https://cbor2.readthedocs.io/
```

## package/python-configshell-fb/Config.in
```kconfig
config BR2_PACKAGE_PYTHON_CONFIGSHELL_FB
	bool "python-configshell-fb"
	select BR2_PACKAGE_PYTHON_PYPARSING
	select BR2_PACKAGE_PYTHON3_CURSES
	select BR2_PACKAGE_PYTHON3_READLINE
	help
	  configshell-fb is a Python library that provides a framework
	  for building simple but nice CLI-based applications.

	  https://github.com/open-iscsi/configshell-fb
```

## package/python-cramjam/Config.in
```kconfig
config BR2_PACKAGE_PYTHON_CRAMJAM
	bool "python-cramjam"
	depends on BR2_PACKAGE_HOST_RUSTC_TARGET_ARCH_SUPPORTS
	help
	  Python bindings to de/compression algorithms in Rust.
	  Allows for using algorithms such as Snappy, without any
	  system or other python dependencies.

	  https://pypi.org/project/cramjam
```

## package/python-googleapis-common-protos/Config.in
```kconfig
config BR2_PACKAGE_PYTHON_GOOGLEAPIS_COMMON_PROTOS
	bool "python-googleapis-common-protos"
	depends on BR2_PACKAGE_HOST_PROTOBUF_ARCH_SUPPORTS # python-protobuf
	select BR2_PACKAGE_PYTHON_PROTOBUF # runtime
	help
	  Common protobufs used in Google APIs.

	  https://github.com/googleapis/python-api-common-protos
```

## package/python-hid/Config.in
```kconfig
config BR2_PACKAGE_PYTHON_HID
	bool "python-hid"
	depends on BR2_PACKAGE_HAS_UDEV # hidapi
	depends on BR2_TOOLCHAIN_HAS_THREADS_NPTL # hidapi
	depends on BR2_TOOLCHAIN_GCC_AT_LEAST_4_9 # hidapi
	depends on BR2_USE_MMU # hidapi
	depends on BR2_USE_WCHAR # hidapi
	select BR2_PACKAGE_HIDAPI
	help
	  ctypes bindings for hidapi.

	  https://github.com/apmorton/pyhidapi

comment "python-hid needs udev /dev management and a toolchain w/ NPTL, gcc >= 4.9, wchar"
	depends on BR2_USE_MMU
	depends on !BR2_TOOLCHAIN_HAS_THREADS_NPTL || \
		!BR2_PACKAGE_HAS_UDEV || \
		!BR2_TOOLCHAIN_GCC_AT_LEAST_4_9 || \
		!BR2_USE_WCHAR
```

## package/python-httpcore2/Config.in
```kconfig
config BR2_PACKAGE_PYTHON_HTTPCORE2
	bool "python-httpcore2"
	select BR2_PACKAGE_PYTHON_H11 # runtime
	select BR2_PACKAGE_PYTHON_TRUSTSTORE # runtime
	help
	  A minimal low-level HTTP client.

	  https://github.com/pydantic/httpx2
```

## package/python-httpx2/Config.in
```kconfig
config BR2_PACKAGE_PYTHON_HTTPX2
	bool "python-httpx2"
	select BR2_PACKAGE_PYTHON_ANYIO # runtime
	select BR2_PACKAGE_PYTHON_HTTPCORE2 # runtime
	select BR2_PACKAGE_PYTHON_IDNA # runtime
	select BR2_PACKAGE_PYTHON_TRUSTSTORE # runtime
	select BR2_PACKAGE_PYTHON3_ZLIB # runtime
	help
	  The next generation HTTP client.

	  https://github.com/pydantic/httpx2
```

## package/python-jaraco-text/Config.in
```kconfig
config BR2_PACKAGE_PYTHON_JARACO_TEXT
	bool "python-jaraco-text"
	select BR2_PACKAGE_PYTHON_JARACO_CONTEXT # runtime
	select BR2_PACKAGE_PYTHON_JARACO_FUNCTOOLS # runtime
	select BR2_PACKAGE_PYTHON_MORE_ITERTOOLS # runtime
	select BR2_PACKAGE_PYTHON_TYPER_SLIM # runtime
	help
	  Module for text manipulation.

	  https://github.com/jaraco/jaraco.text
```

## package/python-librt/Config.in
```kconfig
config BR2_PACKAGE_PYTHON_LIBRT
	bool "python-librt"
	select BR2_PACKAGE_PYTHON_MYPY_EXTENSIONS # runtime
	help
	  Mypyc runtime library.

	  https://github.com/mypyc/librt
```

## package/python-nats-py/Config.in
```kconfig
config BR2_PACKAGE_PYTHON_NATS_PY
	bool "python-nats-py"
	select BR2_PACKAGE_PYTHON3_SSL
	help
	  NATS client for Python.

	  https://github.com/nats-io/nats.py
```

## package/python-opentelemetry-api/Config.in
```kconfig
config BR2_PACKAGE_PYTHON_OPENTELEMETRY_API
	bool "python-opentelemetry-api"
	select BR2_PACKAGE_PYTHON_TYPING_EXTENSIONS # runtime
	help
	  OpenTelemetry Python API.

	  https://github.com/open-telemetry/opentelemetry-python
```

## package/python-questionary/Config.in
```kconfig
config BR2_PACKAGE_PYTHON_QUESTIONARY
	bool "python-questionary"
	select BR2_PACKAGE_PYTHON_PROMPT_TOOLKIT
	help
	  Python library for effortlessly building pretty
	  command line interfaces.

	  https://github.com/tmbo/questionary
```

## package/python-rtslib-fb/Config.in
```kconfig
config BR2_PACKAGE_PYTHON_RTSLIB_FB
	bool "python-rtslib-fb"
	depends on BR2_PACKAGE_HAS_LIBUDEV # python-pyudev
	select BR2_PACKAGE_PYTHON_PYUDEV # runtime
	help
	  rtslib-fb is an object-based Python library for configuring
	  the LIO generic SCSI target, present in 3.x Linux kernel
	  versions.

	  https://github.com/open-iscsi/rtslib-fb

comment "python-rtslib-fb needs libudev"
	depends on !BR2_PACKAGE_HAS_LIBUDEV
```

## package/python-serialx/Config.in
```kconfig
config BR2_PACKAGE_PYTHON_SERIALX
	bool "python-serialx"
	select BR2_PACKAGE_PYTHON_TYPING_EXTENSIONS # runtime
	help
	  Serial library with native synchronous and asynchronous
	  support for Linux and other platforms.

	  https://github.com/puddly/serialx
```
