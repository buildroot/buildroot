## package/nut/Config.in
```kconfig
comment "nut needs a toolchain w/ C++, threads"
	depends on BR2_USE_MMU
	depends on !BR2_INSTALL_LIBSTDCPP || !BR2_TOOLCHAIN_HAS_THREADS

config BR2_PACKAGE_NUT
	bool "nut"
	depends on BR2_USE_MMU # fork()
	depends on BR2_INSTALL_LIBSTDCPP
	depends on BR2_TOOLCHAIN_HAS_THREADS
	help
	  Network UPS tools

	  The primary goal of the Network UPS Tools (NUT) project is
	  to provide support for Power Devices, such as
	  Uninterruptible Power Supplies, Power Distribution Units and
	  Solar Controllers.

	  http://www.networkupstools.org/

if BR2_PACKAGE_NUT

config BR2_PACKAGE_NUT_DRIVERS
	string "drivers"
	help
	  Select the individual drivers to enable, in a
	  comma-separated list. Leave empty for all.

endif # BR2_PACKAGE_NUT
```

## package/nvidia-persistenced/Config.in
```kconfig
config BR2_PACKAGE_NVIDIA_PERSISTENCED
	bool "nvidia-persistenced"
	depends on BR2_USE_MMU # fork()
	depends on !BR2_STATIC_LIBS # dlfcn.h
	depends on BR2_TOOLCHAIN_HAS_THREADS # libtirpc
	select BR2_PACKAGE_LIBTIRPC if !BR2_TOOLCHAIN_HAS_NATIVE_RPC
	help
	  NVIDIA driver persistence daemon.

	  https://github.com/NVIDIA/nvidia-persistenced

comment "nvidia-persistenced needs a toolchain w/ threads, dynamic libs"
	depends on BR2_USE_MMU
	depends on !BR2_TOOLCHAIN_HAS_THREADS || BR2_STATIC_LIBS
```

## package/nvme/Config.in
```kconfig
config BR2_PACKAGE_NVME
	bool "nvme"
	depends on !BR2_STATIC_LIBS # dlfcn.h
	depends on BR2_USE_MMU # libnvme
	select BR2_PACKAGE_LIBNVME
	help
	  NVME utility, a utility for interacting with standard NVM
	  Express (optimized PCI Express SSD interface) devices.

	  https://github.com/linux-nvme/nvme-cli

comment "nvme needs a toolchain w/ dynamic library"
	depends on BR2_STATIC_LIBS
	depends on BR2_USE_MMU
```

## package/nxp-mwifiex/Config.in
```kconfig
config BR2_PACKAGE_NXP_MWIFIEX
	bool "nxp-mwifiex"
	depends on !BR2_s390x
	depends on BR2_LINUX_KERNEL
	help
	  Linux kernel driver from NXP for WiFi chipsets
	  IW416 / IW610 / IW612 / W8801 / W8987 / W8997 / W9098.

	  https://github.com/nxp-imx/mwifiex

comment "nxp-mwifiex needs a Linux kernel to be built"
	depends on !BR2_LINUX_KERNEL
```

## package/oath-toolkit/Config.in
```kconfig
config BR2_PACKAGE_OATH_TOOLKIT
	bool "oath-toolkit"
	depends on BR2_USE_WCHAR
	help
	  OATH Toolkit provide components to build one-time password
	  authentication systems. It contains shared C libraries,
	  command line tools and a PAM module. Supported technologies
	  include the event-based HOTP algorithm (RFC 4226), the
	  time-based TOTP algorithm (RFC 6238), and Portable Symmetric
	  Key Container (PSKC, RFC 6030) to manage secret key
	  data. OATH stands for Open AuTHentication, which is the
	  organization that specify the algorithms.

	  https://www.nongnu.org/oath-toolkit/

if BR2_PACKAGE_OATH_TOOLKIT

config BR2_PACKAGE_OATH_TOOLKIT_PSKC
	bool "enable PSKC"
	select BR2_PACKAGE_LIBXML2
	help
	  Enable the Portable Symmetric Key Container (PSKC) support.

endif

comment "oath-toolkit needs a toolchain w/ wchar"
	depends on !BR2_USE_WCHAR
```

## package/oatpp/Config.in
```kconfig
config BR2_PACKAGE_OATPP
	bool "oatpp"
	depends on BR2_INSTALL_LIBSTDCPP
	depends on BR2_TOOLCHAIN_HAS_THREADS
	help
	  Oat++ is an open-source C++ web framework for highly scalable
	  and resource-efficient web applications. It provides all the
	  necessary components for production-grade development.

	  https://oatpp.io/docs/start

comment "oatpp needs a toolchain w/ C++, threads"
	depends on !BR2_INSTALL_LIBSTDCPP || !BR2_TOOLCHAIN_HAS_THREADS
```

## package/octave/Config.in
```kconfig
config BR2_PACKAGE_OCTAVE
	bool "octave"
	depends on BR2_PACKAGE_OPENBLAS_ARCH_SUPPORTS
	depends on BR2_INSTALL_LIBSTDCPP
	depends on BR2_TOOLCHAIN_GCC_AT_LEAST_4_8 # C++11
	depends on BR2_TOOLCHAIN_HAS_FORTRAN
	# Some Bootlin x86_64 toolchains (like version
	# bleeding-edge-2021.11-1) has a file
	# "x86_64-buildroot-linux-gnu/lib64/libgfortran.la" including
	# a "dependency_libs=" entry with an incorrect absolute path
	# to linquadmath.la on the bootlin build host. This breaks
	# builds using libtool with libgfortran. Those toolchains are
	# used by the "utils/test-pkg" script.
	depends on !BR2_TOOLCHAIN_EXTERNAL_BOOTLIN || !BR2_x86_64
	select BR2_PACKAGE_OPENBLAS
	select BR2_PACKAGE_PCRE2
	help
	  GNU Octave is a high-level language, primarily intended for
	  numerical computations. It provides a convenient command
	  line interface for solving linear and nonlinear problems
	  numerically, and for performing other numerical experiments
	  using a language that is mostly compatible with Matlab. It
	  may also be used as a batch-oriented language. Octave has
	  extensive tools for solving common numerical linear algebra
	  problems, finding the roots of nonlinear equations,
	  integrating ordinary functions, manipulating polynomials,
	  and integrating ordinary differential and
	  differential-algebraic equations. It is easily extensible
	  and customizable via user-defined functions written in
	  Octave's own language, or using dynamically loaded modules
	  written in C++, C, Fortran, or other languages.

	  https://www.octave.org/

comment "octave needs a toolchain w/ C++ and fortran, gcc >= 4.8"
	depends on !BR2_INSTALL_LIBSTDCPP || \
		!BR2_TOOLCHAIN_GCC_AT_LEAST_4_8 || \
		!BR2_TOOLCHAIN_HAS_FORTRAN
```

## package/odhcp6c/Config.in
```kconfig
config BR2_PACKAGE_ODHCP6C
	bool "odhcp6c"
	depends on BR2_USE_MMU # fork()
	depends on BR2_TOOLCHAIN_GCC_AT_LEAST_10
	help
	  odhcp6c is a minimal DHCPv6 and RA-client for use in
	  embedded Linux systems, especially routers.

	  https://git.openwrt.org/project/odhcp6c.git

comment "odhcp6c needs a toolchain w/ gcc >= 10"
	depends on BR2_STATIC_LIBS || !BR2_TOOLCHAIN_GCC_AT_LEAST_10
```

## package/ohdevtools/Config.in.host
```kconfig
config BR2_PACKAGE_HOST_OHDEVTOOLS
	bool "host ohdevtools"
	help
	  A collection of tools used by CI servers and developers
	  working with the OpenHome projects.

	  https://github.com/openhome/ohdevtools
```

## package/ohnet/Config.in
```kconfig
config BR2_PACKAGE_OHNET
	bool "ohnet"
	depends on !BR2_m68k # toolchain issues
	depends on BR2_INSTALL_LIBSTDCPP
	depends on BR2_TOOLCHAIN_HAS_THREADS
	help
	  OpenHome Networking (ohNet) is a modern, cross platform UPnP
	  stack.

	  http://wiki.openhome.org/wiki/OhNet

comment "ohnet needs a toolchain w/ C++, threads"
	depends on !BR2_INSTALL_LIBSTDCPP || !BR2_TOOLCHAIN_HAS_THREADS
```

## package/ohnetgenerated/Config.in
```kconfig
config BR2_PACKAGE_OHNETGENERATED
	bool "ohnetgenerated"
	depends on !BR2_m68k # ohnet
	depends on BR2_INSTALL_LIBSTDCPP
	depends on BR2_TOOLCHAIN_HAS_THREADS # ohnet
	select BR2_PACKAGE_OHNET
	help
	  Pre-generated proxy and provider files, covering ohMedia and
	  UPnP:AV services, to clients of ohNet.

	  https://github.com/openhome/ohNetGenerated

comment "ohnetgenerated needs a toolchain w/ C++, threads"
	depends on !BR2_INSTALL_LIBSTDCPP || !BR2_TOOLCHAIN_HAS_THREADS
```

## package/ohnetmon/Config.in
```kconfig
config BR2_PACKAGE_OHNETMON
	bool "ohnetmon"
	depends on !BR2_m68k # ohnet
	depends on BR2_INSTALL_LIBSTDCPP
	select BR2_PACKAGE_OHNET
	select BR2_PACKAGE_HOST_OHDEVTOOLS
	help
	  ohNetmon implements the OpenHome NetworkMonitor service.

	  https://github.com/openhome/ohNetmon

comment "ohtopology needs a toolchain w/ C++"
	depends on !BR2_INSTALL_LIBSTDCPP
```

## package/ohsongcast/Config.in
```kconfig
config BR2_PACKAGE_OHSONGCAST
	bool "ohsongcast"
	depends on !BR2_m68k # ohnet
	depends on BR2_INSTALL_LIBSTDCPP
	depends on BR2_TOOLCHAIN_HAS_THREADS # ohnet
	select BR2_PACKAGE_OHNET
	select BR2_PACKAGE_OHNETGENERATED
	select BR2_PACKAGE_OHTOPOLOGY
	help
	  ohSongcast can be used to provide a virtual soundcard which
	  sends a device's audio output to another device which
	  implements the OpenHome Receiver service.

	  https://github.com/openhome/ohSongcast

comment "ohsongcast needs a toolchain w/ C++, threads"
	depends on !BR2_INSTALL_LIBSTDCPP || !BR2_TOOLCHAIN_HAS_THREADS
```

## package/ohtopology/Config.in
```kconfig
config BR2_PACKAGE_OHTOPOLOGY
	bool "ohtopology"
	depends on !BR2_m68k # ohnet
	depends on BR2_INSTALL_LIBSTDCPP
	depends on BR2_TOOLCHAIN_HAS_THREADS # ohnet
	select BR2_PACKAGE_OHNET
	select BR2_PACKAGE_OHNETGENERATED
	help
	  ohTopology provides a view onto devices implementing the
	  OpenHome Media standard.

	  https://github.com/openhome/ohTopology

comment "ohtopology needs a toolchain w/ C++"
	depends on !BR2_INSTALL_LIBSTDCPP || !BR2_TOOLCHAIN_HAS_THREADS
```

## package/ola/Config.in
```kconfig
comment "ola needs a toolchain w/ C++, threads, dynamic library, gcc >= 4.8"
	depends on !BR2_INSTALL_LIBSTDCPP || !BR2_TOOLCHAIN_HAS_THREADS \
		|| BR2_STATIC_LIBS \
		|| !BR2_TOOLCHAIN_GCC_AT_LEAST_4_8
	depends on BR2_PACKAGE_PROTOBUF_ARCH_SUPPORTS

menuconfig BR2_PACKAGE_OLA
	bool "ola (open lighting architecture)"
	depends on BR2_INSTALL_LIBSTDCPP # protobuf
	depends on !BR2_STATIC_LIBS # protobuf
	depends on BR2_TOOLCHAIN_HAS_THREADS
	depends on BR2_PACKAGE_PROTOBUF_ARCH_SUPPORTS
	depends on BR2_TOOLCHAIN_GCC_AT_LEAST_4_8 # protobuf
	select BR2_PACKAGE_PROTOBUF
	select BR2_PACKAGE_UTIL_LINUX
	select BR2_PACKAGE_UTIL_LINUX_LIBUUID
	help
	  Open Lighting Architecture provides applications
	  with a mechanism to send and receive DMX512 & RDM
	  commands using hardware devices and DMX over IP protocols.

	  https://www.openlighting.org/ola/

if BR2_PACKAGE_OLA

comment "bindings and interface"

config BR2_PACKAGE_OLA_WEB
	bool "http interface"
	depends on BR2_PACKAGE_LIBGPG_ERROR_ARCH_SUPPORTS # libgcrypt, libmicrohttpd
	select BR2_PACKAGE_LIBMICROHTTPD
	help
	  Build OLA with browser interface.

config BR2_PACKAGE_OLA_PYTHON_BINDINGS
	bool "python bindings"
	depends on BR2_PACKAGE_PROTOBUF_ARCH_SUPPORTS # protobuf
	depends on BR2_PACKAGE_PYTHON3
	select BR2_PACKAGE_PYTHON_PROTOBUF
	help
	  Build OLA with support for the Python language.

comment "tests and examples"

config BR2_PACKAGE_OLA_EXAMPLES
	bool "examples"
	select BR2_PACKAGE_NCURSES
	help
	  Build OLA examples.

config BR2_PACKAGE_OLA_RDM_TESTS
	bool "rdm tests"
	depends on BR2_PACKAGE_OLA_PYTHON_BINDINGS
	depends on BR2_PACKAGE_PYTHON_NUMPY_ARCH_SUPPORTS
	depends on BR2_TOOLCHAIN_USES_GLIBC || BR2_TOOLCHAIN_USES_MUSL # python-numpy
	depends on BR2_TOOLCHAIN_GCC_AT_LEAST_9 # python-numpy
	select BR2_PACKAGE_PYTHON_NUMPY
	help
	  Build OLA RDM tests.

comment "rdm tests needs a glibc or musl toolchain w/ gcc >= 9"
	depends on BR2_PACKAGE_OLA_PYTHON_BINDINGS
	depends on BR2_PACKAGE_PYTHON_NUMPY_ARCH_SUPPORTS
	depends on !BR2_TOOLCHAIN_GCC_AT_LEAST_9 || \
		!BR2_TOOLCHAIN_USES_GLIBC && !BR2_TOOLCHAIN_USES_MUSL

comment "plugin selections"

config BR2_PACKAGE_OLA_PLUGIN_ARTNET
	bool "artnet"
	help
	  Build Artnet plugin for OLA.

config BR2_PACKAGE_OLA_PLUGIN_DUMMY
	bool "dummy"
	help
	  Build Dummy plugin for OLA.

config BR2_PACKAGE_OLA_PLUGIN_E131
	bool "acn E131"
	help
	  Build ACN E131 plugin for OLA.

config BR2_PACKAGE_OLA_PLUGIN_ESPNET
	bool "espnet"
	help
	  Build EspNet plugin for OLA.

config BR2_PACKAGE_OLA_PLUGIN_FTDIDMX
	bool "ftdidmx"
	depends on BR2_TOOLCHAIN_GCC_AT_LEAST_4_9 # libftdi1 -> libusb
	select BR2_PACKAGE_LIBFTDI1
	help
	  Build FTDI USB DMX plugin for OLA.

comment "ftdidmx needs a toolchain w/ gcc >= 4.9"
	depends on !BR2_TOOLCHAIN_GCC_AT_LEAST_4_9

config BR2_PACKAGE_OLA_PLUGIN_GPIO
	bool "GPIO"
	help
	  Build GPIO plugin for OLA.

config BR2_PACKAGE_OLA_PLUGIN_KARATE
	bool "karate"
	help
	  Build Karate plugin for OLA.

config BR2_PACKAGE_OLA_PLUGIN_KINET
	bool "kinet"
	help
	  Build KiNet plugin for OLA.

config BR2_PACKAGE_OLA_PLUGIN_MILINT
	bool "Milford Instruments"
	help
	  Build Milford Instruments 1-463 plugin for OLA.

config BR2_PACKAGE_OLA_PLUGIN_OPENDMX
	bool "Enttec Open DMX"
	help
	  Build Enttec Open DMX plugin for OLA.

config BR2_PACKAGE_OLA_PLUGIN_OPENPIXELCONTROL
	bool "Open Pixel Control"
	help
	  Build Open Pixel Control (OPC) plugin for OLA.

config BR2_PACKAGE_OLA_PLUGIN_OSC
	bool "osc"
	select BR2_PACKAGE_LIBLO
	help
	  Build Open Sound Control (OSC) plugin for OLA.

config BR2_PACKAGE_OLA_PLUGIN_PATHPORT
	bool "pathport"
	help
	  Build Pathport plugin for OLA.

config BR2_PACKAGE_OLA_PLUGIN_RENARD
	bool "renard"
	help
	  Build Renard plugin for OLA.

config BR2_PACKAGE_OLA_PLUGIN_SANDNET
	bool "sandnet"
	help
	  Build SandNet plugin for OLA.

config BR2_PACKAGE_OLA_PLUGIN_SHOWNET
	bool "shownet"
	help
	  Build ShowNet plugin for OLA.

config BR2_PACKAGE_OLA_PLUGIN_SPI
	bool "spi"
	help
	  Build SPI plugin for OLA.

config BR2_PACKAGE_OLA_PLUGIN_STAGEPROFI
	bool "stageprofi"
	depends on BR2_TOOLCHAIN_GCC_AT_LEAST_4_9 # libusb
	select BR2_PACKAGE_LIBUSB
	help
	  Build StageProfi plugin for OLA.

comment "stageprofi needs a toolchain w/ gcc >= 4.9"
	depends on !BR2_TOOLCHAIN_GCC_AT_LEAST_4_9

config BR2_PACKAGE_OLA_PLUGIN_UARTDMX
	bool "uartdmx"
	help
	  Build UART Native DMX plugin for OLA.

config BR2_PACKAGE_OLA_PLUGIN_USBDMX
	bool "usbdmx"
	depends on BR2_TOOLCHAIN_GCC_AT_LEAST_4_9 # libusb
	select BR2_PACKAGE_LIBUSB
	help
	  Build USB DMX plugin for OLA.

comment "usbdmx needs a toolchain w/ gcc >= 4.9"
	depends on !BR2_TOOLCHAIN_GCC_AT_LEAST_4_9

config BR2_PACKAGE_OLA_PLUGIN_USBPRO
	bool "usbpro"
	depends on BR2_TOOLCHAIN_GCC_AT_LEAST_4_9 # libusb
	select BR2_PACKAGE_LIBUSB
	help
	  Build UsbPro plugin for OLA.

comment "usbpro needs a toolchain w/ gcc >= 4.9"
	depends on !BR2_TOOLCHAIN_GCC_AT_LEAST_4_9

endif
```

## package/onevpl-intel-gpu/Config.in
```kconfig
config BR2_PACKAGE_ONEVPL_INTEL_GPU
	bool "onevpl-intel-gpu"
	depends on BR2_x86_64 # intel-mediadriver
	depends on BR2_PACKAGE_LIBVPL_ARCH_SUPPORTS # libvpl
	depends on BR2_INSTALL_LIBSTDCPP # libvpl
	depends on !BR2_STATIC_LIBS # libvpl
	depends on BR2_TOOLCHAIN_GCC_AT_LEAST_7 # libvpl
	depends on BR2_TOOLCHAIN_HAS_SYNC_1 # intel-mediadriver
	depends on BR2_TOOLCHAIN_HAS_THREADS # libvpl
	depends on BR2_TOOLCHAIN_HAS_THREADS_NPTL # intel-mediadriver
	select BR2_PACKAGE_INTEL_MEDIADRIVER # runtime
	select BR2_PACKAGE_LIBVA
	select BR2_PACKAGE_LIBVPL
	help
	  Intel® oneVPL GPU Runtime is a Runtime implementation of
	  oneVPL API for Intel Gen GPUs, starting with Tiger Lake.

	  https://github.com/oneapi-src/oneVPL-intel-gpu

comment "onevpl-intel-gpu needs a toolchain w/ dynamic library, gcc >= 7, C++, NPTL"
	depends on BR2_x86_64
	depends on BR2_PACKAGE_LIBVPL_ARCH_SUPPORTS
	depends on BR2_TOOLCHAIN_HAS_SYNC_1
	depends on BR2_STATIC_LIBS || !BR2_TOOLCHAIN_GCC_AT_LEAST_7 || \
		!BR2_INSTALL_LIBSTDCPP || !BR2_TOOLCHAIN_HAS_THREADS
```

## package/open-iscsi/Config.in
```kconfig
config BR2_PACKAGE_OPEN_ISCSI
	bool "open-iscsi"
	depends on BR2_USE_MMU # fork()
	depends on BR2_TOOLCHAIN_HAS_THREADS # pthread
	depends on !BR2_STATIC_LIBS # kmod
	select BR2_PACKAGE_KMOD
	select BR2_PACKAGE_OPENSSL
	select BR2_PACKAGE_OPEN_ISNS
	select BR2_PACKAGE_UTIL_LINUX
	select BR2_PACKAGE_UTIL_LINUX_LIBMOUNT
	help
	  iSCSI tools for Linux.

	  https://www.open-iscsi.com

comment "open-iscsi needs a toolchain w/ threads, dynamic library"
	depends on BR2_USE_MMU
	depends on !BR2_TOOLCHAIN_HAS_THREADS || BR2_STATIC_LIBS
```

## package/open-isns/Config.in
```kconfig
config BR2_PACKAGE_OPEN_ISNS
	bool "open-isns"
	depends on BR2_USE_MMU # fork()
	help
	  iSNS server and client for Linux.

	  https://github.com/open-iscsi/open-isns
```

## package/opencdm/Config.in
```kconfig
config BR2_PACKAGE_OPENCDM

        bool "OpenCDM"
        help
        Component of the User-agent which provides support for one or more Key Systems.It is transparent to
        the Web application whether a CDM is part of or separate from the User-agent.
        A User-agent can support multiple CDMs.
```
