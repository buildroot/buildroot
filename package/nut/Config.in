## package/opencdmi/Config.in
```kconfig
config BR2_PACKAGE_OPENCDMI
	bool "OpenCDMi"
        select BR2_PACKAGE_RPCBIND if !BR2_PACKAGE_WPEFRAMEWORK_OPENCDMI_INTERFACE
        select BR2_PACKAGE_OPENCDM if !BR2_PACKAGE_WPEFRAMEWORK_OPENCDMI_INTERFACE
	help
           An open interface for accessing  platform DRM Content Decryption Module (CDM).
            This will be a library to use with any process

if BR2_PACKAGE_OPENCDMI && !BR2_PACKAGE_WPEFRAMEWORK_OPENCDMI_INTERFACE
	source "package/opencdm/Config.in"

config BR2_PACKAGE_OPENCDMI_SERVICE
	bool "Service"
        select BR2_PACKAGE_OPENCDM 
	help 
	   Enable service application to get opencdmi functionalities
endif
```

## package/opencl-clhpp/Config.in
```kconfig
config BR2_PACKAGE_OPENCL_CLHPP
	bool "opencl-clhpp"
	# header only library, so there is no build per-se, but
	# packages depending on us will need C++ support
	depends on BR2_INSTALL_LIBSTDCPP
	depends on BR2_PACKAGE_HAS_LIBOPENCL
	help
	  opencl-clhpp are the OpenCL API C++ bindings

	  http://github.khronos.org/OpenCL-CLHPP/

comment "opencl-clhpp needs a toolchain w/ C++"
	depends on BR2_PACKAGE_HAS_LIBOPENCL
	depends on !BR2_INSTALL_LIBSTDCPP
```

## package/opencl-headers/Config.in
```kconfig
config BR2_PACKAGE_OPENCL_HEADERS
	bool "opencl-headers"
	help
	  C language headers for the OpenCL API

	  https://github.com/KhronosGroup/OpenCL-Headers
```

## package/opencl-icd-loader/Config.in
```kconfig
config BR2_PACKAGE_OPENCL_ICD_LOADER
	bool "OpenCL-ICD-Loader"
	depends on BR2_INSTALL_LIBSTDCPP
	depends on BR2_PACKAGE_HAS_LIBOPENCL
	select BR2_PACKAGE_OPENCL_HEADERS
	help
	  OpenCL defines an Installable Client Driver (ICD) mechanism to
	  allow developers to build applications against an Installable
	  Client Driver loader (ICD loader) rather than linking their
	  applications against a specific OpenCL implementation.

	  https://github.com/KhronosGroup/OpenCL-ICD-Loader
```

## package/openconnect/Config.in
```kconfig
config BR2_PACKAGE_OPENCONNECT
	bool "openconnect"
	depends on BR2_USE_MMU # fork()
	select BR2_PACKAGE_OPENSSL if !BR2_PACKAGE_GNUTLS
	# configure: error: LibreSSL does not support Cisco DTLS.
	select BR2_PACKAGE_OPENSSL_FORCE_LIBOPENSSL if !BR2_PACKAGE_GNUTLS
	select BR2_PACKAGE_LIBOPENSSL_ENABLE_RC4 if BR2_PACKAGE_LIBOPENSSL
	select BR2_PACKAGE_LIBOPENSSL_ENABLE_DES if BR2_PACKAGE_LIBOPENSSL
	select BR2_PACKAGE_LIBXML2
	select BR2_PACKAGE_ZLIB
	help
	  OpenConnect is an SSL VPN client initially created to support
	  Cisco's AnyConnect SSL VPN.
	  It has since been ported to support the Juniper SSL VPN (which
	  is now known as Pulse Connect Secure), the Palo Alto Networks
	  GlobalProtect SSL VPN the F5 Big-IP SSL VPN, and the Fortinet
	  FortiGate SSL VPN.

	  https://www.infradead.org/openconnect/
```

## package/opencsd/Config.in
```kconfig
config BR2_PACKAGE_OPENCSD_ARCH_SUPPORTS
	bool
	default y if BR2_arm
	default y if BR2_armeb
	default y if BR2_aarch64
	default y if BR2_aarch64_be

config BR2_PACKAGE_OPENCSD
	bool "opencsd"
	depends on BR2_PACKAGE_OPENCSD_ARCH_SUPPORTS
	depends on !BR2_STATIC_LIBS
	depends on BR2_INSTALL_LIBSTDCPP
	depends on BR2_TOOLCHAIN_GCC_AT_LEAST_4_8 # C++11
	help
	  This library provides an API suitable for the decode of
	  ARM(r) CoreSight(tm) trace streams.

	  OpenCSD is for example an optional dependency in the Linux
	  "perf" tool, starting from kernel version 5.1.

	  https://github.com/Linaro/OpenCSD

comment "opencsd needs a toolchain w/ C++11, gcc >= 4.8, dynamic library"
	depends on BR2_PACKAGE_OPENCSD_ARCH_SUPPORTS
	depends on BR2_STATIC_LIBS \
		|| !BR2_INSTALL_LIBSTDCPP \
		|| !BR2_TOOLCHAIN_GCC_AT_LEAST_4_8
```
