## package/shadowsocks-libev/Config.in
```kconfig
config BR2_PACKAGE_SHADOWSOCKS_LIBEV
	bool "shadowsocks-libev"
	depends on BR2_TOOLCHAIN_HAS_SYNC_4 # for libcork
	depends on BR2_TOOLCHAIN_HAS_SYNC_8 || !BR2_ARCH_IS_64 # for libcork
	depends on BR2_TOOLCHAIN_HAS_THREADS
	depends on BR2_USE_MMU # fork()
	select BR2_PACKAGE_C_ARES
	select BR2_PACKAGE_LIBEV
	select BR2_PACKAGE_LIBSODIUM
	select BR2_PACKAGE_MBEDTLS
	select BR2_PACKAGE_PCRE
	help
	  Shadowsocks-libev is a lightweight secured SOCKS5 proxy for
	  embedded devices and low-end boxes.

	  https://github.com/shadowsocks/shadowsocks-libev

config BR2_PACKAGE_SHADOWSOCKS_LIBEV_CONNMARKTOS
	bool "enable connmarktos feature"
	depends on BR2_PACKAGE_SHADOWSOCKS_LIBEV
	select BR2_PACKAGE_LIBNETFILTER_CONNTRACK
	help
	  This option enable the connmark to TOS feature on shadowsocks

comment "shadowsocks-libev needs a toolchain w/ threads"
	depends on BR2_TOOLCHAIN_HAS_SYNC_4
	depends on BR2_TOOLCHAIN_HAS_SYNC_8 || !BR2_ARCH_IS_64
	depends on BR2_USE_MMU
	depends on !BR2_TOOLCHAIN_HAS_THREADS
```

## package/signal-estimator/Config.in
```kconfig
comment "signal-estimator needs a toochain w/ C++, threads, gcc >= 7"
	depends on !BR2_INSTALL_LIBSTDCPP \
		|| !BR2_TOOLCHAIN_GCC_AT_LEAST_7 \
		|| !BR2_TOOLCHAIN_HAS_THREADS

config BR2_PACKAGE_SIGNAL_ESTIMATOR
	bool "signal-estimator"
	depends on BR2_INSTALL_LIBSTDCPP
	depends on BR2_TOOLCHAIN_GCC_AT_LEAST_7 # C++17
	depends on BR2_TOOLCHAIN_HAS_THREADS # alsa-lib
	select BR2_PACKAGE_ALSA_LIB
	help
	  signal-estimator is a small command-line and GUI tool allowing
	  to measure different characteristics of the signal looped back
	  from audio output to audio input.

	  https://github.com/gavv/signal-estimator
```

## package/sigsum-c/Config.in
```kconfig
config BR2_PACKAGE_SIGSUM_C
	bool "sigsum-c"
	select BR2_PACKAGE_NETTLE
	help
	  C library and command-line utility for verifying Sigsum
	  proofs.

	  https://git.glasklar.is/sigsum/core/sigsum-c/

if BR2_PACKAGE_SIGSUM_C

config BR2_PACKAGE_SIGSUM_C_TOOLS
	bool "Enable tools"
	help
	  Build CLI tools like sigsum-c-verify.

endif
```

## package/sigsum-go/Config.in
```kconfig
config BR2_PACKAGE_SIGSUM_GO
	bool "sigsum-go"
	depends on BR2_PACKAGE_HOST_GO_TARGET_ARCH_SUPPORTS
	select BR2_PACKAGE_HOST_GO
	select BR2_PACKAGE_SIGSUM_GO_VERIFY if \
		!BR2_PACKAGE_SIGSUM_GO_KEY && \
		!BR2_PACKAGE_SIGSUM_GO_POLICY && \
		!BR2_PACKAGE_SIGSUM_GO_SUBMIT && \
		!BR2_PACKAGE_SIGSUM_GO_TOKEN
	help
	  Command-line utilities for interacting with Sigsum logs.

	  https://git.glasklar.is/sigsum/core/sigsum-go/

if BR2_PACKAGE_SIGSUM_GO

config BR2_PACKAGE_SIGSUM_GO_KEY
	bool "sigsum-key"

config BR2_PACKAGE_SIGSUM_GO_POLICY
	bool "sigsum-policy"

config BR2_PACKAGE_SIGSUM_GO_SUBMIT
	bool "sigsum-submit"

config BR2_PACKAGE_SIGSUM_GO_TOKEN
	bool "sigsum-token"

config BR2_PACKAGE_SIGSUM_GO_VERIFY
	bool "sigsum-verify"

endif
```
