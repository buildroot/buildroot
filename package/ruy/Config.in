## package/ruy/Config.in
```kconfig
config BR2_PACKAGE_RUY_ARCH_SUPPORTS
	bool
	default y if BR2_PACKAGE_CPUINFO_ARCH_SUPPORTS

config BR2_PACKAGE_RUY
	bool "ruy"
	depends on BR2_PACKAGE_CPUINFO_ARCH_SUPPORTS
	depends on BR2_INSTALL_LIBSTDCPP
	depends on BR2_TOOLCHAIN_GCC_AT_LEAST_4_9 # C++14
	depends on BR2_TOOLCHAIN_HAS_THREADS # cpuinfo
	select BR2_PACKAGE_CPUINFO
	help
	  Ruy is a matrix multiplication library. Its focus is to cover
	  the matrix multiplication needs of neural network inference
	  engines. Its initial user has been TensorFlow Lite, where it
	  is used by default on the ARM CPU architecture.

	  https://github.com/google/ruy

comment "ruy needs a toolchain w/ C++14, threads"
	depends on !BR2_INSTALL_LIBSTDCPP || \
		!BR2_TOOLCHAIN_GCC_AT_LEAST_4_9 || !BR2_TOOLCHAIN_HAS_THREADS
```

## package/rwmem/Config.in
```kconfig
config BR2_PACKAGE_RWMEM
	bool "rwmem"
	depends on BR2_TOOLCHAIN_GCC_AT_LEAST_5
	depends on BR2_INSTALL_LIBSTDCPP
	depends on BR2_USE_WCHAR # fmt
	select BR2_PACKAGE_FMT
	select BR2_PACKAGE_INIH
	help
	  Simple program to read/write from/to any location in memory.

	  https://github.com/tomba/rwmem

comment "rwmem needs a toolchain w/ C++, wchar, gcc >= 5"
	depends on !BR2_INSTALL_LIBSTDCPP || !BR2_USE_WCHAR || \
		!BR2_TOOLCHAIN_GCC_AT_LEAST_5
```

## package/rygel/Config.in
```kconfig
config BR2_PACKAGE_RYGEL
	bool "rygel"
	depends on BR2_USE_WCHAR # gupnp-av
	depends on BR2_TOOLCHAIN_HAS_THREADS # gupnp-av
	depends on BR2_USE_MMU # gupnp-av, gobject-introspection
	depends on BR2_PACKAGE_GOBJECT_INTROSPECTION_ARCH_SUPPORTS # gobject-introspection
	depends on BR2_TOOLCHAIN_GCC_AT_LEAST_4_9 # gobject-introspection
	depends on BR2_HOST_GCC_AT_LEAST_8 # gobject-introspection -> host-qemu
	depends on BR2_TOOLCHAIN_USES_GLIBC # gobject-introspection
	depends on BR2_PACKAGE_PYTHON3 # gobject-introspection
	select BR2_PACKAGE_GDK_PIXBUF
	select BR2_PACKAGE_GOBJECT_INTROSPECTION
	select BR2_PACKAGE_GUPNP_AV
	select BR2_PACKAGE_GUPNP_DLNA
	select BR2_PACKAGE_LIBGEE
	select BR2_PACKAGE_LIBMEDIAART
	select BR2_PACKAGE_SQLITE
	help
	  Rygel is a home media solution (UPnP AV MediaServer) that
	  allows you to easily share audio, video and pictures to other
	  devices.

	  Additionally, media player software may use Rygel to become a
	  MediaRenderer that may be controlled remotely by a UPnP or
	  DLNA Controller.

	  Rygel achieves interoperability with other devices in the
	  market by trying to conform to the very strict requirements of
	  DLNA and by converting media on-the-fly to formats that client
	  devices can handle.

	  Most Rygel functionality is implemented through a plug-in
	  mechanism.

	  https://wiki.gnome.org/Projects/Rygel

if BR2_PACKAGE_RYGEL

choice
	prompt "media engine"
	default BR2_PACKAGE_RYGEL_MEDIA_ENGINE_SIMPLE

config BR2_PACKAGE_RYGEL_MEDIA_ENGINE_SIMPLE
	bool "simple"

config BR2_PACKAGE_RYGEL_MEDIA_ENGINE_GSTREAMER1
	bool "gstreamer1"
	depends on BR2_PACKAGE_GSTREAMER1_EDITING_SERVICES

comment "gstreamer1 needs gst1-editing-services"
	depends on !BR2_PACKAGE_GSTREAMER1_EDITING_SERVICES

endchoice

comment "rygel needs a glibc toolchain w/ wchar, threads, gcc >= 4.9, host gcc >= 8"
	depends on BR2_USE_MMU
	depends on BR2_PACKAGE_GOBJECT_INTROSPECTION_ARCH_SUPPORTS
	depends on !BR2_USE_WCHAR || !BR2_TOOLCHAIN_HAS_THREADS || \
		!BR2_TOOLCHAIN_USES_GLIBC || \
		!BR2_TOOLCHAIN_GCC_AT_LEAST_4_9 || \
		!BR2_HOST_GCC_AT_LEAST_8

endif # BR2_PACKAGE_RYGEL
```

## package/s6-linux-utils/Config.in
```kconfig
config BR2_PACKAGE_S6_LINUX_UTILS
	bool "s6-linux-utils"
	depends on BR2_USE_MMU # skalibs
	select BR2_PACKAGE_SKALIBS
	help
	  s6-linux-utils is a set of minimalistic Linux-specific
	  system utilities.

	  http://skarnet.org/software/s6-linux-utils/

if BR2_PACKAGE_S6_LINUX_UTILS

config BR2_PACKAGE_S6_LINUX_UTILS_MULTICALL
	bool "s6-linux-utils multicall binary"
	help
	  Build s6-linux-utils as a multicall binary to save disk
	  space.

endif
```

## package/s6-portable-utils/Config.in
```kconfig
config BR2_PACKAGE_S6_PORTABLE_UTILS
	bool "s6-portable-utils"
	depends on BR2_USE_MMU # skalibs
	select BR2_PACKAGE_SKALIBS
	help
	  s6-portable-utils is a set of tiny general Unix utilities,
	  often performing well-known tasks such as cut and grep, but
	  optimized for simplicity and small size. They were designed
	  for embedded systems and other constrained environments, but
	  they work everywhere.

	  http://skarnet.org/software/s6-portable-utils/

if BR2_PACKAGE_S6_PORTABLE_UTILS

config BR2_PACKAGE_S6_PORTABLE_UTILS_MULTICALL
	bool "s6-portable-utils multicall binary"
	help
	  Build s6-portable-utils as a multicall binary to save disk
	  space.

endif
```

## package/sage-firmware/Config.in
```kconfig
config BR2_PACKAGE_SAGE_FIRMWARE
	bool "bcm-sage"
	depends on BR2_PACKAGE_HAS_NEXUS
	help
	  Pre-compiled Sage binaries for a platform
```

## package/sane-airscan/Config.in
```kconfig
config BR2_PACKAGE_SANE_AIRSCAN
	bool "sane-airscan"
	depends on !BR2_STATIC_LIBS # avahi, gnutls, sane-backends
	depends on BR2_TOOLCHAIN_HAS_THREADS # avahi, dbus
	depends on BR2_USE_WCHAR # avahi, gnutls
	depends on BR2_USE_MMU # dbus, sane-backends
	select BR2_PACKAGE_AVAHI
	select BR2_PACKAGE_AVAHI_DAEMON # needed to get avahi-client
	select BR2_PACKAGE_DBUS # needed by avahi to get avahi-client
	select BR2_PACKAGE_GNUTLS
	select BR2_PACKAGE_JPEG
	select BR2_PACKAGE_LIBPNG
	select BR2_PACKAGE_LIBXML2
	select BR2_PACKAGE_SANE_BACKENDS
	select BR2_PACKAGE_TIFF
	help
	  SANE backend for AirScan (eSCL) and WSD document scanners

	  Similar to how most modern network printers support
	  "driverless" printing, using the universal vendor-neutral
	  printing protocol, many modern network scanners and MFPs
	  support "driverless" scanning.

	  https://github.com/alexpevzner/sane-airscan

comment "sane-airscan needs a toolchain w/ wchar, dynamic library, threads"
	depends on BR2_USE_MMU
	depends on !BR2_USE_WCHAR || BR2_STATIC_LIBS || \
		!BR2_TOOLCHAIN_HAS_THREADS
```

## package/sbc/Config.in
```kconfig
config BR2_PACKAGE_SBC
	bool "sbc"
	help
	  An audio codec to connect bluetooth high quality audio
	  devices like headphones or loudspeakers.

	  http://www.bluez.org/

if BR2_PACKAGE_SBC

config BR2_PACKAGE_SBC_TOOLS
	bool "tools"
	select BR2_PACKAGE_LIBSNDFILE
	help
	  Build the command-line SBC tools as well as the library.

endif
```

## package/sbctl/Config.in
```kconfig
config BR2_PACKAGE_SBCTL
	bool "sbctl"
	depends on BR2_PACKAGE_HOST_GO_TARGET_ARCH_SUPPORTS
	depends on BR2_TOOLCHAIN_HAS_THREADS # pcsc-lite
	depends on BR2_USE_MMU # pcsc-lite
	depends on !BR2_STATIC_LIBS # pcsc-lite
	depends on BR2_TOOLCHAIN_GCC_AT_LEAST_4_9 # pcsc-lite
	select BR2_PACKAGE_HOST_GO
	select BR2_PACKAGE_PCSC_LITE # yubikey
	help
	  sbctl intends to be a user-friendly secure boot key manager
	  capable of setting up secure boot, offer key management
	  capabilities, and keep track of files that needs to be
	  signed in the boot chain.

	  https://github.com/Foxboron/sbctl
```

## package/sc2mpd/Config.in
```kconfig
config BR2_PACKAGE_SC2MPD
	bool "sc2mpd"
	depends on !BR2_m68k # ohnet, toolchain issues
	depends on BR2_INSTALL_LIBSTDCPP
	depends on BR2_TOOLCHAIN_HAS_THREADS # ohnet
	select BR2_PACKAGE_ALSA_LIB
	select BR2_PACKAGE_LIBMICROHTTPD
	select BR2_PACKAGE_LIBSAMPLERATE
	select BR2_PACKAGE_OHNET
	select BR2_PACKAGE_OHNETGENERATED
	select BR2_PACKAGE_OHSONGCAST
	help
	  Gateway forwarding a Linn Songcast audio stream to MPD.

	  sc2mpd is designed to work with upmpdcli, with which it
	  provides a Songcast Receiver interface usable from any
	  Songcast Sender such as the Windows or Mac OS X Linn
	  Songcast applications.

	  The package also contains a reverse gateway, mpd2sc,
	  forwarding audio played by mpd to a Songcast Sender, mostly
	  useful for multiroom synchronized play.

	  http://www.lesbonscomptes.com/upmpdcli/sc2mpd.html

comment "sc2mpd needs a toolchain w/ C++, threads"
	depends on !BR2_INSTALL_LIBSTDCPP || !BR2_TOOLCHAIN_HAS_THREADS
```

## package/screen/Config.in
```kconfig
config BR2_PACKAGE_SCREEN
	bool "screen"
	depends on BR2_USE_MMU # fork()
	depends on BR2_USE_WCHAR
	depends on BR2_TOOLCHAIN_GCC_AT_LEAST_8 # C17
	select BR2_PACKAGE_LIBXCRYPT if BR2_TOOLCHAIN_USES_GLIBC
	select BR2_PACKAGE_NCURSES
	help
	  Screen is a full-screen window manager that multiplexes a
	  physical terminal between several processes, typically
	  interactive shells.  Each virtual terminal provides the
	  functions of the DEC VT100 terminal and, in addition,
	  several control functions from the ANSI X3.64 (ISO 6429) and
	  ISO 2022 standards (e.g., insert/delete line and support for
	  multiple character sets).

	  http://www.gnu.org/software/screen/

comment "screen needs a toolchain w/ wchar, gcc >= 8"
	depends on BR2_USE_MMU
	depends on !BR2_USE_WCHAR || \
		!BR2_TOOLCHAIN_GCC_AT_LEAST_8
```

## package/sdbus-cpp/Config.in
```kconfig
config BR2_PACKAGE_SDBUS_CPP
	bool "sdbus-c++"
	depends on BR2_INSTALL_LIBSTDCPP
	depends on BR2_PACKAGE_SYSTEMD
	depends on BR2_TOOLCHAIN_GCC_AT_LEAST_7 # C++17
	help
	  sdbus-c++ is a high-level C++ D-Bus library for Linux
	  designed to provide expressive, easy-to-use API in modern C++.

	  This will build the target library.

	  https://github.com/Kistler-Group/sdbus-cpp

comment "sdbus-c++ needs systemd and a toolchain w/ C++, gcc >= 7"
	depends on !BR2_INSTALL_LIBSTDCPP || !BR2_PACKAGE_SYSTEMD || \
		!BR2_TOOLCHAIN_GCC_AT_LEAST_7
```

## package/sdbus-cpp/Config.in.host
```kconfig
config BR2_PACKAGE_HOST_SDBUS_CPP
	bool "host sdbus-c++"
	depends on BR2_HOST_GCC_AT_LEAST_7
	help
	  sdbus-c++ is a high-level C++ D-Bus library for Linux
	  designed to provide expressive, easy-to-use API in modern C++.

	  This will build the stub code generator for the adaptor and
	  proxy interfaces from D-Bus IDL.

	  https://github.com/Kistler-Group/sdbus-cpp
```

## package/sdk/Config.in
```kconfig
config BR2_PACKAGE_HAS_SDK
	bool

config BR2_PACKAGE_SDK_INSTALL
	depends on BR2_PACKAGE_HAS_SDK
	string
```

## package/sdl2/Config.in
```kconfig
config BR2_PACKAGE_SDL2
	bool "SDL2"
	help
	  Simple DirectMedia Layer - SDL2 is a library that allows
	  programs portable low level access to a video framebuffer,
	  audio output, mouse, and keyboard.

	  http://www.libsdl.org/

if BR2_PACKAGE_SDL2

config BR2_PACKAGE_SDL2_FBCON
	bool "SDL2 framebuffer console video driver"
	default y

config BR2_PACKAGE_SDL2_DIRECTFB
	bool "SDL2 DirectFB video driver"
	depends on BR2_PACKAGE_DIRECTFB

config BR2_PACKAGE_SDL2_QTOPIA
	bool "SDL2 Qtopia video driver"
	depends on BR2_PACKAGE_QT

config BR2_PACKAGE_SDL2_X11
	bool "SDL2 X11 video driver"
	depends on BR2_PACKAGE_XORG7
	select BR2_PACKAGE_XLIB_LIBX11
	select BR2_PACKAGE_XLIB_LIBXEXT

endif
```

## package/seatd/Config.in
```kconfig
menuconfig BR2_PACKAGE_SEATD
	bool "seatd"
	select BR2_PACKAGE_SEATD_BUILTIN \
		if !BR2_PACKAGE_SYSTEMD_LOGIND && !BR2_PACKAGE_SEATD_DAEMON
	help
	  Seat management daemon and support library.

	  https://git.sr.ht/~kennylevinsen/seatd

if BR2_PACKAGE_SEATD

config BR2_PACKAGE_SEATD_BUILTIN
	bool "builtin backend"
	help
	  Builtin in-process seatd implementation inside libseat.

config BR2_PACKAGE_SEATD_DAEMON
	bool "seatd daemon"
	help
	  Build the seatd daemon and support for it inside libseat.

endif
```

## package/semodule-utils/Config.in
```kconfig
config BR2_PACKAGE_SEMODULE_UTILS
	bool "semodule-utils"
	depends on BR2_TOOLCHAIN_HAS_THREADS # libsepol
	depends on BR2_TOOLCHAIN_GCC_AT_LEAST_5 # libsepol
	select BR2_PACKAGE_LIBSEPOL
	help
	  semodule-utils is a package that contains tools for handling
	  selinux modules.

	  The package will install the following utilities:
	  * semodule_deps - Show the dependencies between SELinux
	    policy packages.
	  * semodule_expand - Expand a SELinux policy module package.
	  * semodule_link - Link SELinux policy module packages together
	  * semodule_package - Create a SELinux policy module package.

	  https://github.com/SELinuxProject/selinux/wiki/Releases

comment "semodule-utils needs a toolchain w/ threads, gcc >= 5"
	depends on !BR2_TOOLCHAIN_HAS_THREADS || \
		!BR2_TOOLCHAIN_GCC_AT_LEAST_5
```

## package/serd/Config.in
```kconfig
config BR2_PACKAGE_SERD
	bool "serd"
	help
	  Serd is a lightweight C library for RDF syntax which
	  supports reading and writing Turtle, TriG, NTriples, and
	  NQuads.

	  https://drobilla.net/software/serd.html
```

## package/sexpect/Config.in
```kconfig
config BR2_PACKAGE_SEXPECT
	bool "sexpect"
	depends on BR2_USE_MMU # fork()
	help
	  sexpect is another implementation of Expect which is
	  specifically designed for Shell scripts
	  (sh, bash, ksh, zsh, ...)

	  https://github.com/clarkwang/sexpect
```

## package/sff-sdk/Config.in
```kconfig
config BR2_PACKAGE_SFF_SDK
	bool "sff-sdk"
	depends on BR2_arm
	select BR2_PACKAGE_HAS_NEXUS
	select BR2_PACKAGE_HAS_LIBEGL
	select BR2_PACKAGE_HAS_LIBGLES
	help
	  Pre-compiled binaries for a platform

if BR2_PACKAGE_SFF_SDK

config BR2_PACKAGE_PROVIDES_NEXUS
	default "sff-sdk"

config BR2_PACKAGE_PROVIDES_LIBEGL
	default "sff-sdk"

config BR2_PACKAGE_PROVIDES_LIBGLES
	default "sff-sdk"

endif
```

## package/shadow/Config.in
```kconfig
menuconfig BR2_PACKAGE_SHADOW
	bool "shadow"
	depends on !BR2_STATIC_LIBS
	depends on BR2_TOOLCHAIN_HEADERS_AT_LEAST_4_14
	depends on !BR2_TOOLCHAIN_USES_UCLIBC # reallocarray, explicit_bzero
	help
	  Utilities to deal with user accounts.

	  https://github.com/shadow-maint/shadow

if BR2_PACKAGE_SHADOW

config BR2_PACKAGE_SHADOW_SHADOWGRP
	bool "shadowgrp"
	help
	  Enable shadow group support.

config BR2_PACKAGE_SHADOW_ACCOUNT_TOOLS_SETUID
	bool "account-tools-setuid"
	depends on BR2_USE_MMU  # linux-pam
	depends on BR2_ENABLE_LOCALE  # linux-pam
	depends on BR2_USE_WCHAR  # linux-pam
	depends on !BR2_STATIC_LIBS  # linux-pam
	depends on BR2_TOOLCHAIN_GCC_AT_LEAST_4_9 # linux-pam
	select BR2_PACKAGE_LINUX_PAM
	help
	  Install the user and group management tools (e.g. groupadd)
	  with setuid and authenticate the callers via PAM.

comment "account-tools-setuid needs a toolchain w/ dynamic library, wchar, locale, gcc >= 4.9"
	depends on BR2_USE_MMU
	depends on BR2_STATIC_LIBS || !BR2_USE_WCHAR || \
		!BR2_ENABLE_LOCALE || !BR2_TOOLCHAIN_GCC_AT_LEAST_4_9

config BR2_PACKAGE_SHADOW_SUBORDINATE_IDS
	bool "subordinate-ids"
	help
	  Support subordinate ids. Helpful to use container solution
	  like podman without root.

config BR2_PACKAGE_SHADOW_SHA_CRYPT
	bool "sha-crypt"
	default y
	help
	  Allow the SHA256 and SHA512 password encryption algorithms.

config BR2_PACKAGE_SHADOW_BCRYPT
	bool "bcrypt"
	help
	  Allow the bcrypt password encryption algorithm.

config BR2_PACKAGE_SHADOW_YESCRYPT
	bool "yescrypt"
	help
	  Allow the yescrypt password encryption algorithm.

endif # BR2_PACKAGE_SHADOW

comment "shadow needs a glibc or musl toolchain w/ headers >= 4.14, dynamic library"
	depends on !BR2_TOOLCHAIN_HEADERS_AT_LEAST_4_14 || \
		BR2_STATIC_LIBS || BR2_TOOLCHAIN_USES_UCLIBC
```
