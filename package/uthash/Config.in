## package/uthash/Config.in
```kconfig
config BR2_PACKAGE_UTHASH
	bool "uthash"
	help
	  uthash is a set of C macros implementing hash tables, linked
	  lists, dynamic arrays and other data structures, provided as
	  headers only.

	  https://troydhanson.github.io/uthash/
```

## package/zstd/Config.in
```kconfig
config BR2_PACKAGE_ZSTD
	bool "zstd"
	help
	  Zstandard, or zstd as short version, is a fast lossless
	  compression algorithm, targeting real-time compression
	  scenarios at zlib-level and better compression ratios

	  The selection of other packages will enable some features:
	  xz, lz4 and/or zlib will enable support for corresponding
	  compression formats

	  https://facebook.github.io/zstd

if BR2_PACKAGE_ZSTD

config BR2_PACKAGE_ZSTD_PZSTD
	bool "pzstd"
	depends on BR2_INSTALL_LIBSTDCPP
	depends on BR2_TOOLCHAIN_HAS_THREADS
	help
	  PZstandard, or pzstd, is a multi-threaded implementation
	  of the Zstandard (zstd) compression algorithm.

comment "pzstd needs a toolchain w/ C++, threads"
	depends on !BR2_INSTALL_LIBSTDCPP || !BR2_TOOLCHAIN_HAS_THREADS

endif
```

## support/testing/tests/core/br2-external/flat-stacksize/Config.in
```kconfig
source "$BR2_EXTERNAL_FLAT_STACKSIZE_PATH/package/flat-stacksize-test/Config.in"
```

## support/testing/tests/core/br2-external/flat-stacksize/package/flat-stacksize-test/Config.in
```kconfig
config BR2_PACKAGE_FLAT_STACKSIZE_TEST
	bool "flat-stacksize-test"
	depends on BR2_BINFMT_FLAT && !BR2_USE_MMU
	help
	  Package for testing the $(PKG)_FLAT_STACKSIZE variable, which
	  defines the stack size of an application built into the
	  FLAT binary format.
```

## support/testing/tests/package/br2-external/sqlitecpp/package/sqlitecpp-test/Config.in
```kconfig
config BR2_PACKAGE_SQLITECPP_TEST
	bool "sqlitecpp-test"
	depends on BR2_PACKAGE_SQLITECPP
	help
	  Test program for the SQLiteCpp library.
```

## support/testing/tests/package/test_uboot_tools/signed.its
```
/dts-v1/;

/ {
	description = "Signed test FIT";
	#address-cells = <1>;

	images {
		kernel {
			description = "This file, pretending to be a kernel";
			data = /incbin/("example.its");
			type = "kernel";
			arch = "arm64";
			os = "linux";
			compression = "none";
			load = <0x40400000>;
			entry = <0x40400000>;

			hash-1 {
				algo = "sha256";
			};
		};
	};

	configurations {
		default = "config-1";

		config-1 {
			description = "Signed test entry";
			kernel = "kernel";

			signature-1 {
				algo = "sha256,rsa2048";
				key-name-hint = "dev";
				sign-images = "kernel";
			};
		};
	};
};
```
