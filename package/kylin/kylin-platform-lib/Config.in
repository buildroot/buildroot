## package/kylin/kylin-platform-lib/Config.in
```kconfig
config BR2_PACKAGE_KYLIN_PLATFORM_LIB
	bool "platform API"
	help
         Realtek Kylin hardware API
```

## package/kylin/mali/Config.in
```kconfig
config BR2_PACKAGE_KYLIN_MALI
	bool "mali videodriver"
	help
         kylin mali videodriver

         source:
	 ssh://dhcgerrit.realtek.com.tw:20002/mali_release
         branch: midgard_10.0_gLinux
         commit: 9284bb6a0f5ecd6b6eca4a9633a8b7ffd7367140
```

## package/lapack/Config.in
```kconfig
config BR2_PACKAGE_LAPACK_ARCH_SUPPORTS
	bool
	default y
	# _fpu_control is used on PowerPC, but not available with
	# uClibc or musl
	depends on !BR2_powerpc || BR2_TOOLCHAIN_USES_GLIBC

comment "lapack/blas needs a glibc toolchain"
	depends on BR2_powerpc
	depends on !BR2_TOOLCHAIN_USES_GLIBC

comment "lapack/blas needs a toolchain w/ fortran"
	depends on BR2_PACKAGE_LAPACK_ARCH_SUPPORTS
	depends on !BR2_TOOLCHAIN_HAS_FORTRAN

config BR2_PACKAGE_LAPACK
	bool "lapack/blas"
	depends on BR2_PACKAGE_LAPACK_ARCH_SUPPORTS
	depends on BR2_TOOLCHAIN_HAS_FORTRAN
	help
	  LAPACK and BLAS FORTRAN implementation. This package
	  installs two libraries: libblas and liblapack.

	  http://www.netlib.org/lapack/

config BR2_PACKAGE_LAPACK_COMPLEX
	bool "Complex/Complex16 support"
	default y
	depends on BR2_PACKAGE_LAPACK
	help
	  Builds support for COMPLEX and COMPLEX16 data types.
```

## package/leafnode2/Config.in
```kconfig
config BR2_PACKAGE_LEAFNODE2
	bool "leafnode2"
	depends on BR2_USE_MMU # fork()
	select BR2_PACKAGE_LIBXCRYPT if BR2_TOOLCHAIN_USES_GLIBC
	select BR2_PACKAGE_PCRE
	help
	  Leafnode-2 is a store-and-forward NNTP (or Usenet) proxy
	  server designed for small sites with just a few active
	  newsgroups.

	  https://gitlab.com/leafnode-2/leafnode-2
```

## package/ledmon/Config.in
```kconfig
config BR2_PACKAGE_LEDMON
	bool "ledmon"
	depends on BR2_PACKAGE_HAS_UDEV
	depends on BR2_TOOLCHAIN_HAS_THREADS # sg3_utils
	select BR2_PACKAGE_PCIUTILS
	select BR2_PACKAGE_SG3_UTILS
	help
	  Enclosure LED Utilities. The ledmon application is
	  a daemon process used to monitor a state of software
	  RAID devices (md only) or a state of block devices.

	  https://github.com/intel/ledmon

comment "ledmon needs udev and a toolchain w/ threads"
	depends on !BR2_PACKAGE_HAS_UDEV || !BR2_TOOLCHAIN_HAS_THREADS
```

## package/liba52/Config.in
```kconfig
config BR2_PACKAGE_LIBA52
	bool "liba52"
	help
	  http://liba52.sourceforge.net/
```

## package/libabseil-cpp/Config.in
```kconfig
config BR2_PACKAGE_LIBABSEIL_CPP
	bool "libabseil-cpp"
	depends on BR2_INSTALL_LIBSTDCPP
	depends on BR2_TOOLCHAIN_HAS_THREADS
	help
	  Abseil is an open-source collection of C++ library code
	  designed to augment the C++ standard library. The Abseil
	  library code is collected from Google's own C++ code base,
	  has been extensively tested and used in production, and is
	  the same code we depend on in our daily coding lives.

	  https://github.com/abseil/abseil-cpp

comment "libabseil-cpp needs a toolchain w/ C++, threads"
	depends on !BR2_INSTALL_LIBSTDCPP || !BR2_TOOLCHAIN_HAS_THREADS
```

## package/libamazon/Config.in
```kconfig
config BR2_PACKAGE_LIBAMAZON
	bool "libamazon"
		default n
	depends on (BR2_mipsel || BR2_arm) && !BR2_PACKAGE_AMAZON
	depends on BR2_PACKAGE_WPEFRAMEWORK
	select BR2_PACKAGE_JPEG
	select BR2_PACKAGE_ZLIB
	select BR2_PACKAGE_LIBCURL
	select BR2_PACKAGE_LIBPNG
	select BR2_PACKAGE_WPEFRAMEWORK_VIRTUALINPUT

	help
		This is the binary build package for the amazon application through
		the injected bundle in the Thunder AppEngine WebKitBrowser
```

## package/libargon2/Config.in
```kconfig
config BR2_PACKAGE_LIBARGON2
	bool "libargon2"
	depends on BR2_USE_MMU
	help
	  A modern password hashing algorithm

	  https://password-hashing.net/#argon2
```

## package/libatomic_ops/Config.in
```kconfig
config BR2_PACKAGE_LIBATOMIC_OPS_ARCH_SUPPORTS
	bool
	default y if BR2_aarch64 || BR2_arm || BR2_armeb
	default y if BR2_i386 || BR2_x86_64
	default y if BR2_powerpc || BR2_powerpc64 || BR2_powerpc64le
	default y if BR2_mips || BR2_mipsel || BR2_mips64 || BR2_mips64el
	default y if BR2_riscv
	default y if BR2_sparc || BR2_sparc64
	# Unsupported for MIPS R6
	depends on !BR2_MIPS_CPU_MIPS32R6 && !BR2_MIPS_CPU_MIPS64R6

config BR2_PACKAGE_LIBATOMIC_OPS
	bool "libatomic_ops"
	depends on BR2_PACKAGE_LIBATOMIC_OPS_ARCH_SUPPORTS
	help
	  Atomic operations library

	  https://github.com/ivmai/libatomic_ops
```

## package/libavif/Config.in
```kconfig
config BR2_PACKAGE_LIBAVIF
	bool "libavif"
	depends on !BR2_STATIC_LIBS # dav1d, dlfcn.h
	depends on BR2_TOOLCHAIN_HAS_THREADS # dav1d, pthread
	select BR2_PACKAGE_DAV1D
	help
	  Friendly, portable C implementation of the AV1 Image File
	  Format.

	  https://github.com/AOMediaCodec/libavif

comment "libavif needs a toolchain w/ threads, dynamic library"
	depends on !BR2_TOOLCHAIN_HAS_THREADS || BR2_STATIC_LIBS
```

## package/libb2/Config.in
```kconfig
config BR2_PACKAGE_LIBB2
	bool "libb2"
	help
	  C library providing BLAKE2b, BLAKE2s, BLAKE2bp, BLAKE2sp.

	  https://github.com/BLAKE2/libb2
```

## package/libblockdev/Config.in
```kconfig
config BR2_PACKAGE_LIBBLOCKDEV
	bool "libblockdev"
	depends on !BR2_STATIC_LIBS # kmod
	depends on BR2_USE_WCHAR # libglib2
	depends on BR2_TOOLCHAIN_HAS_THREADS # libglib2
	depends on BR2_USE_MMU # libglib2
	depends on BR2_PACKAGE_HAS_UDEV
	depends on BR2_ENABLE_LOCALE
	select BR2_PACKAGE_KMOD
	select BR2_PACKAGE_LIBGLIB2
	select BR2_PACKAGE_UTIL_LINUX
	select BR2_PACKAGE_UTIL_LINUX_LIBUUID
	help
	  libblockdev is a C library supporting GObject introspection
	  for manipulation of block devices. It has a plugin-based
	  architecture where each technology (like LVM, Btrfs, MD RAID,
	  Swap,...) is implemented in a separate plugin, possibly with
	  multiple implementations.

	  https://github.com/storaged-project/libblockdev/

if BR2_PACKAGE_LIBBLOCKDEV

comment "plugins"

config BR2_PACKAGE_LIBBLOCKDEV_CRYPTO
	bool "crypto"
	depends on BR2_TOOLCHAIN_HAS_SYNC_4 # cryptsetup -> json-c
	select BR2_PACKAGE_CRYPTSETUP
	select BR2_PACKAGE_KEYUTILS

config BR2_PACKAGE_LIBBLOCKDEV_FS
	bool "filesystem"
	depends on BR2_ENABLE_LOCALE # parted
	depends on BR2_TOOLCHAIN_GCC_AT_LEAST_5 # parted
	select BR2_PACKAGE_UTIL_LINUX_LIBMOUNT
	select BR2_PACKAGE_PARTED
	select BR2_PACKAGE_E2FSPROGS

comment "filesystem plugin needs a toolchain w/ locale, gcc >= 5"
	depends on !BR2_ENABLE_LOCALE || !BR2_TOOLCHAIN_GCC_AT_LEAST_5

config BR2_PACKAGE_LIBBLOCKDEV_LOOP
	bool "loop"

config BR2_PACKAGE_LIBBLOCKDEV_LVM2
	bool "lvm2"
	depends on BR2_ENABLE_LOCALE # parted
	depends on BR2_TOOLCHAIN_GCC_AT_LEAST_5 # parted
	select BR2_PACKAGE_PARTED
	select BR2_PACKAGE_LIBYAML
	select BR2_PACKAGE_LVM2

comment "lvm2 support needs a toolchain w/ locale, gcc >= 5"
	depends on !BR2_ENABLE_LOCALE || !BR2_TOOLCHAIN_GCC_AT_LEAST_5

config BR2_PACKAGE_LIBBLOCKDEV_MDRAID
	bool "mdraid"
	select BR2_PACKAGE_LIBBYTESIZE

config BR2_PACKAGE_LIBBLOCKDEV_NVME
	bool "nvme"
	depends on BR2_USE_MMU # libnvme
	select BR2_PACKAGE_LIBNVME

config BR2_PACKAGE_LIBBLOCKDEV_PART
	bool "part"
	depends on BR2_ENABLE_LOCALE # parted
	depends on BR2_TOOLCHAIN_GCC_AT_LEAST_5 # parted
	select BR2_PACKAGE_PARTED
	select BR2_PACKAGE_UTIL_LINUX_LIBFDISK

comment "part plugin needs a toolchain w/ locale, gcc >= 5"
	depends on !BR2_ENABLE_LOCALE || !BR2_TOOLCHAIN_GCC_AT_LEAST_5

config BR2_PACKAGE_LIBBLOCKDEV_SMART
	bool "smart"
	depends on BR2_PACKAGE_HAS_UDEV # libatasmart
	select BR2_PACKAGE_LIBATASMART

comment "smart support needs udev /dev management"
	depends on !BR2_PACKAGE_HAS_UDEV

config BR2_PACKAGE_LIBBLOCKDEV_SMARTMONTOOLS
	bool "smartmontools"
	depends on BR2_INSTALL_LIBSTDCPP # smartmontools
	depends on BR2_USE_MMU # smartmontools
	select BR2_PACKAGE_JSON_GLIB
	select BR2_PACKAGE_SMARTMONTOOLS # runtime

comment "smartmontools support needs a toolchain w/ C++"
	depends on BR2_USE_MMU
	depends on !BR2_INSTALL_LIBSTDCPP

config BR2_PACKAGE_LIBBLOCKDEV_SWAP
	bool "swap"
	select BR2_PACKAGE_UTIL_LINUX_LIBBLKID

endif

comment "libblockdev needs udev /dev management and a toolchain w/ wchar, threads, dynamic library, locale"
	depends on BR2_USE_MMU
	depends on !BR2_PACKAGE_HAS_UDEV || BR2_STATIC_LIBS || \
		!BR2_USE_WCHAR || !BR2_TOOLCHAIN_HAS_THREADS || \
		!BR2_ENABLE_LOCALE
```

## package/libbpf/Config.in
```kconfig
config BR2_PACKAGE_LIBBPF
	bool "libbpf"
	depends on BR2_TOOLCHAIN_HAS_SYNC_4
	depends on BR2_USE_WCHAR # elfutils
	depends on !BR2_STATIC_LIBS # elfutils
	depends on BR2_TOOLCHAIN_HAS_THREADS # elfutils
	depends on BR2_TOOLCHAIN_HEADERS_AT_LEAST_4_13
	depends on BR2_TOOLCHAIN_USES_UCLIBC || BR2_TOOLCHAIN_USES_GLIBC # elfutils
	select BR2_PACKAGE_ELFUTILS
	select BR2_PACKAGE_ZLIB
	help
	  libbpf library.
	  A mirror of bpf-next linux tree bpf-next/tools/lib/bpf
	  directory plus its supporting header files. The version
	  of the package reflects the version of ABI.

	  https://github.com/libbpf/libbpf

comment "libbpf needs a uClibc or glibc toolchain w/ wchar, dynamic library, threads, headers >= 4.13"
	depends on BR2_TOOLCHAIN_HAS_SYNC_4
	depends on !BR2_USE_WCHAR || BR2_STATIC_LIBS \
		|| !BR2_TOOLCHAIN_HAS_THREADS \
		|| !BR2_TOOLCHAIN_HEADERS_AT_LEAST_4_13 \
		|| !(BR2_TOOLCHAIN_USES_UCLIBC || BR2_TOOLCHAIN_USES_GLIBC)
```

## package/libcamera-apps/Config.in
```kconfig
config BR2_PACKAGE_LIBCAMERA_APPS
	bool "libcamera-apps"
	depends on BR2_PACKAGE_LIBCAMERA_ARCH_SUPPORTS # libcamera
	depends on BR2_INSTALL_LIBSTDCPP # libcamera/boost
	depends on BR2_TOOLCHAIN_HAS_THREADS # libcamera/boost
	depends on BR2_TOOLCHAIN_GCC_AT_LEAST_7 # C++17/libcamera
	depends on !BR2_STATIC_LIBS # gnutls/libcamera
	depends on BR2_USE_WCHAR # gnutls/libcamera/boost
	select BR2_PACKAGE_BOOST
	select BR2_PACKAGE_BOOST_PROGRAM_OPTIONS
	select BR2_PACKAGE_JPEG
	select BR2_PACKAGE_LIBCAMERA
	select BR2_PACKAGE_LIBEXIF
	select BR2_PACKAGE_LIBPNG
	select BR2_PACKAGE_TIFF
	select BR2_PACKAGE_XLIB_LIBX11 if BR2_PACKAGE_XORG7 && (BR2_PACKAGE_HAS_LIBEGL || BR2_PACKAGE_HAS_LIBGL)
	select BR2_PACKAGE_LIBEPOXY if BR2_PACKAGE_XORG7 && (BR2_PACKAGE_HAS_LIBEGL || BR2_PACKAGE_HAS_LIBGL)
	select BR2_PACKAGE_QT5BASE_GUI if BR2_PACKAGE_QT5
	select BR2_PACKAGE_QT5BASE_WIDGETS if BR2_PACKAGE_QT5
	help
	  This is a small suite of libcamera-based apps that aim to copy
	  the functionality of the existing "raspicam" apps.

	  https://github.com/raspberrypi/libcamera-apps

comment "libcamera-apps needs a toolchain w/ C++, threads, wchar, dynamic library, gcc >= 7"
	depends on BR2_PACKAGE_LIBCAMERA_ARCH_SUPPORTS
	depends on !BR2_INSTALL_LIBSTDCPP || !BR2_TOOLCHAIN_HAS_THREADS || \
		!BR2_TOOLCHAIN_GCC_AT_LEAST_7 || BR2_STATIC_LIBS || !BR2_USE_WCHAR
```

## package/libcamera/Config.in
```kconfig
config BR2_PACKAGE_LIBCAMERA_ARCH_SUPPORTS
	bool
	default y
	# Invalid packing size of ControlValue struct on m68k
	depends on !BR2_m68k
	depends on !BR2_TOOLCHAIN_HAS_BINUTILS_BUG_27597

menuconfig BR2_PACKAGE_LIBCAMERA
	bool "libcamera"
	depends on BR2_PACKAGE_LIBCAMERA_ARCH_SUPPORTS
	depends on BR2_INSTALL_LIBSTDCPP
	depends on BR2_TOOLCHAIN_HAS_THREADS
	depends on BR2_TOOLCHAIN_GCC_AT_LEAST_8 # C++17
	depends on !BR2_STATIC_LIBS # gnutls
	depends on BR2_USE_WCHAR # gnutls
	select BR2_PACKAGE_GNUTLS
	select BR2_PACKAGE_LIBYAML
	select BR2_PACKAGE_LIBCAMERA_PIPELINE_UVCVIDEO if !BR2_PACKAGE_LIBCAMERA_HAS_PIPELINE
	help
	  libcamera provides a software stack to support
	  complex devices that need heavy hardware image
	  processing operations.

	  http://www.libcamera.org/

if BR2_PACKAGE_LIBCAMERA

config BR2_PACKAGE_LIBCAMERA_V4L2
	bool "libcamera v4l2 compatibility layer"
	help
	  libcamera v4l2 compatibility layer

config BR2_PACKAGE_LIBCAMERA_HAS_PIPELINE
	bool

config BR2_PACKAGE_LIBCAMERA_PIPELINE_IMX8_ISI
	bool "imx8-isi pipeline"
	depends on BR2_arm || BR2_aarch64
	select BR2_PACKAGE_LIBCAMERA_HAS_PIPELINE
	help
	  Pipeline for i.MX8 SoC ISI capture interface.

config BR2_PACKAGE_LIBCAMERA_PIPELINE_IPU3
	bool "ipu3 pipeline"
	depends on BR2_i386 || BR2_x86_64
	select BR2_PACKAGE_LIBCAMERA_HAS_PIPELINE
	help
	  Pipeline for Intel IPU3.

config BR2_PACKAGE_LIBCAMERA_PIPELINE_RKISP1
	bool "rkisp1 pipeline"
	depends on BR2_arm || BR2_aarch64
	select BR2_PACKAGE_LIBCAMERA_HAS_PIPELINE
	help
	  Pipeline for Rockchip ISP1.

config BR2_PACKAGE_LIBCAMERA_PIPELINE_RPI_VC4
	bool "rpi/vc4 pipeline"
	depends on BR2_arm || BR2_aarch64
	depends on BR2_USE_WCHAR # boost (already enforced for gnutls)
	select BR2_PACKAGE_BOOST
	select BR2_PACKAGE_LIBCAMERA_HAS_PIPELINE
	help
	  Pipeline for Raspberry Pi devices.

config BR2_PACKAGE_LIBCAMERA_PIPELINE_SIMPLE
	bool "simple pipeline"
	select BR2_PACKAGE_LIBCAMERA_HAS_PIPELINE
	help
	  Pipeline for simple pipelines.

config BR2_PACKAGE_LIBCAMERA_PIPELINE_UVCVIDEO
	bool "uvcvideo pipeline"
	help
	  Pipeline for uvcvideo devices.

config BR2_PACKAGE_LIBCAMERA_PIPELINE_VIMC
	bool "vimc pipeline"
	select BR2_PACKAGE_LIBCAMERA_HAS_PIPELINE
	help
	  Pipeline for the vimc device.

config BR2_PACKAGE_LIBCAMERA_COMPLIANCE
	bool "lc-compliance test application"
	depends on BR2_USE_WCHAR # gtest
	depends on BR2_TOOLCHAIN_HAS_THREADS # gtest
	depends on BR2_INSTALL_LIBSTDCPP # gtest
	depends on BR2_TOOLCHAIN_GCC_AT_LEAST_5 # gtest
	depends on BR2_USE_MMU # gtest
	select BR2_PACKAGE_GTEST
	select BR2_PACKAGE_LIBEVENT
	help
	  lc-compliance test application

comment "lc-compliance test application needs a toolchain w/ C++, wchar, threads, gcc >= 5"
	depends on BR2_USE_MMU
	depends on !BR2_USE_WCHAR || !BR2_TOOLCHAIN_HAS_THREADS || \
		!BR2_INSTALL_LIBSTDCPP || !BR2_TOOLCHAIN_GCC_AT_LEAST_5

endif # BR2_PACKAGE_LIBCAMERA

comment "libcamera needs a toolchain w/ C++, threads, wchar, dynamic library, gcc >= 8"
	depends on BR2_PACKAGE_LIBCAMERA_ARCH_SUPPORTS
	depends on !BR2_INSTALL_LIBSTDCPP || !BR2_TOOLCHAIN_HAS_THREADS || \
		!BR2_TOOLCHAIN_GCC_AT_LEAST_8 || BR2_STATIC_LIBS || !BR2_USE_WCHAR
```

## package/libcanberra/Config.in
```kconfig
comment "libcanberra needs a toolchain w/ wchar, threads, dynamic library"
	depends on !BR2_USE_WCHAR || !BR2_TOOLCHAIN_HAS_THREADS || \
		BR2_STATIC_LIBS

config BR2_PACKAGE_LIBCANBERRA
	bool "libcanberra"
	depends on BR2_USE_WCHAR
	depends on BR2_TOOLCHAIN_HAS_THREADS
	depends on !BR2_STATIC_LIBS
	# We need at least one audio backend
	select BR2_PACKAGE_ALSA_LIB if \
	       !BR2_PACKAGE_PULSEAUDIO && \
	       !BR2_PACKAGE_GSTREAMER1
	# We need libltdl
	select BR2_PACKAGE_LIBTOOL
	select BR2_PACKAGE_LIBVORBIS
	help
	  libcanberra defines a simple abstract interface for playing
	  event sounds.

	  http://0pointer.de/lennart/projects/libcanberra/
```

## package/libcgroup/Config.in
```kconfig
config BR2_PACKAGE_LIBCGROUP
	bool "libcgroup"
	depends on BR2_INSTALL_LIBSTDCPP
	depends on BR2_TOOLCHAIN_HAS_THREADS
	select BR2_PACKAGE_MUSL_FTS if !BR2_TOOLCHAIN_USES_GLIBC
	help
	  libcgroup is a library that abstracts the control
	  group file system in Linux.

	  http://libcg.sourceforge.net/

if BR2_PACKAGE_LIBCGROUP

config BR2_PACKAGE_LIBCGROUP_TOOLS
	bool "install tools"
	help
	  Include a set of command-line tools for managing cgroups.

endif

comment "libcgroup needs a toolchain w/ C++, threads"
	depends on !BR2_INSTALL_LIBSTDCPP || !BR2_TOOLCHAIN_HAS_THREADS
```

## package/libcli/Config.in
```kconfig
config BR2_PACKAGE_LIBCLI
	bool "libcli"
	select BR2_PACKAGE_LIBXCRYPT if BR2_TOOLCHAIN_USES_GLIBC
	help
	  Libcli provides a shared library for including a Cisco-like
	  command-line interface into other software. It's a telnet
	  interface which supports command-line editing, history,
	  authentication and callbacks for a user-definable function
	  tree.

	  https://github.com/dparrish/libcli
```
