## package/libcoap/Config.in
```kconfig
config BR2_PACKAGE_LIBCOAP
	bool "libcoap"
	select BR2_PACKAGE_LIBOPENSSL_ENABLE_PSK if BR2_PACKAGE_LIBOPENSSL
	select BR2_PACKAGE_LIBOPENSSL_ENGINES if BR2_PACKAGE_LIBOPENSSL
	help
	  libcoap is a C implementation of a lightweight
	  application-protocol for devices that are constrained their
	  resources such as computing power, RF range, memory,
	  bandwidth, or network packet sizes. This protocol, CoAP, is
	  standardized by the IETF as RFC 7252. For further
	  information related to CoAP, see <http://coap.technology>.

	  https://github.com/obgm/libcoap
```

## package/libcppconnman/Config.in
```kconfig
config BR2_PACKAGE_LIBCPPCONNMAN
	bool "libcppconnman"
	depends on BR2_INSTALL_LIBSTDCPP
	depends on BR2_TOOLCHAIN_GCC_AT_LEAST_10 # C++20
	depends on BR2_USE_WCHAR # libglib2
	depends on BR2_TOOLCHAIN_HAS_THREADS # libglib2
	depends on BR2_USE_MMU # libglib2
	select BR2_PACKAGE_LIBGLIB2
	help
	  libcppconnman provide easy to use C++ API to communicate
	  with ConnMan via the DBus using GDBus.

	  https://amarula.github.io/libcppconnman/

comment "libcppconnman needs a toolchain w/ C++20, wchar, threads"
	depends on BR2_USE_MMU
	depends on !BR2_INSTALL_LIBSTDCPP || !BR2_USE_WCHAR || \
		!BR2_TOOLCHAIN_HAS_THREADS || !BR2_TOOLCHAIN_GCC_AT_LEAST_10

if BR2_PACKAGE_LIBCPPCONNMAN

config BR2_PACKAGE_LIBCPPCONNMAN_EXAMPLE
	bool "libcppconnman example"
	depends on BR2_TOOLCHAIN_HAS_SYNC_1 # std::atomic<bool>
	select BR2_PACKAGE_READLINE
	help
	  Compile CLI example.

endif
```

## package/libcurl/Config.in
```kconfig
config BR2_PACKAGE_LIBCURL
	bool "libcurl"
	help
	  cURL is a tool for getting files from FTP, HTTP, Gopher, Telnet,
	  and Dict servers, using any of the supported protocols.

	  http://curl.haxx.se/

if BR2_PACKAGE_LIBCURL

config BR2_PACKAGE_CURL
	bool "curl binary"
	help
	  Install curl binary as well

config BR2_PACKAGE_LIBCURL_VERBOSE
	bool "enable verbose strings"
	help
	  Enable verbose text strings

config BR2_PACKAGE_LIBCURL_ENABLE_HTTP2
	bool "enable HTTP2 support"
	select BR2_PACKAGE_NGHTTP2
	help
		Enable HTTP2 support

endif
```

## package/libdash/Config.in
```kconfig
config BR2_PACKAGE_LIBDASH
    bool "libdash"
    default n
    select BR2_PACKAGE_LIBCURL
    select BR2_PACKAGE_LIBXML2
    select BR2_PACKAGE_ZLIB
    help
       LIBDASH Library
```

## package/libdbi-drivers/Config.in
```kconfig
config BR2_PACKAGE_LIBDBI_DRIVERS
	bool "libdbi-drivers"
	depends on !BR2_STATIC_LIBS # libdbi
	select BR2_PACKAGE_LIBDBI
	help
	  The libdbi-drivers project provides the
	  database-specific drivers for the libdbi framework.

	  http://libdbi-drivers.sourceforge.net

comment "libdbi-drivers needs a toolchain w/ dynamic library"
	depends on BR2_STATIC_LIBS
```

## package/libdbi/Config.in
```kconfig
config BR2_PACKAGE_LIBDBI
	bool "lidbi"
	depends on !BR2_STATIC_LIBS
	help
	  libdbi implements a database-independent abstraction layer
	  in C, similar to the DBI/DBD layer in Perl.

	  http://libdbi.sourceforge.net

comment "libdbi needs a toolchain w/ dynamic library"
	depends on BR2_STATIC_LIBS
```
