## package/musl/Config.in
```kconfig
config BR2_PACKAGE_MUSL_ARCH_SUPPORTS
	bool
	default y if BR2_aarch64
	default y if BR2_aarch64_be
	default y if BR2_arm
	default y if BR2_armeb
	default y if BR2_i386
	default y if BR2_microblaze
	default y if BR2_mips
	default y if BR2_mipsel
	default y if BR2_mips64
	default y if BR2_mips64el
	default y if BR2_or1k
	default y if BR2_powerpc
	default y if BR2_powerpc64
	default y if BR2_powerpc64le
	default y if BR2_RISCV_64
	default y if BR2_sh
	default y if BR2_x86_64
	depends on !BR2_powerpc_SPE # not supported, build breaks
	depends on !(BR2_powerpc64 || BR2_powerpc64le) || BR2_POWERPC_CPU_HAS_ALTIVEC
	# sh2 nommu is supported by musl, but we don't have support
	# for it in Buildroot.
	depends on BR2_USE_MMU

config BR2_PACKAGE_MUSL_SUPPORTS
	bool
	default y if BR2_PACKAGE_MUSL_ARCH_SUPPORTS

config BR2_PACKAGE_MUSL
	bool
	default y
	depends on BR2_TOOLCHAIN_USES_MUSL
	select BR2_PACKAGE_LINUX_HEADERS
	# SSP broken on i386/ppc: http://www.openwall.com/lists/musl/2016/12/04/2
	select BR2_TOOLCHAIN_HAS_SSP if BR2_PACKAGE_HOST_BINUTILS_SUPPORTS_CFI \
		&& !(BR2_i386 || BR2_powerpc)
	# Compatibility headers: cdefs.h, queue.h
	select BR2_PACKAGE_MUSL_COMPAT_HEADERS
	help
	  http://musl.libc.org/
```

## package/mxt-app/Config.in
```kconfig
config BR2_PACKAGE_MXT_APP
	bool "mxt-app"
	depends on BR2_TOOLCHAIN_HAS_THREADS # libusb
	depends on BR2_TOOLCHAIN_GCC_AT_LEAST_4_9 # libusb
	select BR2_PACKAGE_LIBUSB
	help
	  mxt-app is a utility for managing Atmel maXTouch touch
	  controllers and other devices that support Atmel Object Based
	  Protocol.

	  https://github.com/atmel-maxtouch/mxt-app/

comment "mxt-app needs a toolchain w/ threads, gcc >= 4.9"
	depends on !BR2_TOOLCHAIN_HAS_THREADS || \
		!BR2_TOOLCHAIN_GCC_AT_LEAST_4_9
```

## package/mysensors/Config.in
```kconfig
config BR2_PACKAGE_MYSENSORS
	bool "mysensors MQTT gateway"
	help
	  MySensors is an open source hardware and software community focusing on do-it-yourself home automation and Internet of Things.

if BR2_PACKAGE_MYSENSORS

menu "Options"	
choice
	prompt "Radio Module"
config BR2_PACKAGE_MYSENSORS_TRANSPORT_NRF24
	bool "Nordic NRF24"
config BR2_PACKAGE_MYSENSORS_TRANSPORT_RS485
	bool "RS485"
config BR2_PACKAGE_MYSENSORS_TRANSPORT_RFM95
	bool "HopeRF RFM95"
endchoice
		
config BR2_PACKAGE_MYSENSORS_CONFIG_FILE
string "config file"
default "/etc/mysensorsgw.dat"	

menuconfig BR2_PACKAGE_MYSENSORS_IRQ
bool "Use IRQ on new messages"	
if 	BR2_PACKAGE_MYSENSORS_IRQ	
	config BR2_PACKAGE_MYSENSORS_IRQ_PIN
		string "Pin for IRQ"
		default "15"
endif

menuconfig BR2_PACKAGE_MYSENSORS_LEDS
bool "Use indication LEDS"	
if 	BR2_PACKAGE_MYSENSORS_LEDS
config BR2_PACKAGE_MYSENSORS_LEDS_ERR_PIN
	string "Pin for error led"
	default "12"

config BR2_PACKAGE_MYSENSORS_LEDS_RX_PIN
	string "Pin for receive data led"
	default "16"
	
config BR2_PACKAGE_MYSENSORS_LEDS_TX_PIN
	string "Pin for transmit data led"
	default "18"
endif

endmenu

choice
prompt "Gateway Type"
config BR2_PACKAGE_MYSENSORS_SYSTEM_ETHERNET
	bool "Network"
config BR2_PACKAGE_MYSENSORS_SYSTEM_MQTT
	bool "MQTT client"
config BR2_PACKAGE_MYSENSORS_SYSTEM_SERIAL
	bool "Serial"
endchoice

choice
prompt "Platform"
config BR2_PACKAGE_MYSENSORS_SYSTEM_RPI10
	bool "RaspberryPi 1/0"
config BR2_PACKAGE_MYSENSORS_SYSTEM_RPI23
	bool "RaspberryPi 2/3"
endchoice

if BR2_PACKAGE_MYSENSORS_SYSTEM_MQTT
menuconfig BR2_PACKAGE_MYSENSORS_TYPE_MQTT
	bool "MQTT Options"
	select BR2_PACKAGE_MOSQUITTO
	  
if BR2_PACKAGE_MYSENSORS_TYPE_MQTT
	config BR2_PACKAGE_MYSENSORS_MQTT_IP
		string "mqtt broker ip"
		default "127.0.0.1"

	config BR2_PACKAGE_MYSENSORS_MQTT_PUBLISH_TOPIC_PREFIX
		string "mqtt publish topic prefix"
		default "mysensors-out"

	config BR2_PACKAGE_MYSENSORS_MQTT_SUBSCRIBE_TOPIC_PREFIX
		string "mqtt subscribe topic prefix"
		default "mysensors-in"

	config BR2_PACKAGE_MYSENSORS_MQTT_CLIEN_ID
		string "mqtt client id"
		default "mygateway1"
endif
endif

endif
```

## package/nanomsg/Config.in
```kconfig
config BR2_PACKAGE_NANOMSG
    bool "nanomsg"
    default n
    help
      Socket library that provides several common communication patterns
```

## package/ndctl/Config.in
```kconfig
config BR2_PACKAGE_NDCTL
	bool "ndctl"
	depends on BR2_PACKAGE_HAS_UDEV
	depends on BR2_TOOLCHAIN_HEADERS_AT_LEAST_5_10 # __struct_group()
	depends on BR2_TOOLCHAIN_HAS_THREADS
	depends on BR2_USE_MMU
	select BR2_PACKAGE_INIPARSER
	select BR2_PACKAGE_JSON_C
	select BR2_PACKAGE_KEYUTILS
	select BR2_PACKAGE_KMOD
	select BR2_PACKAGE_UTIL_LINUX
	select BR2_PACKAGE_UTIL_LINUX_LIBS
	select BR2_PACKAGE_UTIL_LINUX_LIBUUID
	help
	  A "device memory" enabling project encompassing tools and
	  libraries for CXL, NVDIMMs, DAX, memory tiering and other
	  platform memory device topics.

	  https://github.com/pmem/ndctl

comment "ndctl needs udev /dev management, a toolchain headers >= 5.10"
	depends on BR2_USE_MMU
	depends on !BR2_PACKAGE_HAS_UDEV \
		|| !BR2_TOOLCHAIN_HAS_THREADS \
		|| !BR2_TOOLCHAIN_HEADERS_AT_LEAST_5_10
```

## package/neon-2-sse/Config.in
```kconfig
config BR2_PACKAGE_NEON_2_SSE
	bool "neon-2-sse"
	help
	  The platform independent header allowing to compile any
	  C/C++ code containing ARM NEON intrinsic functions for
	  x86 target systems using SIMD up to SSE4 intrinsic
	  functions.

	  https://github.com/intel/ARM_NEON_2_x86_SSE
```

## package/nerdctl/Config.in
```kconfig
config BR2_PACKAGE_NERDCTL
	bool "nerdctl"
	depends on BR2_PACKAGE_HOST_GO_TARGET_ARCH_SUPPORTS
	depends on BR2_PACKAGE_HOST_GO_TARGET_CGO_LINKING_SUPPORTS
	depends on BR2_TOOLCHAIN_HAS_THREADS
	depends on !BR2_TOOLCHAIN_USES_UCLIBC # containerd
	depends on BR2_USE_MMU # util-linux
	select BR2_PACKAGE_CONTAINERD # runtime
	help
	  Docker-compatible CLI for containerd, controlling runc.

	  https://github.com/containerd/nerdctl

comment "nerdctl needs a glibc or musl toolchain w/ threads"
	depends on BR2_PACKAGE_HOST_GO_TARGET_ARCH_SUPPORTS
	depends on BR2_PACKAGE_HOST_GO_TARGET_CGO_LINKING_SUPPORTS
	depends on BR2_USE_MMU
	depends on !BR2_TOOLCHAIN_HAS_THREADS || BR2_TOOLCHAIN_USES_UCLIBC
```

## package/netavark/Config.in
```kconfig
config BR2_PACKAGE_NETAVARK
	bool "netavark"
	depends on BR2_PACKAGE_HOST_RUSTC_TARGET_ARCH_SUPPORTS
	select BR2_PACKAGE_HOST_RUSTC
	select BR2_PACKAGE_AARDVARK_DNS  # runtime
	select BR2_PACKAGE_IPTABLES if !BR2_PACKAGE_NFTABLES  # runtime
	select BR2_PACKAGE_NFTABLES_JSON if BR2_PACKAGE_NFTABLES && !BR2_PACKAGE_IPTABLES
	help
	  Netavark is a rust based network stack for containers. It
	  is being designed to work with Podman but is also applicable
	  for other OCI container management applications.

	  https://github.com/containers/netavark
```

## package/netbird/Config.in
```kconfig
config BR2_PACKAGE_NETBIRD
	bool "netbird"
	depends on BR2_PACKAGE_HOST_GO_TARGET_ARCH_SUPPORTS
	select BR2_PACKAGE_HOST_GO
	help
	  Connect your devices into a secure WireGuard-based
	  overlay network with SSO, MFA and granular access
	  controls.

	  https://github.com/netbirdio/netbird
```
