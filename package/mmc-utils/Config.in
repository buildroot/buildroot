## package/mmc-utils/Config.in
```kconfig
config BR2_PACKAGE_MMC_UTILS
	bool "mmc-utils"
	depends on BR2_TOOLCHAIN_HEADERS_AT_LEAST_4_4
	help
	  MMC utils

	  https://git.kernel.org/pub/scm/utils/mmc/mmc-utils.git

if BR2_PACKAGE_MMC_UTILS

config BR2_PACKAGE_MMC_UTILS_ENABLE_DANGEROUS_COMMANDS
	bool "Enable dangerous commands"
	help
	   Enable support for dangerous commands in mmc-utils. mmc-utils
	   considers turning on permanent write protection on a device a
	   "dangerous command" and doesn't offer it by default.

endif

comment "mmc-utils needs a toolchain w/ headers >= 4.4"
	depends on !BR2_TOOLCHAIN_HEADERS_AT_LEAST_4_4
```

## package/moarvm/Config.in
```kconfig
config BR2_PACKAGE_MOARVM
	bool "moarvm"
	depends on BR2_TOOLCHAIN_HAS_THREADS_NPTL # libuv
	depends on !BR2_STATIC_LIBS # libuv
	depends on BR2_USE_MMU # libuv
	depends on BR2_PACKAGE_LIBATOMIC_OPS_ARCH_SUPPORTS # libatomic_ops
	depends on BR2_TOOLCHAIN_HAS_SYNC_4 # libuv
	depends on BR2_TOOLCHAIN_GCC_AT_LEAST_4_9 # libuv
	select BR2_PACKAGE_LIBUV
	select BR2_PACKAGE_LIBTOMMATH
	select BR2_PACKAGE_LIBATOMIC_OPS
	# dyncall does not work on riscv
	select BR2_PACKAGE_LIBFFI if BR2_riscv
	select BR2_PACKAGE_ZSTD
	help
	  Short for "Metamodel On A Runtime", MoarVM is a virtual
	  machine built especially for Rakudo Perl 6 and the NQP
	  Compiler Toolchain.

	  http://moarvm.com

comment "moarvm needs a toolchain w/ NPTL, dynamic library, gcc >= 4.9"
	depends on !BR2_TOOLCHAIN_HAS_THREADS_NPTL || BR2_STATIC_LIBS \
		|| !BR2_TOOLCHAIN_GCC_AT_LEAST_4_9
	depends on BR2_USE_MMU
	depends on BR2_PACKAGE_LIBATOMIC_OPS_ARCH_SUPPORTS
	depends on BR2_TOOLCHAIN_HAS_SYNC_4
```

## package/moby-buildkit/Config.in
```kconfig
config BR2_PACKAGE_MOBY_BUILDKIT
	bool "moby-buildkit"
	depends on BR2_PACKAGE_HOST_GO_TARGET_ARCH_SUPPORTS
	depends on BR2_PACKAGE_HOST_GO_TARGET_CGO_LINKING_SUPPORTS
	depends on BR2_TOOLCHAIN_HAS_THREADS
	depends on !BR2_TOOLCHAIN_USES_UCLIBC
	depends on BR2_USE_MMU
	select BR2_PACKAGE_CGROUPFS_MOUNT if !BR2_PACKAGE_SYSTEMD # runtime dependency
	select BR2_PACKAGE_HOST_GO
	help
	  BuildKit is a toolkit for converting source code to build
	  artifacts in an efficient, expressive and repeatable manner.

	  https://github.com/moby/buildkit

comment "moby-buildkit needs a glibc or musl toolchain w/ threads"
	depends on BR2_PACKAGE_HOST_GO_TARGET_ARCH_SUPPORTS
	depends on BR2_PACKAGE_HOST_GO_TARGET_CGO_LINKING_SUPPORTS
	depends on !BR2_TOOLCHAIN_HAS_THREADS || BR2_TOOLCHAIN_USES_UCLIBC
	depends on BR2_USE_MMU
```

## package/moby-buildkit/Config.in.host
```kconfig
config BR2_PACKAGE_HOST_MOBY_BUILDKIT
	bool "host moby-buildkit"
	depends on BR2_PACKAGE_HOST_GO_HOST_ARCH_SUPPORTS
	help
	  BuildKit is a toolkit for converting source code to build
	  artifacts in an efficient expressive and repeatable manner.

	  https://github.com/moby/buildkit
```

## package/modem-manager/Config.in
```kconfig
config BR2_PACKAGE_MODEM_MANAGER
	bool "modem-manager"
	depends on BR2_USE_WCHAR # libglib2 and gnutls
	depends on BR2_TOOLCHAIN_HAS_THREADS # dbus, libglib2
	depends on BR2_USE_MMU # dbus
	depends on !BR2_STATIC_LIBS
	select BR2_PACKAGE_DBUS
	select BR2_PACKAGE_LIBGLIB2
	select BR2_PACKAGE_LIBGUDEV if BR2_PACKAGE_HAS_UDEV
	help
	  ModemManager is a DBus-activated daemon which controls mobile
	  broadband (2G/3G/4G) devices and connections.

	  http://www.freedesktop.org/wiki/Software/ModemManager/

if BR2_PACKAGE_MODEM_MANAGER

config BR2_PACKAGE_MODEM_MANAGER_LIBMBIM
	bool "MBIM support"
	select BR2_PACKAGE_LIBMBIM
	help
	  This option enables support for MBIM protocol

config BR2_PACKAGE_MODEM_MANAGER_LIBQMI
	bool "QMI support"
	select BR2_PACKAGE_LIBQMI
	help
	  This option enables support for QMI protocol

config BR2_PACKAGE_MODEM_MANAGER_LIBQRTR
	bool "QRTR support"
	depends on BR2_TOOLCHAIN_HEADERS_AT_LEAST_4_15 # libqrtr-glib
	select BR2_PACKAGE_LIBQRTR_GLIB
	select BR2_PACKAGE_MODEM_MANAGER_LIBQMI
	help
	  This option enables support for QRTR protocol

comment "QRTR support needs a toolchain w/ headers >= 4.15"
	depends on !BR2_TOOLCHAIN_HEADERS_AT_LEAST_4_15

config BR2_PACKAGE_MODEM_MANAGER_ATVIADBUS
	bool "at-via-dbus support"
	help
	  This option enables support for issuing AT commands
	  over the D-Bus interface.

endif

comment "modemmanager needs a toolchain w/ wchar, threads, dynamic library"
	depends on !BR2_USE_WCHAR || !BR2_TOOLCHAIN_HAS_THREADS || \
		BR2_STATIC_LIBS
	depends on BR2_USE_MMU
```

## package/modsecurity2/Config.in
```kconfig
config BR2_PACKAGE_MODSECURITY2
	bool "modsecurity2"
	depends on BR2_PACKAGE_APACHE
	select BR2_PACKAGE_LIBXML2
	select BR2_PACKAGE_PCRE
	help
	  ModSecurity is an open source, cross-platform web application
	  firewall (WAF) module. Known as the "Swiss Army Knife" of
	  WAFs, it enables web application defenders to gain visibility
	  into HTTP(S) traffic and provides a power rules language and
	  API to implement advanced protections.

	  https://github.com/SpiderLabs/ModSecurity
```

## package/mokutil/Config.in
```kconfig
config BR2_PACKAGE_MOKUTIL
	bool "mokutil"
	# We're not selecting shim, but this package only makes sense
	# on architectures on which shim is supported
	depends on BR2_PACKAGE_SHIM_ARCH_SUPPORTS
	depends on BR2_PACKAGE_EFIVAR_ARCH_SUPPORTS
	depends on BR2_USE_MMU # keyutils
	depends on !BR2_STATIC_LIBS # efivar, keyutils
	depends on !BR2_TOOLCHAIN_EXTERNAL_CODESOURCERY_MIPS # efivar
	depends on BR2_TOOLCHAIN_GCC_AT_LEAST_4_9 # efivar
	depends on BR2_TOOLCHAIN_HAS_THREADS # efivar
	depends on BR2_TOOLCHAIN_HEADERS_AT_LEAST_3_12 # efivar
	select BR2_PACKAGE_EFIVAR
	select BR2_PACKAGE_KEYUTILS
	select BR2_PACKAGE_LIBXCRYPT if BR2_TOOLCHAIN_USES_GLIBC
	select BR2_PACKAGE_OPENSSL
	select BR2_PACKAGE_OPENSSL_FORCE_LIBOPENSSL
	help
	  mokutil is a tool to import or delete the machines owner
	  keys (MOK) stored in the database of shim.

	  "shim" is the first stage bootloader to support UEFI Secure
	  Boot. See also the "shim" package in the bootloaders
	  section.

	  https://github.com/lcp/mokutil

comment "mokutil needs a toolchain w/ dynamic library, threads, gcc >= 4.9, headers >= 3.12"
	depends on BR2_PACKAGE_EFIVAR_ARCH_SUPPORTS
	depends on BR2_PACKAGE_SHIM_ARCH_SUPPORTS
	depends on BR2_USE_MMU
	depends on BR2_STATIC_LIBS || \
		!BR2_TOOLCHAIN_GCC_AT_LEAST_4_9 || \
		!BR2_TOOLCHAIN_HAS_THREADS || \
		!BR2_TOOLCHAIN_HEADERS_AT_LEAST_3_12
```

## package/mosquitto/Config.in
```kconfig
config BR2_PACKAGE_MOSQUITTO
	bool "mosquitto"
	depends on BR2_USE_MMU  # lib peeks in malloc() internals; broker fork()s
	depends on !BR2_STATIC_LIBS
	select BR2_PACKAGE_CJSON
	help
	  Eclipse Mosquitto is an open source (EPL/EDL licensed) message
	  broker that implements the MQTT protocol versions 5.0, 3.1.1
	  and 3.1. Mosquitto is lightweight and is suitable for use on
	  all devices from low power single board computers to full
	  servers.

	  The MQTT protocol provides a lightweight method of carrying
	  out messaging using a publish/subscribe model. This makes it
	  suitable for Internet of Things messaging such as with low
	  power sensors or mobile devices such as phones,
	  embedded computers or microcontrollers.

	  The Mosquitto project also provides a C library for
	  implementing MQTT clients, and the very popular mosquitto_pub
	  and mosquitto_sub command line MQTT clients.

	  https://mosquitto.org/

if BR2_PACKAGE_MOSQUITTO

choice
	prompt "Websockets support"
	help
	  Choose what websocket implementation to use. Note that
	  the mosquitto_{sub,pub,rr} clients (above) only support
	  websockets with the builtin implementation, while the
	  broker supports websockets with either libwebsockets
	  or the builtin implementation.

config BR2_PACKAGE_MOSQUITTO_WS_NONE
	bool "none"

config BR2_PACKAGE_MOSQUITTO_WS_LIBWS
	bool "with libwebsockets"
	select BR2_PACKAGE_OPENSSL
	select BR2_PACKAGE_LIBWEBSOCKETS
	select BR2_PACKAGE_LIBWEBSOCKETS_EXT_POLL

config BR2_PACKAGE_MOSQUITTO_WS_BUILTIN
	bool "with builtin implementation"
	select BR2_PACKAGE_OPENSSL

endchoice

config BR2_PACKAGE_MOSQUITTO_CLIENTS
	bool "install clients"
	default y  # Backward compatibility
	help
	  Install CLI tools to publish/subscribe to the broker:
	    mosquitto_pub
	    mosquitto_sub
	    mosquitto_rr

config BR2_PACKAGE_MOSQUITTO_APPS
	bool "install apps"
	default y if BR2_PACKAGE_MOSQUITTO_BROKER  # Backward compatibility
	depends on BR2_USE_WCHAR  # libedit
	# For mosquitto_ctrl shell feature, mandatorily enabled:
	select BR2_PACKAGE_READLINE if !BR2_PACKAGE_LIBEDIT
	help
	  Those apps can be used to interact with the broker:
	    mosquitto_db_dump
	    mosquitto_signal

	  Additionally, when openssl is enabled, the following apps are
	  also installed:
	    mosquitto_ctrl
	    mosquitto_passwd

config BR2_PACKAGE_MOSQUITTO_BROKER
	bool "install the mosquitto broker"
	default y
	help
	  Build and install the mosquitto broker onto target.

if BR2_PACKAGE_MOSQUITTO_BROKER

config BR2_PACKAGE_MOSQUITTO_BROKER_HTTP_API
	bool "http_api"
	select BR2_PACKAGE_LIBMICROHTTPD
	help
	  Add support for simple webserver as a listener to serve
	  some of the HTTP API.

config BR2_PACKAGE_MOSQUITTO_BROKER_BRIDGE
	bool "bridge support"
	default y  # legacy
	help
	  Include bridge support for connecting to other brokers

config BR2_PACKAGE_MOSQUITTO_BROKER_SYS
	bool "$SYS tree support"
	default y  # legacy
	help
	  Enable the $SYS/# tree structure, to export broker status as
	  MQTT topics.

config BR2_PACKAGE_MOSQUITTO_BROKER_CONTROL
	bool "$CONTROL tree support"
	default y  # legacy
	help
	  Enable the $CONTROL/# tree structure, to control the broker
	  via messages posted to, or retrieved from, MQTT topics.

config BR2_PACKAGE_MOSQUITTO_BROKER_PLUGIN_STATIC_PASSWD
	bool "static password file plugin"
	default y
	help
	  Add support for authentication based on static files. using
	  a plugin rather than the legacy builtin support.

config BR2_PACKAGE_MOSQUITTO_BROKER_PLUGIN_STATIC_ACL
	bool "static ACL file plugin"
	default y
	help
	  Add support for authorization (ACL) based on static files,
	  using a plugin rather than the legacy builtin support.

config BR2_PACKAGE_MOSQUITTO_BROKER_DYNAMIC_SECURITY_PLUGIN
	bool "dynamic security plugin"
	select BR2_PACKAGE_OPENSSL
	help
	  Build and install the dynamic security plugin for
	  mosquitto broker onto target.

config BR2_PACKAGE_MOSQUITTO_BROKER_PLUGIN_PERSIST_SQLITE
	bool "persist-sqlite plugin"
	select BR2_PACKAGE_SQLITE
	help
	  Add the persist-sqlite plugin, to persist the broker
	  state across restarts.

endif
endif

comment "mosquitto needs a toolchain w/ dynamic library"
	depends on BR2_USE_MMU
	depends on BR2_STATIC_LIBS
```

## package/mosquitto/Config.in.host
```kconfig
config BR2_PACKAGE_HOST_MOSQUITTO
	bool "host mosquitto (mosquitto_passwd)"
	select BR2_HOST_CMAKE_AT_LEAST_4_3
	help
	  Only installs mosquitto_passwd.
```

## package/mp4v2/Config.in
```kconfig
config BR2_PACKAGE_MP4V2
	bool "mp4v2"
	depends on BR2_INSTALL_LIBSTDCPP
	depends on BR2_TOOLCHAIN_GCC_AT_LEAST_5 # C++11
	help
	  The MP4v2 library provides functions to read, create, and
	  modify mp4 files.

	  https://github.com/TechSmith/mp4v2/

if BR2_PACKAGE_MP4V2

config BR2_PACKAGE_MP4V2_UTIL
	bool "Install mp4 command line tools"
	help
	  Enable to install the mp4 command line tools mp4art,
	  mp4chaps, mp4extract, mp4info, mp4subtitle, mp4tags, and
	  mp4trackdump.

endif

comment "mp4v2 needs a toolchain w/ C++, gcc >= 5"
	depends on !BR2_INSTALL_LIBSTDCPP || \
		!BR2_TOOLCHAIN_GCC_AT_LEAST_5
```

## package/mpir/Config.in
```kconfig
config BR2_PACKAGE_MPIR
	bool "mpir"
	select BR2_PACKAGE_GMP
	help
	  MPIR is a highly optimised library for bignum arithmetic
	  forked from the GMP bignum library.

	  https://github.com/wbhart/mpir
```

## package/mrouted/Config.in
```kconfig
config BR2_PACKAGE_MROUTED
	bool "mrouted"
	depends on BR2_USE_MMU # fork()
	help
	  An implementation of the DVMRP multicast routing protocol.
	  Unlike PIM a DVMRP router has a distance vector protocol (like
	  RIP) built-in to figure out the reverse-path to the multicast
	  source. This package comes with mrouted and mroutectl.  Where
	  the latter is used to query status and control operation.

	  Note: at least two interfaces with MULTICAST flag is requried.

	  http://github.com/troglobit/mrouted
```

## package/msgpack-c/Config.in
```kconfig
config BR2_PACKAGE_MSGPACK_C
	bool "msgpack-c"
	help
	  MessagePack is an efficient binary serialization format.

	  It lets you exchange data among multiple languages like JSON
	  but it's faster and smaller.

	  Note: this package is the C variant of msgpack-c. For the
	  C++ variant, use the "msgpack" Buildroot package.

	  https://msgpack.org/
```

## package/mstpd/Config.in
```kconfig
config BR2_PACKAGE_MSTPD
	bool "mstpd"
	help
	  Multiple Spanning Tree Protocol Daemon.
	  This package provides a user-space daemon which replaces
	  the STP handling that is built into the Linux kernel Ethernet
	  bridge and adds support for RSTP and PVST+.

	  https://github.com/mstpd/mstpd
```

## package/multipath-tools/Config.in
```kconfig
comment "multipath-tools needs udev and a toolchain w/ threads, dynamic library, C++"
	depends on BR2_USE_MMU
	depends on BR2_TOOLCHAIN_HAS_SYNC_4
	depends on BR2_PACKAGE_LIBURCU_ARCH_SUPPORTS
	depends on !BR2_TOOLCHAIN_HAS_THREADS || BR2_STATIC_LIBS || \
		!BR2_PACKAGE_HAS_UDEV || !BR2_INSTALL_LIBSTDCPP

config BR2_PACKAGE_MULTIPATH_TOOLS
	bool "multipath-tools"
	depends on !BR2_STATIC_LIBS
	depends on BR2_USE_MMU
	depends on BR2_TOOLCHAIN_HAS_THREADS
	depends on BR2_TOOLCHAIN_HAS_SYNC_4
	depends on BR2_PACKAGE_LIBURCU_ARCH_SUPPORTS
	depends on BR2_PACKAGE_HAS_UDEV
	depends on BR2_INSTALL_LIBSTDCPP # liburcu
	select BR2_PACKAGE_JSON_C
	select BR2_PACKAGE_LIBURCU
	select BR2_PACKAGE_LIBAIO
	select BR2_PACKAGE_LVM2
	select BR2_PACKAGE_LVM2_STANDARD_INSTALL
	select BR2_PACKAGE_READLINE
	select BR2_PACKAGE_UTIL_LINUX
	select BR2_PACKAGE_UTIL_LINUX_LIBS
	select BR2_PACKAGE_UTIL_LINUX_LIBMOUNT
	help
	  This package provides the following binaries to drive
	  the Device Mapper multipathing driver:
	    * multipath - Device mapper target autoconfig.
	    * multipathd - Multipath daemon.
	    * mpathpersist - Manages SCSI persistent reservations on
	      dm multipath devices.
	    * kpartx - Create device maps from partition tables.

	  https://github.com/openSUSE/multipath-tools
```

## package/mupdf/Config.in
```kconfig
config BR2_PACKAGE_MUPDF
	bool "mupdf"
	depends on BR2_INSTALL_LIBSTDCPP # harfbuzz
	depends on BR2_TOOLCHAIN_HAS_SYNC_4 # harfbuzz
	depends on BR2_TOOLCHAIN_GCC_AT_LEAST_4_9 # harfbuzz
	select BR2_PACKAGE_FREETYPE
	select BR2_PACKAGE_GUMBO_PARSER
	select BR2_PACKAGE_HARFBUZZ
	select BR2_PACKAGE_JBIG2DEC
	select BR2_PACKAGE_JPEG
	select BR2_PACKAGE_LCMS2
	select BR2_PACKAGE_OPENJPEG
	select BR2_PACKAGE_ZLIB
	help
	  MuPDF is a lightweight PDF, XPS, and E-book viewer.

	  https://www.mupdf.com/

comment "mupdf needs a toolchain w/ C++, gcc >= 4.9"
	depends on BR2_TOOLCHAIN_HAS_SYNC_4
	depends on !BR2_INSTALL_LIBSTDCPP || \
		!BR2_TOOLCHAIN_GCC_AT_LEAST_4_9
```
