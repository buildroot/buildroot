## package/rockchip-rkbin/Config.in
```kconfig
config BR2_PACKAGE_ROCKCHIP_RKBIN
	bool "rockchip-rkbin"
	depends on BR2_arm || BR2_aarch64
	help
	  This package provides Rockchip SoC binary blobs for U-Boot.

if BR2_PACKAGE_ROCKCHIP_RKBIN

config BR2_PACKAGE_ROCKCHIP_RKBIN_TPL_FILENAME
	string "Rockchip rkbin tpl file path"
	help
	  Path to the tpl file inside the rkbin repository. The
	  specified file will be copied and used by U-Boot as tpl.

config BR2_PACKAGE_ROCKCHIP_RKBIN_BL31_FILENAME
	string "Rockchip rkbin bl31 file path"
	help
	  Path to the bl31 file inside the rkbin repository. The
	  specified file will be copied and used by U-Boot as bl31.

config BR2_PACKAGE_ROCKCHIP_RKBIN_TEE_FILENAME
	string "Rockchip rkbin tee file path"
	help
	  Path to the TEE file inside the rkbin repository. The
	  specified file will be copied and used by U-Boot as TEE.

endif # BR2_PACKAGE_ROCKCHIP_RKBIN
```

## package/rpi-bt-firmware/Config.in
```kconfig
config BR2_PACKAGE_RPI_BT_FIRMWARE
	bool "rpi-bt-firmware"
	depends on BR2_PACKAGE_RPI_FIRMWARE && \
		(BR2_PACKAGE_RPI_VERSION_RPI0 || BR2_PACKAGE_RPI_VERSION_RPI3 || BR2_PACKAGE_RPI_VERSION_RPI3PLUS) && \
		(BR2_arm || BR2_aarch64)
	help
	  Raspberry Pi 3 and Zero W Broadcom BCM43438 Bluetooth module
	  firmware.

	  https://aur.archlinux.org/packages/pi-bluetooth
```

## package/rpi-firmware/Config.in
```kconfig
config BR2_PACKAGE_RPI_FIRMWARE
	bool "rpi-firmware"
	depends on BR2_arm || BR2_aarch64
	help
	  RaspberryPi Firmware

	  Pre-compiled binaries of the current bootloader and GPU
	  firmware

	  https://github.com/raspberrypi/firmware

if BR2_PACKAGE_RPI_FIRMWARE

config BR2_PACKAGE_RPI_FIRMWARE_BOOTCODE_BIN
	bool "rpi 0/1/2/3 bootcode.bin"
	help
	  The bootcode.bin for versions Zero/1/2/3 (not needed on rpi4,
	  because it has been replaced by boot code in the onboard
	  EEPROM).

config BR2_PACKAGE_RPI_FIRMWARE_VARIANT_PI
	bool "rpi 0/1/2/3 (default)"
	help
	  The default set of files for versions Zero/1/2/3.

config BR2_PACKAGE_RPI_FIRMWARE_VARIANT_PI_X
	bool "rpi 0/1/2/3 (extended)"
	help
	  The extended set of files for versions Zero/1/2/3 (additional
	  GPU features, eg. more audio/video codecs).

config BR2_PACKAGE_RPI_FIRMWARE_VARIANT_PI_CD
	bool "rpi 0/1/2/3 (cut-down)"
	help
	  The cut-down set of files for versions Zero/1/2/3 (only
	  features required to boot a Linux kernel).

config BR2_PACKAGE_RPI_FIRMWARE_VARIANT_PI_DB
	bool "rpi 0/1/2/3 (debug)"
	help
	  The debug set of files for versions Zero/1/2/3.

config BR2_PACKAGE_RPI_FIRMWARE_VARIANT_PI4
	bool "rpi 4 (default)"
	help
	  The default set of files for versions 4 (standard GPU
	  features).

config BR2_PACKAGE_RPI_FIRMWARE_VARIANT_PI4_X
	bool "rpi 4 (extended)"
	help
	  The extended set of files for versions 4 (additional GPU
	  features, eg. more audio/video codecs).

config BR2_PACKAGE_RPI_FIRMWARE_VARIANT_PI4_CD
	bool "rpi 4 (cut-down)"
	help
	  The cut-down set of files for versions 4 (only features
	  required to boot a Linux kernel).

config BR2_PACKAGE_RPI_FIRMWARE_VARIANT_PI4_DB
	bool "rpi 4 (debug)"
	help
	  The debug set of files for versions 4.

config BR2_PACKAGE_RPI_FIRMWARE_CONFIG_FILE
	string "Path to a file stored as boot/config.txt"
	help
	  Path to a file stored as config.txt in the boot partition
	  of the generated SD card image.

config BR2_PACKAGE_RPI_FIRMWARE_CMDLINE_FILE
	string "Path to a file stored as boot/cmdline.txt"
	default "board/raspberrypi/cmdline.txt"  # legacy
	help
	  Path to a file stored as cmdline.txt in the boot partition
	  of the generated SD card image.

config BR2_PACKAGE_RPI_FIRMWARE_INSTALL_DTBS
	bool "Install Device Tree Blobs (DTBs)"
	default y
	depends on !BR2_LINUX_KERNEL_DTS_SUPPORT
	help
	  If you are using a Linux kernel <= 3.18, you should say 'y'
	  here.

	  If you are using a Linux kernel >= 3.19, you should say 'n'
	  here, and enable BR2_LINUX_KERNEL_DTS_SUPPORT to let the
	  kernel build the DTB.

config BR2_PACKAGE_RPI_FIRMWARE_INSTALL_DTB_OVERLAYS
	bool "Install DTB overlays"
	default y
	depends on BR2_PACKAGE_RPI_FIRMWARE_INSTALL_DTBS \
		|| BR2_LINUX_KERNEL_DTS_SUPPORT
	select BR2_LINUX_KERNEL_DTB_OVERLAY_SUPPORT \
		if BR2_LINUX_KERNEL_DTS_SUPPORT
	help
	  Say 'y' here if you need to load one or more of the DTB
	  overlays, to support HATs (Hardware Attached on Top, add-on
	  modules).

config BR2_PACKAGE_RPI_FIRMWARE_INSTALL_VCDBG
	bool "vcdbg"
	depends on BR2_arm # prebuilt arm binary, rpi-userland
	depends on BR2_TOOLCHAIN_USES_GLIBC
	depends on BR2_INSTALL_LIBSTDCPP # rpi-userland
	help
	  Install vcdbg, to help debug communication with the GPU.

comment "vcdbg needs a glibc toolchain w/ C++"
	depends on BR2_arm
	depends on !BR2_TOOLCHAIN_USES_GLIBC || !BR2_INSTALL_LIBSTDCPP

endif # BR2_PACKAGE_RPI_FIRMWARE
```

## package/rpi-rgb-led-matrix/Config.in
```kconfig
config BR2_PACKAGE_RPI_RGB_LED_MATRIX
	bool "rpi-rgb-led-matrix"
	depends on BR2_aarch64 || BR2_arm
	depends on BR2_INSTALL_LIBSTDCPP
	depends on BR2_TOOLCHAIN_HAS_THREADS
	depends on !BR2_STATIC_LIBS
	help
	  A library to control commonly available 64x64, 32x32 or 16x32
	  RGB LED panels with the Raspberry Pi. Can support PWM up to
	  11Bit per channel, providing true 24bpp color with CIE1931
	  profile.

	  https://github.com/hzeller/rpi-rgb-led-matrix

if BR2_PACKAGE_RPI_RGB_LED_MATRIX

config BR2_PACKAGE_RPI_RGB_LED_MATRIX_IMAGE_VIEWER
	bool "Build led-image-viewer"
	select BR2_PACKAGE_GRAPHICSMAGICK
	help
	  The image viewer reads all kinds of image formats,
	  including animated gifs.

config BR2_PACKAGE_RPI_RGB_LED_MATRIX_TEXT_SCROLLER
	bool "Build text-scroller"
	help
	  The text scroller allows to show some scrolling text.

config BR2_PACKAGE_RPI_RGB_LED_MATRIX_VIDEO_VIEWER
	bool "Build video-viewer"
	select BR2_PACKAGE_FFMPEG
	select BR2_PACKAGE_FFMPEG_SWSCALE
	help
	  The video viewer allows to play common video formats
	  on the RGB matrix (just the picture, no sound).

endif

comment "rpi-rgb-led-matrix needs a toolchain w/ C++, threads, dynamic library"
	depends on BR2_aarch64 || BR2_arm
	depends on !BR2_INSTALL_LIBSTDCPP || \
		!BR2_TOOLCHAIN_HAS_THREADS || \
		BR2_STATIC_LIBS
```

## package/rpi-wifi-firmware/Config.in
```kconfig
config BR2_PACKAGE_RPI_WIFI_FIRMWARE
	bool "rpi-wifi-firmware"
	depends on BR2_arm || BR2_aarch64
	help
	  This package provides the wifi firmware for the Raspberry Pi
```

## package/rpi3plus-bt-firmware/Config.in
```kconfig
config BR2_PACKAGE_RPI3PLUS_BT_FIRMWARE
	bool "rpi3plus-bt-firmware"
	depends on BR2_arm || BR2_aarch64
	help
	  Raspberry Pi 3+ Broadcom BCM4345C0 Bluetooth module
	  firmware.

	  https://github.com/RPi-Distro/bluez-firmware
```

## package/rpm/Config.in
```kconfig
comment "rpm needs a toolchain w/ dynamic library, threads and lua >= 5.3"
	depends on !BR2_TOOLCHAIN_HAS_THREADS || BR2_STATIC_LIBS \
		|| !BR2_PACKAGE_LUA_5_3
	depends on BR2_PACKAGE_BUSYBOX_SHOW_OTHERS
	depends on BR2_USE_MMU

config BR2_PACKAGE_RPM
	bool "rpm"
	depends on !BR2_STATIC_LIBS # dlfcn.h
	depends on BR2_PACKAGE_BUSYBOX_SHOW_OTHERS
	depends on BR2_PACKAGE_LUA_5_3
	depends on BR2_TOOLCHAIN_HAS_THREADS
	depends on BR2_USE_MMU # fork()
	select BR2_PACKAGE_LIBGCRYPT if !BR2_PACKAGE_OPENSSL
	select BR2_PACKAGE_FILE
	select BR2_PACKAGE_POPT
	select BR2_PACKAGE_ZLIB
	help
	  The RPM Package Manager (RPM).

	  http://www.rpm.org/

if BR2_PACKAGE_RPM

comment "rpm2archive support needs a toolchain w/ wchar"
	depends on !BR2_USE_WCHAR

config BR2_PACKAGE_RPM_RPM2ARCHIVE
	bool "rpm2archive command"
	default y
	depends on BR2_USE_WCHAR
	select BR2_PACKAGE_LIBARCHIVE
	help
	  Enable rpm2archive

endif
```

## package/rsyslog/Config.in
```kconfig
config BR2_PACKAGE_RSYSLOG
	bool "rsyslog"
	depends on BR2_TOOLCHAIN_HAS_THREADS
	depends on BR2_USE_MMU # fork()
	depends on !BR2_STATIC_LIBS # modules
	# Propagate the exact same dependency from libfastjson,
	# even though rsyslog already depends on threads for itself:
	depends on BR2_TOOLCHAIN_HAS_SYNC_4 || BR2_TOOLCHAIN_HAS_THREADS
	depends on BR2_PACKAGE_BUSYBOX_SHOW_OTHERS
	select BR2_PACKAGE_APR_UTIL if BR2_PACKAGE_CIVETWEB_LIB
	select BR2_PACKAGE_ZLIB
	select BR2_PACKAGE_LIBESTR
	select BR2_PACKAGE_LIBLOGGING
	select BR2_PACKAGE_LIBFASTJSON
	help
	  Rsyslog is a powerful and flexible syslog implementation

	  http://www.rsyslog.com

if BR2_PACKAGE_RSYSLOG

config BR2_PACKAGE_RSYSLOG_EXTRA_PLUGINS
	bool "extra plugins"
	default y
	help
	  Enable rsyslog plugins that require external
	  dependencies. The different plugins will be automatically
	  enabled if their dependencies are enabled.

endif # BR2_PACKAGE_RSYSLOG

comment "rsyslog needs a toolchain w/ threads, dynamic library"
	depends on BR2_USE_MMU
	depends on BR2_TOOLCHAIN_HAS_SYNC_4
	depends on !BR2_TOOLCHAIN_HAS_THREADS || BR2_STATIC_LIBS
	depends on BR2_PACKAGE_BUSYBOX_SHOW_OTHERS
```

## package/rtl8188eu/Config.in
```kconfig
config BR2_PACKAGE_RTL8188EU
	bool "rtl8188eu"
	depends on !BR2_s390x
	depends on BR2_LINUX_KERNEL
	help
	  A standalone driver for the RTL8188EU USB Wi-Fi adapter.

	  https://github.com/benetti-engineering/rtl8188eu

comment "rtl8188eu needs a Linux kernel to be built"
	depends on !BR2_s390x
	depends on !BR2_LINUX_KERNEL
```

## package/rtl8189es/Config.in
```kconfig
config BR2_PACKAGE_RTL8189ES
	bool "rtl8189es"
	depends on BR2_LINUX_KERNEL
	help
	  Wireless driver rtl8189es.

	  https://github.com/jwrdegoede/rtl8189ES_linux.git

comment "rtl8189es needs a Linux kernel to be built"
	depends on !BR2_LINUX_KERNEL
```

## package/rtl8192eu/Config.in
```kconfig
config BR2_PACKAGE_RTL8192EU
	bool "rtl8192eu"
	depends on BR2_LINUX_KERNEL
	help
	  A standalone driver for the RTL8192EU USB Wi-Fi adapter.

	  Make sure your target kernel has the CONFIG_WIRELESS_EXT
	  config option enabled.

	  https://github.com/clnhub/rtl8192eu-linux

comment "rtl8192eu needs a Linux kernel to be built"
	depends on !BR2_LINUX_KERNEL
```

## package/rtl8723bu/Config.in
```kconfig
config BR2_PACKAGE_RTL8723BU
	bool "rtl8723bu"
	depends on !BR2_s390x
	depends on BR2_LINUX_KERNEL
	help
	  rtl8723bu wifi driver

	  https://github.com/benetti-engineering-sas/rtl8723bu

comment "rtl8723bu needs a Linux kernel to be built"
	depends on !BR2_s390x
	depends on !BR2_LINUX_KERNEL
```

## package/rtl8723ds-bt/Config.in
```kconfig
config BR2_PACKAGE_RTL8723DS_BT
	bool "rtl8723ds-bt"
	help
	  rtl8723ds UART attached Bluetooth module firmware.

	  https://github.com/wsyco/RTL8723DS_BT_Linux
```

## package/rtl8723ds/Config.in
```kconfig
config BR2_PACKAGE_RTL8723DS
	bool "rtl8723ds"
	depends on !BR2_s390x
	depends on BR2_LINUX_KERNEL
	help
	  rtl8723bs wifi driver

	  https://github.com/benetti-engineering/rtl8723ds

comment "rtl8723ds needs a Linux kernel to be built"
	depends on !BR2_s390x
	depends on !BR2_LINUX_KERNEL
```

## package/rtl8812au-aircrack-ng/Config.in
```kconfig
comment "rtl8812au-aircrack-ng needs a Linux kernel to be built"
	depends on !BR2_LINUX_KERNEL

config BR2_PACKAGE_RTL8812AU_AIRCRACK_NG
	bool "rtl8812au-aircrack-ng"
	depends on BR2_LINUX_KERNEL
	help
	  rtl8812au wifi driver (aircrack-ng repository)

	  https://github.com/aircrack-ng/rtl8812au
```

## package/rtl8821cu/Config.in
```kconfig
comment "rtl8821cu needs a Linux kernel to be built"
	depends on !BR2_LINUX_KERNEL

config BR2_PACKAGE_RTL8821CU
	bool "rtl8821cu"
	depends on BR2_LINUX_KERNEL
	help
	  rtl8821cu wifi driver

	  https://github.com/brektrou/rtl8821CU
```

## package/rtl8822cs/Config.in
```kconfig
comment "rl8822cs needs a Linux kernel to be built"
	depends on !BR2_s390x
	depends on !BR2_LINUX_KERNEL

config BR2_PACKAGE_RTL8822CS
	bool "rtl8822cs"
	depends on !BR2_s390x
	depends on BR2_LINUX_KERNEL
	help
	  Realtek RTL8822CS Wi-Fi driver as a kernel module (JetHome
	  repository)

          https://github.com/jethome-ru/rtl88x2cs/
```

## package/rtl_433/Config.in
```kconfig
config BR2_PACKAGE_RTL_433
	bool "rtl_433"
	depends on BR2_USE_MMU # fork()
	depends on BR2_TOOLCHAIN_HAS_THREADS
	select BR2_PACKAGE_LIBOPENSSL_ENABLE_PSK if BR2_PACKAGE_LIBOPENSSL
	help
	  rtl_433 (despite the name) is a generic data receiver, mainly
	  for the 433.92 MHz, 868 MHz (SRD), 315 MHz, 345 MHz, and 915
	  MHz ISM bands.

	  https://github.com/merbanan/rtl_433

comment "rtl_433 needs a toolchain w/ threads"
	depends on BR2_USE_MMU
	depends on !BR2_TOOLCHAIN_HAS_THREADS
```

## package/rtmessage/Config.in
```kconfig
config BR2_PACKAGE_RTMESSAGE
    bool "RT Message"
    default n
    help
       RT Message library
```

## package/rtremote/Config.in
```kconfig
config BR2_PACKAGE_RTREMOTE
	bool "rtRemote"
	select BR2_PACKAGE_RTCORE
	help
	  rtRemote
```

## package/rtty/Config.in
```kconfig
config BR2_PACKAGE_RTTY
	bool "rtty"
	depends on BR2_USE_MMU # fork()
	select BR2_PACKAGE_LIBEV
	select BR2_PACKAGE_LIBXCRYPT if BR2_TOOLCHAIN_USES_GLIBC
	help
	  Access your device's terminal from anywhere via the web.

	  https://github.com/zhaojh329/rtty
```

## package/ruby/Config.in
```kconfig
config BR2_PACKAGE_RUBY
	bool "ruby"
	depends on BR2_USE_WCHAR
	depends on BR2_TOOLCHAIN_HAS_THREADS
	depends on !BR2_STATIC_LIBS
	depends on BR2_TOOLCHAIN_GCC_AT_LEAST_4_9
	depends on BR2_HOST_GCC_AT_LEAST_4_9
	help
	  Object Oriented Scripting Language.

	  http://www.ruby-lang.org/

comment "ruby needs a toolchain w/ wchar, threads, dynamic library, gcc >= 4.9, host gcc >= 4.9"
	depends on !BR2_USE_WCHAR || !BR2_TOOLCHAIN_HAS_THREADS || \
		BR2_STATIC_LIBS || !BR2_TOOLCHAIN_GCC_AT_LEAST_4_9 || \
		!BR2_HOST_GCC_AT_LEAST_4_9
```

## package/runc/Config.in.host
```kconfig
config BR2_PACKAGE_HOST_RUNC
	bool "host runc"
	depends on BR2_PACKAGE_HOST_GO_HOST_ARCH_SUPPORTS
	help
	  runC is a CLI tool for spawning and running containers
	  according to the OCI specification.

	  https://github.com/opencontainers/runc
```
