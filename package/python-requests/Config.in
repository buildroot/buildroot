## package/python-requests/Config.in
```kconfig
config BR2_PACKAGE_PYTHON_REQUESTS
	bool "python-requests"
	select BR2_PACKAGE_PYTHON_CERTIFI # runtime
	select BR2_PACKAGE_PYTHON_CHARSET_NORMALIZER # runtime
	select BR2_PACKAGE_PYTHON_IDNA # runtime
	select BR2_PACKAGE_PYTHON_URLLIB3 # runtime
	select BR2_PACKAGE_PYTHON3_SSL # runtime
	select BR2_PACKAGE_PYTHON3_ZLIB # runtime
	help
	  Requests is an Apache2 Licensed HTTP library, written in
	  Python, for human beings.

	  http://www.python-requests.org/
```

## package/python-rfc3987/Config.in
```kconfig
config BR2_PACKAGE_PYTHON_RFC3987
	bool "python-rfc3987"
	help
	  Parsing and validation of URIs (RFC 3986) and IRIs (RFC
	  3987).

	  http://pypi.python.org/pypi/rfc3987
```

## package/python-rgbmatrix/Config.in
```kconfig
config BR2_PACKAGE_PYTHON_RGBMATRIX
	bool "python-rgbmatrix"
	depends on BR2_aarch64 || BR2_arm  # rpi-rgb-led-matrix
	depends on BR2_INSTALL_LIBSTDCPP  # rpi-rgb-led-matrix
	depends on BR2_TOOLCHAIN_HAS_THREADS  # rpi-rgb-led-matrix
	depends on !BR2_STATIC_LIBS  # rpi-rgb-led-matrix
	select BR2_PACKAGE_HOST_PYTHON_CYTHON
	select BR2_PACKAGE_RPI_RGB_LED_MATRIX

comment "python-rgbmatrix needs a toolchain w/ C++, threads, dynamic libraries"
	depends on BR2_aarch64 || BR2_arm
	depends on !BR2_INSTALL_LIBSTDCPP \
		|| !BR2_TOOLCHAIN_HAS_THREADS \
		|| BR2_STATIC_LIBS
```

## package/python-rich/Config.in
```kconfig
config BR2_PACKAGE_PYTHON_RICH
	bool "python-rich"
	select BR2_PACKAGE_PYTHON3_ZLIB
	select BR2_PACKAGE_PYTHON_MARKDOWN_IT_PY # runtime
	select BR2_PACKAGE_PYTHON_PYGMENTS # runtime
	help
	  Render rich text, tables, progress bars, syntax
	  highlighting, markdown and more to the terminal.

	  https://github.com/Textualize/rich
```

## package/python-rpds-py/Config.in
```kconfig
config BR2_PACKAGE_PYTHON_RPDS_PY
	bool "python-rpds-py"
	depends on BR2_PACKAGE_HOST_RUSTC_TARGET_ARCH_SUPPORTS
	help
	  Python bindings to the Rust rpds crate for persistent
	  data structures.

	  https://github.com/crate-py/rpds
```

## package/python-rpi-gpio/Config.in
```kconfig
config BR2_PACKAGE_PYTHON_RPI_GPIO
	bool "python-rpi-gpio"
	depends on BR2_arm || BR2_aarch64
	help
	  A Python module to control the GPIO on a Raspberry Pi.

	  http://sourceforge.net/p/raspberry-gpio-python
```

## package/python-rsa/Config.in
```kconfig
config BR2_PACKAGE_PYTHON_RSA
	bool "python-rsa"
	depends on BR2_PACKAGE_PYTHON3
	select BR2_PACKAGE_PYTHON_PYASN1 # runtime
	help
	  Python-RSA is a pure-Python RSA implementation. It supports
	  encryption and decryption, signing and verifying signatures,
	  and key generation according to PKCS\#1 version 1.5. It can
	  be used as a Python library as well as on the command line.

	  https://stuvel.eu/rsa
```

## package/python-rtoml/Config.in
```kconfig
config BR2_PACKAGE_PYTHON_RTOML
	bool "python-rtoml"
	depends on BR2_PACKAGE_HOST_RUSTC_TARGET_ARCH_SUPPORTS
	help
	  A better TOML library for python implemented in rust.

	  https://github.com/samuelcolvin/rtoml
```

## package/python-ruamel-yaml-clib/Config.in
```kconfig
config BR2_PACKAGE_PYTHON_RUAMEL_YAML_CLIB
	bool "python-ruamel-yaml-clib"
	depends on BR2_PACKAGE_PYTHON_RUAMEL_YAML
	help
	  C version of reader, parser and emitter for ruamel.yaml
	  derived from libyaml

	  https://sourceforge.net/projects/ruamel-yaml/
```

## package/python-ruamel-yaml/Config.in
```kconfig
config BR2_PACKAGE_PYTHON_RUAMEL_YAML
	bool "python-ruamel-yaml"
	help
	  ruamel.yaml is a YAML parser/emitter that supports roundtrip
	  preservation of comments, seq/map flow style, and map key
	  order.

	  https://sourceforge.net/projects/ruamel-yaml/
```

## package/python-s3transfer/Config.in
```kconfig
config BR2_PACKAGE_PYTHON_S3TRANSFER
	bool "python-s3transfer"
	select BR2_PACKAGE_PYTHON_BOTOCORE # runtime
	help
	  An Amazon S3 Transfer Manager.

	  https://github.com/boto/s3transfer
```

## package/python-scapy/Config.in
```kconfig
config BR2_PACKAGE_PYTHON_SCAPY
	bool "python-scapy"
	select BR2_PACKAGE_PYTHON3_ZLIB
	help
	  Scapy: interactive packet manipulation tool.

	  http://www.secdev.org/projects/scapy
```

## package/python-schedule/Config.in
```kconfig
config BR2_PACKAGE_PYTHON_SCHEDULE
	bool "python-schedule"
	depends on BR2_PACKAGE_PYTHON3
	help
	  Job scheduling for humans.

	  https://github.com/dbader/schedule
```

## package/python-scipy/Config.in
```kconfig
config BR2_PACKAGE_PYTHON_SCIPY
	bool "python-scipy"
	depends on BR2_PACKAGE_PYTHON_NUMPY_ARCH_SUPPORTS # python-numpy
	depends on BR2_PACKAGE_LAPACK_ARCH_SUPPORTS # lapack
	depends on BR2_PACKAGE_OPENBLAS_ARCH_SUPPORTS # openblas
	depends on BR2_TOOLCHAIN_USES_GLIBC || BR2_TOOLCHAIN_USES_MUSL # python-numpy
	depends on BR2_TOOLCHAIN_GCC_AT_LEAST_9 # python-numpy
	depends on BR2_HOST_GCC_AT_LEAST_9 # host-python-numpy
	depends on BR2_TOOLCHAIN_HAS_FORTRAN # lapack
	depends on BR2_INSTALL_LIBSTDCPP
	select BR2_PACKAGE_LAPACK
	select BR2_PACKAGE_OPENBLAS
	select BR2_PACKAGE_PYTHON3_ZLIB # runtime scipy::io
	select BR2_PACKAGE_PYTHON_NUMPY # runtime
	select BR2_PACKAGE_PYTHON_PYBIND
	help
	  The SciPy library is one of the core packages that make up the
	  SciPy stack. It provides many user-friendly and efficient
	  numerical routines such as routines for numerical integration,
	  interpolation, optimization, linear algebra and statistics.

	  https://www.scipy.org/scipylib/

comment "python-scipy needs glibc or musl toolchain w/ fortran, c++, gcc >= 9, host gcc >= 9"
	depends on BR2_PACKAGE_PYTHON_NUMPY_ARCH_SUPPORTS
	depends on BR2_PACKAGE_LAPACK_ARCH_SUPPORTS
	depends on BR2_PACKAGE_OPENBLAS_ARCH_SUPPORTS
	depends on !BR2_TOOLCHAIN_HAS_FORTRAN || \
		!BR2_INSTALL_LIBSTDCPP || !BR2_HOST_GCC_AT_LEAST_9 || \
		!BR2_TOOLCHAIN_GCC_AT_LEAST_9 || \
		(!BR2_TOOLCHAIN_USES_GLIBC && !BR2_TOOLCHAIN_USES_MUSL)
```

## package/python-scp/Config.in
```kconfig
config BR2_PACKAGE_PYTHON_SCP
	bool "python-scp"
	depends on BR2_PACKAGE_HOST_RUSTC_TARGET_ARCH_SUPPORTS # python-paramiko -> python-cryptography, python-bcrypt
	select BR2_PACKAGE_PYTHON_PARAMIKO # runtime
	help
	  scp module for paramiko.

	  https://github.com/jbardin/scp.py
```

## package/python-sdbus-modemmanager/Config.in
```kconfig
config BR2_PACKAGE_PYTHON_SDBUS_MODEMMANAGER
	bool "python-sdbus-modemmanager"
	depends on BR2_PACKAGE_SYSTEMD
	depends on BR2_PACKAGE_MODEM_MANAGER # runtime
	select BR2_PACKAGE_PYTHON_SDBUS # runtime
	help
	  ModemManager bindings for sdbus.

	  https://github.com/zhanglongqi/python-sdbus-modemmanager

comment "python-sdbus-modemmanager needs systemd and modem-manager"
	depends on !BR2_PACKAGE_SYSTEMD || !BR2_PACKAGE_MODEM_MANAGER
```

## package/python-sdbus-networkmanager/Config.in
```kconfig
config BR2_PACKAGE_PYTHON_SDBUS_NETWORKMANAGER
	bool "python-sdbus-networkmanager"
	depends on BR2_PACKAGE_SYSTEMD
	depends on BR2_PACKAGE_NETWORK_MANAGER # runtime
	select BR2_PACKAGE_PYTHON_SDBUS # runtime
	help
	  NetworkManager bindings for sdbus.

	  https://github.com/igo95862/python-sdbus

comment "python-sdbus-networkmanager needs systemd and network-manager"
	depends on !BR2_PACKAGE_SYSTEMD || !BR2_PACKAGE_NETWORK_MANAGER
```

## package/python-sdbus-systemd/Config.in
```kconfig
config BR2_PACKAGE_PYTHON_SDBUS_SYSTEMD
	bool "python-sdbus-systemd"
	depends on BR2_PACKAGE_SYSTEMD
	select BR2_PACKAGE_PYTHON_SDBUS # runtime
	help
	  Systemd bindings for python-sdbus.

	  https://github.com/bernhardkaindl/python-sdbus-systemd

comment "python-sdbus-systemd needs systemd"
	depends on !BR2_PACKAGE_SYSTEMD
```

## package/python-sdbus/Config.in
```kconfig
config BR2_PACKAGE_PYTHON_SDBUS
	bool "python-sdbus"
	depends on BR2_PACKAGE_SYSTEMD # required to get sd-bus
	help
	  Modern Python D-Bus library. Based on sd-bus from
	  libsystemd.

	  https://github.com/python-sdbus/python-sdbus

comment "python-sdbus needs systemd"
	depends on !BR2_PACKAGE_SYSTEMD
```

## package/python-secretstorage/Config.in
```kconfig
config BR2_PACKAGE_PYTHON_SECRETSTORAGE
	bool "python-secretstorage"
	depends on BR2_PACKAGE_PYTHON3
	depends on BR2_PACKAGE_HOST_RUSTC_TARGET_ARCH_SUPPORTS # python-cryptography
	select BR2_PACKAGE_PYTHON_CRYPTOGRAPHY # runtime
	help
	  Python bindings to FreeDesktop.org Secret Service API.

	  https://github.com/mitya57/secretstorage
```

## package/python-segno/Config.in
```kconfig
config BR2_PACKAGE_PYTHON_SEGNO
	bool "python-segno"
	select BR2_PACKAGE_PYTHON3_PYEXPAT # runtime
	select BR2_PACKAGE_PYTHON3_ZLIB # runtime
	help
	  QR Code and Micro QR Code generator for Python.

	  https://github.com/heuer/segno/
```

## package/python-selenium/Config.in
```kconfig
config BR2_PACKAGE_PYTHON_SELENIUM
	bool "python-selenium"
	depends on BR2_PACKAGE_HOST_RUSTC_TARGET_ARCH_SUPPORTS
	select BR2_PACKAGE_PYTHON_CERTIFI # runtime
	select BR2_PACKAGE_PYTHON_PYSOCKS # runtime
	select BR2_PACKAGE_PYTHON_TRIO # runtime
	select BR2_PACKAGE_PYTHON_TRIO_WEBSOCKET # runtime
	select BR2_PACKAGE_PYTHON_TYPING_EXTENSIONS # runtime
	select BR2_PACKAGE_PYTHON_URLLIB3 # runtime
	select BR2_PACKAGE_PYTHON_WEBSOCKET_CLIENT # runtime
	help
	  Python language bindings for Selenium WebDriver.

	  https://www.selenium.dev
```

## package/python-semver/Config.in
```kconfig
config BR2_PACKAGE_PYTHON_SEMVER
	bool "python-semver"
	help
	  Python helper for Semantic Versioning (https://semver.org).

	  https://github.com/python-semver/python-semver
```

## package/python-serial-asyncio/Config.in
```kconfig
config BR2_PACKAGE_PYTHON_SERIAL_ASYNCIO
	bool "python-serial-asyncio"
	select BR2_PACKAGE_PYTHON_SERIAL
	help
	  asyncio extension package for pyserial.

	  https://github.com/pyserial/pyserial-asyncio
```

## package/python-service-identity/Config.in
```kconfig
config BR2_PACKAGE_PYTHON_SERVICE_IDENTITY
	bool "python-service-identity"
	depends on BR2_PACKAGE_HOST_RUSTC_TARGET_ARCH_SUPPORTS # python-cryptography
	select BR2_PACKAGE_PYTHON_ATTRS # runtime
	select BR2_PACKAGE_PYTHON_CRYPTOGRAPHY # runtime
	select BR2_PACKAGE_PYTHON_PYASN1 # runtime
	select BR2_PACKAGE_PYTHON_PYASN1_MODULES # runtime
	help
	  Service identity verification for pyOpenSSL.

	  https://pypi.python.org/pypi/service_identity
```
