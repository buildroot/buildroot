## package/kodi-pvr-waipu/Config.in
```kconfig
config BR2_PACKAGE_KODI_PVR_WAIPU
	bool "kodi-pvr-waipu"
	select BR2_PACKAGE_JSON_FOR_MODERN_CPP
	help
	  Waipu.tv PVR Plugin for Kodi

	  https://github.com/flubshi/pvr.waipu
```

## package/kodi-pvr-wmc/Config.in
```kconfig
config BR2_PACKAGE_KODI_PVR_WMC
	bool "kodi-pvr-wmc"
	help
	  Kodi's Windows Media Center client addon

	  https://github.com/kodi-pvr/pvr.wmc
```

## package/kodi-pvr-zattoo/Config.in
```kconfig
config BR2_PACKAGE_KODI_PVR_ZATTOO
	bool "kodi-pvr-zattoo"
	select BR2_PACKAGE_JSON_FOR_MODERN_CPP
	select BR2_PACKAGE_TINYXML2
	help
	  Kodi PVR-Addon for Zattoo

	  https://github.com/rbuehlma/pvr.zattoo
```

## package/kodi-screensaver-asterwave/Config.in
```kconfig
config BR2_PACKAGE_KODI_SCREENSAVER_ASTERWAVE
	bool "kodi-screensaver-asterwave"
	select BR2_PACKAGE_GLM
	help
	  AsterWave screensaver for Kodi

	  https://github.com/xbmc/screensaver.asterwave
```

## package/kodi-screensaver-biogenesis/Config.in
```kconfig
config BR2_PACKAGE_KODI_SCREENSAVER_BIOGENESIS
	bool "kodi-screensaver-biogenesis"
	help
	  BioGenesis screensaver for Kodi

	  https://github.com/xbmc/screensaver.biogenesis
```

## package/kodi-screensaver-cpblobs/Config.in
```kconfig
config BR2_PACKAGE_KODI_SCREENSAVER_CPBLOBS
	bool "kodi-screensaver-cpblobs"
	select BR2_PACKAGE_GLM
	help
	  CpBlobs screensaver for Kodi

	  https://github.com/xbmc/screensaver.cpblobs
```

## package/kodi-screensaver-greynetic/Config.in
```kconfig
config BR2_PACKAGE_KODI_SCREENSAVER_GREYNETIC
	bool "kodi-screensaver-greynetic"
	select BR2_PACKAGE_GLM
	help
	  Greynetic screensaver for Kodi

	  https://github.com/xbmc/screensaver.greynetic
```

## package/kodi-screensaver-matrixtrails/Config.in
```kconfig
config BR2_PACKAGE_KODI_SCREENSAVER_MATRIXTRAILS
	bool "kodi-screensaver-matrixtrails"
	help
	  Matrix trails screensaver for Kodi

	  https://github.com/xbmc/screensaver.matrixtrails
```

## package/kodi-screensaver-pingpong/Config.in
```kconfig
config BR2_PACKAGE_KODI_SCREENSAVER_PINGPONG
	bool "kodi-screensaver-pingpong"
	select BR2_PACKAGE_GLM
	help
	  Ping-pong screensaver for Kodi

	  https://github.com/xbmc/screensaver.pingpong
```

## package/kodi-screensaver-pyro/Config.in
```kconfig
config BR2_PACKAGE_KODI_SCREENSAVER_PYRO
	bool "kodi-screensaver-pyro"
	help
	  Pyro screensaver for Kodi

	  https://github.com/xbmc/screensaver.pyro
```

## package/kodi-screensaver-rsxs/Config.in
```kconfig
config BR2_PACKAGE_KODI_SCREENSAVER_RSXS
	bool "kodi-screensaver-rsxs"
	depends on BR2_PACKAGE_KODI_RENDER_SYSTEM_GL
	select BR2_PACKAGE_BZIP2
	help
	  RSXS screensaver add-ons for Kodi

	  https://github.com/xbmc/screensavers.rsxs

comment "kodi-screensaver-rsxs needs OpenGL as Kodi render system"
	depends on !BR2_PACKAGE_KODI_RENDER_SYSTEM_GL
```

## package/kodi-screensaver-stars/Config.in
```kconfig
config BR2_PACKAGE_KODI_SCREENSAVER_STARS
	bool "kodi-screensaver-stars"
	help
	  Starfield screensaver for Kodi

	  https://github.com/xbmc/screensaver.stars
```

## package/kodi-vfs-libarchive/Config.in
```kconfig
config BR2_PACKAGE_KODI_VFS_LIBARCHIVE
	bool "kodi-vfs-libarchive"
	select BR2_PACKAGE_BZIP2
	select BR2_PACKAGE_LIBARCHIVE
	select BR2_PACKAGE_LZ4
	select BR2_PACKAGE_LZO
	select BR2_PACKAGE_OPENSSL
	select BR2_PACKAGE_XZ
	select BR2_PACKAGE_ZLIB
	help
	  Libarchive VFS add-on for Kodi

	  https://github.com/xbmc/vfs.libarchive
```

## package/kodi-vfs-sftp/Config.in
```kconfig
config BR2_PACKAGE_KODI_VFS_SFTP
	bool "kodi-vfs-sftp"
	select BR2_PACKAGE_LIBSSH
	select BR2_PACKAGE_OPENSSL
	select BR2_PACKAGE_ZLIB
	help
	  SFTP VFS addon for Kodi

	  https://github.com/xbmc/vfs.sftp
```

## package/kodi-visualisation-fishbmc/Config.in
```kconfig
config BR2_PACKAGE_KODI_VISUALISATION_FISHBMC
	bool "kodi-visualisation-fishbmc"
	select BR2_PACKAGE_GLM
	help
	  Fische visualiser for Kodi

	  https://github.com/xbmc/visualization.fishbmc
```

## package/kodi-visualisation-matrix/Config.in
```kconfig
config BR2_PACKAGE_KODI_VISUALISATION_MATRIX
	bool "kodi-visualisation-matrix"
	select BR2_PACKAGE_GLM
	help
	  Matrix themed visualization addon for Kodi

	  https://github.com/xbmc/visualization.matrix
```

## package/kodi-visualisation-shadertoy/Config.in
```kconfig
config BR2_PACKAGE_KODI_VISUALISATION_SHADERTOY
	bool "kodi-visualisation-shadertoy"
	depends on BR2_TOOLCHAIN_GCC_AT_LEAST_4_7 # jsoncpp
	select BR2_PACKAGE_GLM
	select BR2_PACKAGE_JSONCPP
	help
	  Shadertoy visualiser for Kodi

	  https://github.com/notspiff/visualization.shadertoy

comment "kodi-visualisation-shadertoy needs a toolchain w/ gcc >= 4.7"
	depends on !BR2_TOOLCHAIN_GCC_AT_LEAST_4_7
```

## package/kodi-visualisation-spectrum/Config.in
```kconfig
config BR2_PACKAGE_KODI_VISUALISATION_SPECTRUM
	bool "kodi-visualisation-spectrum"
	select BR2_PACKAGE_GLM
	help
	  Spectrum visualiser for Kodi

	  https://github.com/notspiff/visualization.spectrum
```

## package/kodi-visualisation-waveform/Config.in
```kconfig
config BR2_PACKAGE_KODI_VISUALISATION_WAVEFORM
	bool "kodi-visualisation-waveform"
	select BR2_PACKAGE_GLM
	help
	  Waveform visualiser for Kodi

	  https://github.com/notspiff/visualization.waveform
```

## package/kpn-sdk/Config.in
```kconfig
config BR2_PACKAGE_KPN_SDK
	bool "kpn-sdk"
	depends on BR2_mipsel
	select BR2_PACKAGE_HAS_NEXUS
	select BR2_PACKAGE_HAS_LIBEGL
	select BR2_PACKAGE_HAS_LIBGLES
	help
	  Pre-compiled binaries for a platform

if BR2_PACKAGE_KPN_SDK

config BR2_PACKAGE_PROVIDES_NEXUS
	default "kpn-sdk"

config BR2_PACKAGE_PROVIDES_LIBEGL
	default "kpn-sdk"

config BR2_PACKAGE_PROVIDES_LIBGLES
	default "kpn-sdk"

endif
```

## package/ksmbd-tools/Config.in
```kconfig
config BR2_PACKAGE_KSMBD_TOOLS
	bool "ksmbd-tools"
	depends on BR2_USE_MMU # fork()
	depends on BR2_USE_WCHAR # libglib2
	depends on BR2_TOOLCHAIN_HAS_THREADS # libglib2, libnl
	select BR2_PACKAGE_LIBGLIB2
	select BR2_PACKAGE_LIBNL
	help
	  ksmbd kernel server userspace utilities.

	  https://github.com/cifsd-team/ksmbd-tools

comment "ksmbd-tools needs a toolchain w/ wchar, threads"
	depends on BR2_USE_MMU
	depends on !BR2_USE_WCHAR || !BR2_TOOLCHAIN_HAS_THREADS
```

## package/kylin-drivers/Config.in
```kconfig
# Kylin drivers
menuconfig BR2_PACKAGE_KYLIN_DRIVERS
	bool "kylin kernel drivers"
	help
	  kylin kernel drivers

if BR2_PACKAGE_KYLIN_DRIVERS
    source "package/kylin-mali/Config.in"
endif
```

## package/kylin-graphics/Config.in
```kconfig
#kylin mali graphics libraies
config BR2_PACKAGE_KYLIN_GRAPHICS
	bool "mali graphics libraries"
	select BR2_PACKAGE_WAYLAND
	select BR2_PACKAGE_HAS_LIBEGL
	select BR2_PACKAGE_HAS_LIBEGL_WAYLAND
	select BR2_PACKAGE_HAS_LIBGLES
	help
         EGL/GLESv2 support for kylin mali videodriver

config BR2_PACKAGE_PROVIDES_LIBEGL
	default "kylin-graphics"
	
config BR2_PACKAGE_PROVIDES_LIBGLES
	default "kylin-graphics"
```

## package/kylin/Config.in
```kconfig
source "package/kylin/kylin-mali/Config.in"
source "package/kylin/kylin-graphics/Config.in"
source "package/kylin/kylin-platform-lib/Config.in"
```

## package/kylin/kylin-graphics/Config.in
```kconfig
config BR2_PACKAGE_KYLIN_GRAPHICS
	bool "mali graphics libraries"
	select BR2_PACKAGE_WAYLAND
	select BR2_PACKAGE_HAS_LIBEGL
	select BR2_PACKAGE_HAS_LIBEGL_WAYLAND
	select BR2_PACKAGE_HAS_LIBGLES
	help
         EGL/GLESv2 support for kylin mali videodriver

if BR2_PACKAGE_KYLIN_GRAPHICS

config BR2_PACKAGE_PROVIDES_LIBEGL
	default "kylin-graphics"
	
config BR2_PACKAGE_PROVIDES_LIBGLES
	default "kylin-graphics"

endif
```
