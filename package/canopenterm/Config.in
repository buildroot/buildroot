## package/canopenterm/Config.in
```kconfig
config BR2_PACKAGE_CANOPENTERM
	bool "canopenterm"
	depends on BR2_PACKAGE_SDL3_ARCH_SUPPORTS # sdl3
	depends on BR2_INSTALL_LIBSTDCPP # pocketpy
	depends on BR2_PACKAGE_LUA
	depends on BR2_TOOLCHAIN_HAS_THREADS # sdl3
	depends on BR2_USE_WCHAR # sdl3
	depends on !BR2_STATIC_LIBS # canvenient, isocline, pocketpy, sdl3
	select BR2_PACKAGE_CANVENIENT
	select BR2_PACKAGE_CJSON
	select BR2_PACKAGE_INIH
	select BR2_PACKAGE_ISOCLINE
	select BR2_PACKAGE_POCKETPY
	select BR2_PACKAGE_READLINE
	select BR2_PACKAGE_SDL3
	help
	  CANopenTerm is an open-source tool for developing,
	  testing, and analyzing CANopen CC networks and
	  devices.

	  https://github.com/CANopenTerm/CANopenTerm

comment "canopenterm needs a toolchain w/ C++, threads, wchar, dynamic library"
	depends on BR2_PACKAGE_SDL3_ARCH_SUPPORTS
	depends on BR2_PACKAGE_LUA
	depends on !BR2_INSTALL_LIBSTDCPP || !BR2_TOOLCHAIN_HAS_THREADS \
		|| !BR2_USE_WCHAR || BR2_STATIC_LIBS
```

## package/canvenient/Config.in
```kconfig
config BR2_PACKAGE_CANVENIENT
	bool "canvenient"
	depends on !BR2_STATIC_LIBS
	select BR2_PACKAGE_LIBSOCKETCAN
	help
	  CANvenient is a portable CAN abstraction library
	  supporting several driver backends. On Linux it is
	  implemented on top of SocketCAN.

	  https://github.com/CANopenTerm/CANvenient

comment "canvenient needs a toolchain w/ dynamic library"
	depends on BR2_STATIC_LIBS
```

## package/cgroupfs-v2-mount/Config.in
```kconfig
config BR2_PACKAGE_CGROUPFS_V2_MOUNT
	bool "cgroupfs-v2-mount"
	depends on !BR2_INIT_SYSTEMD
	depends on !BR2_PACKAGE_CGROUPFS_MOUNT
	help
	  Mount the cgroup v2 hierarchy filesystem.

	  To use non-default mount options, set MOUNT_OPTS in
	  /etc/default/cgroupfs2. If set, the value will be passed to
	  the -o option of the mount command.

comment "cgroupfs-v2-mount is incompatible with cgroupfs-mount"
	depends on !BR2_INIT_SYSTEMD
	depends on BR2_PACKAGE_CGROUPFS_MOUNT
```

## package/freescale-imx/mali-imx/Config.in
```kconfig
comment "mali-imx needs an i.MX platform with a Mali GPU"
	depends on !BR2_PACKAGE_FREESCALE_IMX_HAS_MALI_GPU

comment "mali-imx needs a glibc toolchain with C++"
	depends on BR2_aarch64
	depends on BR2_PACKAGE_FREESCALE_IMX_HAS_MALI_GPU
	depends on !BR2_TOOLCHAIN_USES_GLIBC || !BR2_INSTALL_LIBSTDCPP

config BR2_PACKAGE_MALI_IMX
	bool "mali-imx"
	depends on BR2_aarch64
	depends on BR2_PACKAGE_FREESCALE_IMX_HAS_MALI_GPU
	# Library binaries are linked against libc.so.6
	depends on BR2_TOOLCHAIN_USES_GLIBC
	# Library binaries are linked against libstdc++.so.6
	depends on BR2_INSTALL_LIBSTDCPP
	select BR2_PACKAGE_HAS_LIBEGL
	select BR2_PACKAGE_HAS_LIBGLES
	select BR2_PACKAGE_HAS_LIBOPENCL
	select BR2_PACKAGE_HAS_LIBGBM
	select BR2_PACKAGE_LIBGBM_HAS_FEATURE_DMA_BUF
	select BR2_PACKAGE_LIBGBM_HAS_FEATURE_FORMAT_MODIFIER_PLANE_COUNT
	select BR2_PACKAGE_LIBDRM
	select BR2_PACKAGE_WAYLAND
	help
	  Userspace libraries and firmware for Mali GPU on
	  i.MX95 platforms.

	  This library is provided by Freescale as-is and
	  doesn't have an upstream.

if BR2_PACKAGE_MALI_IMX

config BR2_PACKAGE_PROVIDES_LIBGBM
	default "mali-imx"

config BR2_PACKAGE_PROVIDES_LIBEGL
	default "mali-imx"

config BR2_PACKAGE_PROVIDES_LIBGLES
	default "mali-imx"

config BR2_PACKAGE_PROVIDES_LIBOPENCL
	default "mali-imx"

config BR2_PACKAGE_MALI_IMX_COMPILERS
	bool "install Mali offline compilers"
	help
	  Copy the Mali Shader offline compiler and the
	  Mali OpenCL offline compiler to the target.

	  Warning: compilers take approximately 100 MB of
	  disk space.

endif
```

## package/grout/Config.in
```kconfig
config BR2_PACKAGE_GROUT
	bool "grout"
	depends on BR2_PACKAGE_DPDK_ARCH_SUPPORTS # dpdk
	depends on BR2_TOOLCHAIN_HAS_THREADS # dpdk
	depends on BR2_USE_MMU # dpdk, numactl, libecoli
	depends on BR2_TOOLCHAIN_GCC_AT_LEAST_13 # C23 enum underlying types
	depends on BR2_TOOLCHAIN_HEADERS_AT_LEAST_4_19 # dpdk
	depends on BR2_TOOLCHAIN_USES_GLIBC # dpdk
	depends on BR2_TOOLCHAIN_HAS_ATOMIC # numactl
	depends on !BR2_STATIC_LIBS # libecoli
	depends on BR2_USE_WCHAR # libecoli
	select BR2_PACKAGE_DPDK
	select BR2_PACKAGE_LIBEVENT
	select BR2_PACKAGE_NUMACTL
	select BR2_PACKAGE_LIBECOLI
	select BR2_PACKAGE_LIBMNL
	select BR2_PACKAGE_LIBPCAP
	help
	  Graph router based on DPDK

if BR2_PACKAGE_GROUT

config BR2_PACKAGE_GROUT_GRTCPDUMP
	bool "grtcpdump"
	select BR2_PACKAGE_BASH # runtime
	select BR2_PACKAGE_BUSYBOX_SHOW_OTHERS # bash
	select BR2_PACKAGE_JQ # runtime
	select BR2_PACKAGE_TCPDUMP # runtime
	help
	  Install grtcpdump, a tcpdump wrapper for grout
	  interfaces. It needs bash, jq and tcpdump at runtime.

endif

comment "grout needs a glibc toolchain w/ dynamic library, threads, wchar, gcc >= 13, headers >= 4.19"
	depends on BR2_USE_MMU
	depends on BR2_PACKAGE_DPDK_ARCH_SUPPORTS
	depends on BR2_TOOLCHAIN_HAS_ATOMIC
	depends on !BR2_TOOLCHAIN_HAS_THREADS || \
		!BR2_TOOLCHAIN_USES_GLIBC || \
		!BR2_TOOLCHAIN_GCC_AT_LEAST_13 || \
		!BR2_TOOLCHAIN_HEADERS_AT_LEAST_4_19
```

## package/isocline/Config.in
```kconfig
config BR2_PACKAGE_ISOCLINE
	bool "isocline"
	depends on !BR2_STATIC_LIBS
	help
	  Isocline is a pure C library that can be used as an
	  alternative to the GNU readline library. It provides
	  multi-line editing, history, completion and syntax
	  highlighting.

	  https://github.com/daanx/isocline

comment "isocline needs a toolchain w/ dynamic library"
	depends on BR2_STATIC_LIBS
```

## package/libliftoff/Config.in
```kconfig
config BR2_PACKAGE_LIBLIFTOFF
	bool "libliftoff"
	depends on !BR2_STATIC_LIBS # test/libdrm_mock shared library
	depends on BR2_TOOLCHAIN_HAS_THREADS # libdrm
	select BR2_PACKAGE_LIBDRM
	help
	  libliftoff eases the use of KMS planes from userspace.
	  Users create "virtual planes" called layers, set KMS
	  properties on them, and libliftoff picks hardware planes for
	  these layers if possible.

	  https://gitlab.freedesktop.org/emersion/libliftoff

comment "libliftoff needs a toolchain w/ threads, dynamic library"
	depends on !BR2_TOOLCHAIN_HAS_THREADS || BR2_STATIC_LIBS
```

## package/lpty/Config.in
```kconfig
config BR2_PACKAGE_LPTY
	bool "lpty"
	help
	  A simple facility for lua to control other programs via
	  PTYs.

	  https://www.tset.de/lpty/
```

## package/rtl8812au/Config.in
```kconfig
comment "rtl8812au needs a Linux kernel to be built"
	depends on !BR2_s390x
	depends on !BR2_LINUX_KERNEL

config BR2_PACKAGE_RTL8812AU
	bool "rtl8812au"
	depends on !BR2_s390x
	depends on BR2_LINUX_KERNEL
	help
	  Realtek RTL8812AU USB wifi driver, based on Realtek's
	  v5.13.6 (20210820) release.

	  https://github.com/cybersnow02/8812au-20210820
```

## package/zic/Config.in
```kconfig
config BR2_PACKAGE_ZIC
	bool "zic"
	help
	  timezone information compiler (zic)

	  https://www.iana.org/time-zones
```
