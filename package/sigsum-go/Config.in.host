## package/sigsum-go/Config.in.host
```kconfig
config BR2_PACKAGE_HOST_SIGSUM_GO
	bool "host sigsum-go"
	depends on BR2_PACKAGE_HOST_GO_HOST_ARCH_SUPPORTS
	select BR2_PACKAGE_HOST_GO
	help
	  Command-line utilities for interacting with Sigsum logs.

	  https://git.glasklar.is/sigsum/core/sigsum-go/
```

## package/simple-mail/Config.in
```kconfig
config BR2_PACKAGE_SIMPLE_MAIL
	bool "simple-mail"
	depends on BR2_PACKAGE_QT5 || BR2_PACKAGE_QT6
	select BR2_PACKAGE_QT5BASE_NETWORK if BR2_PACKAGE_QT5
	select BR2_PACKAGE_QT6BASE_NETWORK if BR2_PACKAGE_QT6
	select BR2_PACKAGE_OPENSSL
	help
	  An SMTP library written in C++ for Qt.

	  https://github.com/cutelyst/simple-mail
```

## package/sipeed-lpi4abin/Config.in
```kconfig
config BR2_PACKAGE_SIPEED_LPI4ABIN
	bool "sipeed-lpi4abin"
	depends on BR2_riscv
	help
	  This package provides TH1520 SoC binary blobs for
	  LicheePi 4A.

	  https://github.com/revyos/th1520-boot-firmware
```

## package/siproxd/Config.in
```kconfig
config BR2_PACKAGE_SIPROXD
	bool "siproxd"
	depends on BR2_USE_MMU # fork()
	depends on BR2_TOOLCHAIN_HAS_THREADS
	select BR2_PACKAGE_LIBOSIP2
	select BR2_PACKAGE_LIBTOOL
	select BR2_PACKAGE_SQLITE
	help
	  Siproxd is a proxy/masquerading daemon for SIP (Session
	  Initiation Protocol), which is used in IP telephony. It
	  handles registrations of SIP clients on a private IP network
	  and performs rewriting of the SIP message bodies to make SIP
	  connections work via a masquerading firewall (NAT). It allows
	  SIP software clients (like kphone, linphone) or SIP hardware
	  clients (Voice over IP phones which are SIP-compatible, such
	  as those from Cisco, Grandstream or Snom) to work behind an IP
	  masquerading firewall or NAT router.

	  http://siproxd.sourceforge.net/

comment "siproxd needs a toolchain w/ threads"
	depends on BR2_USE_MMU
	depends on !BR2_TOOLCHAIN_HAS_THREADS
```

## package/skopeo/Config.in
```kconfig
config BR2_PACKAGE_SKOPEO
	bool "skopeo"
	depends on BR2_PACKAGE_HOST_GO_TARGET_ARCH_SUPPORTS
	depends on BR2_PACKAGE_HOST_GO_TARGET_CGO_LINKING_SUPPORTS
	depends on BR2_USE_MMU  # btrfs-progs, libgpgme, lvm2
	depends on BR2_PACKAGE_LIBGPG_ERROR_ARCH_SUPPORTS  # libgpgme
	depends on BR2_TOOLCHAIN_HAS_THREADS_NPTL
	depends on !BR2_STATIC_LIBS  # lvm2
	select BR2_PACKAGE_HOST_GO
	select BR2_PACKAGE_BTRFS_PROGS
	select BR2_PACKAGE_CONTAINERS_IMAGE_CONFIG  # runtime
	select BR2_PACKAGE_LIBGPGME
	select BR2_PACKAGE_LVM2
	help
	  skopeo is a command line utility that performs various
	  operations on container images and image repositories.

	  https://github.com/containers/skopeo

comment "skopeo needs a toolchain w/ NPTL, sahred libs"
	depends on BR2_PACKAGE_HOST_GO_TARGET_ARCH_SUPPORTS
	depends on BR2_PACKAGE_HOST_GO_TARGET_CGO_LINKING_SUPPORTS
	depends on BR2_USE_MMU
	depends on BR2_PACKAGE_LIBGPG_ERROR_ARCH_SUPPORTS
	depends on !BR2_TOOLCHAIN_HAS_THREADS_NPTL \
		|| BR2_STATIC_LIBS
```

## package/skopeo/Config.in.host
```kconfig
config BR2_PACKAGE_HOST_SKOPEO
	bool "host skopeo"
	depends on BR2_PACKAGE_HOST_GO_HOST_ARCH_SUPPORTS
	depends on BR2_PACKAGE_HOST_GO_HOST_CGO_LINKING_SUPPORTS
	select BR2_PACKAGE_HOST_GO
	help
	  skopeo is a command line utility that performs various
	  operations on container images and image repositories.

	  https://github.com/containers/skopeo
```

## package/slang/Config.in
```kconfig
config BR2_PACKAGE_SLANG
	bool "slang"
	depends on BR2_USE_MMU # fork()
	help
	  Multi-platform console display library.

	  http://www.jedsoft.org/slang/index.html

if BR2_PACKAGE_SLANG

config BR2_PACKAGE_SLANG_SLSH
	bool "enable slsh"
	help
	  Enable the S-lang interpreter

endif
```

## package/slirp4netns/Config.in
```kconfig
config BR2_PACKAGE_SLIRP4NETNS
	bool "slirp4netns"
	depends on BR2_USE_MMU # libcap, libglib2, slirp
	depends on BR2_USE_WCHAR # libglib2, slirp
	depends on BR2_TOOLCHAIN_HAS_THREADS # libglib2, slirp
	depends on BR2_PACKAGE_LIBSECCOMP_ARCH_SUPPORTS # libseccomp
	depends on BR2_TOOLCHAIN_HEADERS_AT_LEAST_3_17 # libseccomp
	select BR2_PACKAGE_LIBCAP
	select BR2_PACKAGE_LIBGLIB2
	select BR2_PACKAGE_LIBSECCOMP
	select BR2_PACKAGE_SLIRP
	help
	  User-mode networking for unprivileged network namespaces.

	  https://github.com/rootless-containers/slirp4netns

comment "slirp4netns needs a toolchain w/ wchar, threads, headers >= 3.17"
	depends on BR2_USE_MMU
	depends on BR2_PACKAGE_LIBSECCOMP_ARCH_SUPPORTS
	depends on !BR2_USE_WCHAR || !BR2_TOOLCHAIN_HAS_THREADS || !BR2_TOOLCHAIN_HEADERS_AT_LEAST_3_17
```

## package/sloci-image/Config.in.host
```kconfig
config BR2_PACKAGE_HOST_SLOCI_IMAGE
	bool "host sloci-image"
	help
	  A simple CLI tool for packing rootfs into a single-layer OCI
	  image.

	  https://github.com/jirutka/sloci-image
```

## package/snagboot/Config.in.host
```kconfig
config BR2_PACKAGE_HOST_SNAGBOOT
	bool "host snagboot"
	help
	  Snagboot intends to be an open-source and generic
	  replacement to the vendor-specific, sometimes proprietary,
	  tools used to recover and/or reflash embedded platforms.

	  https://github.com/bootlin/snagboot/
```

## package/snooze/Config.in
```kconfig
config BR2_PACKAGE_SNOOZE
	bool "snooze"
	help
	  snooze is a tool for waiting until a particular time and then
	  running a command. Together with a service supervision system
	  such as runit, this can be used to replace cron(8).

	  https://github.com/leahneukirchen/snooze
```

## package/snort3/Config.in
```kconfig
config BR2_PACKAGE_SNORT3
	bool "snort3"
	depends on BR2_PACKAGE_LUAJIT_ARCH_SUPPORTS # luajit
	depends on !(BR2_PACKAGE_DAQ || BR2_PACKAGE_SNORT)
	depends on BR2_USE_MMU # fork()
	depends on BR2_INSTALL_LIBSTDCPP
	depends on !BR2_STATIC_LIBS # daq3
	depends on BR2_TOOLCHAIN_GCC_AT_LEAST_4_9 # C++11
	depends on BR2_TOOLCHAIN_HAS_THREADS # hwloc
	depends on BR2_USE_WCHAR
	select BR2_PACKAGE_DAQ3
	select BR2_PACKAGE_FLEX
	select BR2_PACKAGE_HWLOC
	select BR2_PACKAGE_LIBDNET
	select BR2_PACKAGE_LIBPCAP
	select BR2_PACKAGE_LUAJIT
	select BR2_PACKAGE_PCRE
	select BR2_PACKAGE_LIBTIRPC if !BR2_TOOLCHAIN_HAS_NATIVE_RPC
	select BR2_PACKAGE_OPENSSL
	select BR2_PACKAGE_ZLIB
	help
	  Snort 3 is the next generation Snort IPS (Intrusion
	  Prevention System).

	  - Support multiple packet processing threads
	  - Shared configuration and attribute table
	  - Use a simple, scriptable configuration
	  - Make key components pluggable
	  - Autodetect services for portless configuration
	  - Support sticky buffers in rules
	  - Autogenerate reference documentation
	  - Provide better cross platform support

	  https://www.snort.org/snort3

comment "snort3 needs a toolchain w/ C++, wchar, threads, dynamic library, gcc >= 4.9"
	depends on BR2_PACKAGE_LUAJIT_ARCH_SUPPORTS
	depends on !(BR2_PACKAGE_DAQ || BR2_PACKAGE_SNORT)
	depends on BR2_USE_MMU
	depends on !BR2_INSTALL_LIBSTDCPP || !BR2_USE_WCHAR || \
		BR2_STATIC_LIBS || !BR2_TOOLCHAIN_HAS_THREADS || \
		!BR2_TOOLCHAIN_GCC_AT_LEAST_4_9
```

## package/soapy-sdr/Config.in
```kconfig
comment "SoapySDR needs a toolchain w/ C++, threads, dynamic library"
	depends on !BR2_INSTALL_LIBSTDCPP || !BR2_TOOLCHAIN_HAS_THREADS || \
		BR2_STATIC_LIBS

config BR2_PACKAGE_SOAPY_SDR
	bool "SoapySDR"
	depends on !BR2_STATIC_LIBS
	depends on BR2_INSTALL_LIBSTDCPP
	depends on BR2_TOOLCHAIN_HAS_THREADS
	help
	  Soapy SDR - vendor and platform neutral SDR support library.

	  https://github.com/pothosware/SoapySDR/wiki

if BR2_PACKAGE_SOAPY_SDR

config BR2_PACKAGE_SOAPY_SDR_APPS
	bool "apps support"
	help
	  Enable apps

config BR2_PACKAGE_SOAPY_SDR_PYTHON
	bool "python support"
	depends on BR2_PACKAGE_PYTHON3
	help
	  Enable python binding
endif
```

## package/softhsm2/Config.in
```kconfig
config BR2_PACKAGE_SOFTHSM2
	bool "softhsm2"
	depends on BR2_INSTALL_LIBSTDCPP
	depends on BR2_TOOLCHAIN_GCC_AT_LEAST_4_8 # C++11
	depends on BR2_TOOLCHAIN_HAS_THREADS
	depends on !BR2_STATIC_LIBS # dlopen()
	select BR2_PACKAGE_OPENSSL
	select BR2_PACKAGE_OPENSSL_FORCE_LIBOPENSSL
	select BR2_PACKAGE_LIBOPENSSL_ENABLE_DES
	help
	  SoftHSM is an implementation of a cryptographic store
	  accessible through a PKCS#11 interface. You can use it
	  to explore PKCS#11 without having a Hardware Security
	  Module.

	  https://www.opendnssec.org/softhsm

comment "softhsm2 needs a toolchain w/ C++, threads, gcc >= 4.8 and dynamic library support"
	depends on !BR2_INSTALL_LIBSTDCPP || BR2_STATIC_LIBS || \
		!BR2_TOOLCHAIN_HAS_THREADS || \
		!BR2_TOOLCHAIN_GCC_AT_LEAST_4_8
```

## package/sord/Config.in
```kconfig
config BR2_PACKAGE_SORD
	bool "sord"
	select BR2_PACKAGE_SERD
	select BR2_PACKAGE_ZIX
	help
	  Sord is a lightweight C library for storing RDF data in
	  memory.

	  https://drobilla.net/software/sord.html
```

## package/spandsp/Config.in
```kconfig
config BR2_PACKAGE_SPANDSP
	bool "spandsp"
	select BR2_PACKAGE_TIFF
	help
	  Spandsp is a library of many DSP functions for telephony.
	  These range from simple modules, such as DTMF detection, to
	  a complete software FAX machine.

	  https://github.com/freeswitch/spandsp
```

## package/spark/Config.in
```kconfig
config BR2_PACKAGE_SPARK
	bool "Spark"
	select BR2_PACKAGE_OPENSSL
	select BR2_PACKAGE_WESTEROS if !BR2_PACKAGE_WPEFRAMEWORK_COMPOSITOR
	select BR2_PACKAGE_UTIL_LINUX
	select BR2_PACKAGE_LIBPNG
	select BR2_PACKAGE_LIBCURL
	select BR2_PACKAGE_PXCORE_LIBNODE
	help
	  pxCore is a small open source library that provides a portable
	  framebuffer and windowing abstraction for C++

if BR2_PACKAGE_SPARK
  
  menu "Extra options"
  
  choice
          bool "Application type"
          default BR2_PACKAGE_SPARK_LIB
          help
            Choose application type.
  
  config BR2_PACKAGE_SPARK_APP
          bool "executable"
          help
            Create Spark standalone app.
  
  config BR2_PACKAGE_SPARK_LIB
          bool "library"
          help
            Create Spark library.
  
  endchoice

  endmenu
endif
```

## package/speechd/Config.in
```kconfig
config BR2_PACKAGE_SPEECHD
	bool "speechd"
	depends on BR2_USE_WCHAR # libglib2
	depends on BR2_TOOLCHAIN_HAS_THREADS # libglib2
	depends on BR2_USE_MMU # libglib2
	depends on !BR2_STATIC_LIBS
	select BR2_PACKAGE_DOTCONF
	select BR2_PACKAGE_LIBGLIB2
	select BR2_PACKAGE_LIBSNDFILE
	help
	  Speech Dispatcher project provides a high-level device
	  independent layer for access to speech synthesis through
	  a simple, stable and well documented interface.

	  https://freebsoft.org/speechd

comment "speechd needs a toolchain w/ wchar, threads, dynamic library"
	depends on BR2_USE_MMU
	depends on !BR2_USE_WCHAR || !BR2_TOOLCHAIN_HAS_THREADS || \
		BR2_STATIC_LIBS
```

## package/sphinxbase/Config.in
```kconfig
config BR2_PACKAGE_SPHINXBASE
        bool "sphinxbase"
        select BR2_PACKAGE_ALSA_LIB
        help
          sphnix is a speech recognizer software for English and
          other languages.

          http://cmusphinx.sourceforge.net/

#endif # BR2_PACKAGE_SPHINXBASE
```

## package/spice/Config.in
```kconfig
comment "spice server needs a toolchain w/ wchar, threads, C++, gcc >= 6"
	depends on BR2_USE_MMU
	depends on !BR2_USE_WCHAR || !BR2_TOOLCHAIN_HAS_THREADS || \
		!BR2_INSTALL_LIBSTDCPP || !BR2_TOOLCHAIN_GCC_AT_LEAST_6

config BR2_PACKAGE_SPICE
	bool "spice server"
	depends on BR2_USE_MMU # libglib2
	depends on BR2_USE_WCHAR # libglib2
	depends on BR2_TOOLCHAIN_HAS_THREADS # libglib2
	depends on BR2_INSTALL_LIBSTDCPP
	# Needs gcc >= 6 with c++11 std::list allocator
	# https://gcc.gnu.org/git/?p=gcc.git;a=commit;h=cc7f3d0eeef05fb8fc11384a9a29afae10a54cc7
	depends on BR2_TOOLCHAIN_GCC_AT_LEAST_6
	select BR2_PACKAGE_JPEG
	select BR2_PACKAGE_LIBGLIB2
	select BR2_PACKAGE_OPENSSL
	select BR2_PACKAGE_PIXMAN
	select BR2_PACKAGE_SPICE_PROTOCOL
	help
	  The Spice project aims to provide a complete open source
	  solution for interaction with virtualized desktop devices.
	  The Spice project deals with both the virtualized devices
	  and the front-end. Interaction between front-end and
	  back-end is done using VD-Interfaces.

	  This package implements the server-part of Spice.

	  http://www.spice-space.org/
```

## package/spidev_test/Config.in
```kconfig
config BR2_PACKAGE_SPIDEV_TEST
	bool "spidev_test"
	help
	  SPI testing utility (using spidev driver).

	  This package builds and installs the userspace 'spidev_test'
	  command. It is up to the user to ensure that the kernel
	  configuration has all suitable options enabled to allow a
	  proper operation of 'spidev_test'.

	  The version used is based on your toolchain headers version,
	  if it's older than 3.15 then 3.0 is used, up to headers 5.7
	  version 4.10 is used and otherwise version 5.8.
	  This means you won't have quad-pumped SPI support if your
	  toolchain is too old.

	  https://www.kernel.org/doc/html/latest/spi/index.html
```

## package/spirv-headers/Config.in
```kconfig
config BR2_PACKAGE_SPIRV_HEADERS
	bool "spirv-headers"
	depends on BR2_INSTALL_LIBSTDCPP
	help
	  Machine-readable files for the SPIR-V Registry

	  https://www.khronos.org/registry/spir-v

comment "spirv-headers needs a toolchain w/ C++"
	depends on !BR2_INSTALL_LIBSTDCPP
```

## package/spirv-llvm-translator/Config.in
```kconfig
config BR2_PACKAGE_SPIRV_LLVM_TRANSLATOR
	bool "spirv-translator"
	depends on BR2_PACKAGE_LLVM_ARCH_SUPPORTS
	depends on BR2_TOOLCHAIN_GCC_AT_LEAST_7
	depends on BR2_TOOLCHAIN_HAS_THREADS
	depends on BR2_INSTALL_LIBSTDCPP
	depends on !BR2_STATIC_LIBS
	depends on BR2_USE_WCHAR # llvm
	depends on BR2_HOST_GCC_AT_LEAST_7 # host-llvm
	select BR2_PACKAGE_LLVM
	select BR2_PACKAGE_SPIRV_HEADERS
	select BR2_PACKAGE_ZLIB
	help
	  LLVM/SPIR-V Bi-Directional Translator is a library and tool
	  for translation between LLVM IR and SPIR-V.

	  https://github.com/khronosGroup/SPIRV-LLVM-Translator

comment "spirv-translator needs a toolchain w/ wchar, threads, C++, gcc >= 7, dynamic library, host gcc >= 7"
	depends on BR2_PACKAGE_LLVM_ARCH_SUPPORTS
	depends on !BR2_TOOLCHAIN_HAS_THREADS || !BR2_INSTALL_LIBSTDCPP || \
		!BR2_TOOLCHAIN_GCC_AT_LEAST_7 || \
		BR2_STATIC_LIBS || !BR2_USE_WCHAR || \
		!BR2_HOST_GCC_AT_LEAST_7
```

## package/spirv-tools/Config.in
```kconfig
config BR2_PACKAGE_SPIRV_TOOLS
	bool "spirv-tools"
	depends on BR2_INSTALL_LIBSTDCPP
	depends on !BR2_STATIC_LIBS
	depends on BR2_TOOLCHAIN_GCC_AT_LEAST_8 # C++17 filesystem
	select BR2_PACKAGE_SPIRV_HEADERS
	help
	  The SPIR-V Tools project provides an API and commands for
	  processing SPIR-V modules.

	  https://github.com/KhronosGroup/SPIRV-Tools

comment "spirv-tools needs a toolchain w/ C++, dynamic library, gcc >= 8"
	depends on !BR2_INSTALL_LIBSTDCPP || BR2_STATIC_LIBS || \
		!BR2_TOOLCHAIN_GCC_AT_LEAST_8
```

## package/sqlitecpp/Config.in
```kconfig
config BR2_PACKAGE_SQLITECPP
	bool "sqlitecpp"
	depends on BR2_INSTALL_LIBSTDCPP
	depends on BR2_TOOLCHAIN_GCC_AT_LEAST_4_9 # C++11
	select BR2_PACKAGE_SQLITE
	select BR2_PACKAGE_SQLITE_ENABLE_COLUMN_METADATA
	help
	  SQLiteC++ (SQLiteCpp) is a lean and easy to use
	  C++ SQLite3 wrapper.

	  https://github.com/SRombauts/SQLiteCpp

comment "sqlitecpp needs a toolchain w/ C++11, gcc >= 4.9"
	depends on !BR2_INSTALL_LIBSTDCPP || !BR2_TOOLCHAIN_GCC_AT_LEAST_4_9
```
