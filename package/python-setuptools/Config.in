## package/python-setuptools/Config.in
```kconfig
config BR2_PACKAGE_PYTHON_SETUPTOOLS
	bool "python-setuptools"
	select BR2_PACKAGE_PYTHON3_PYEXPAT # runtime
	select BR2_PACKAGE_PYTHON3_ZLIB # runtime
	help
	  Download, build, install, upgrade, and uninstall Python
	  packages.

	  http://pypi.python.org/pypi/setuptools
```

## package/python-simple-pid/Config.in
```kconfig
config BR2_PACKAGE_PYTHON_SIMPLE_PID
	bool "python-simple-pid"
	help
	  A simple, easy to use PID controller.

	  https://github.com/m-lundberg/simple-pid
```

## package/python-simple-websocket/Config.in
```kconfig
config BR2_PACKAGE_PYTHON_SIMPLE_WEBSOCKET
	bool "python-simple-websocket"
	select BR2_PACKAGE_PYTHON_WSPROTO # runtime
	help
	  Simple WebSocket server and client for Python.

	  https://github.com/miguelgrinberg/simple-websocket
```

## package/python-simplelogging/Config.in
```kconfig
config BR2_PACKAGE_PYTHON_SIMPLELOGGING
	bool "python-simplelogging"
	depends on BR2_PACKAGE_PYTHON3 # python-colorlog
	select BR2_PACKAGE_PYTHON_COLORLOG # runtime
	help
	  Logging made simple, no excuse for any debug print call.

	  https://github.com/vpoulailleau/simplelogging
```

## package/python-smbprotocol/Config.in
```kconfig
config BR2_PACKAGE_PYTHON_SMBPROTOCOL
	bool "python-smbprotocol"
	depends on BR2_PACKAGE_HOST_RUSTC_TARGET_ARCH_SUPPORTS # python-cryptography
	select BR2_PACKAGE_PYTHON_CRYPTOGRAPHY # runtime
	select BR2_PACKAGE_PYTHON_PYSPNEGO # runtime
	help
	  Interact with a server using the SMB 2/3 Protocol.

	  https://github.com/jborean93/smbprotocol
```

## package/python-smbus2/Config.in
```kconfig
config BR2_PACKAGE_PYTHON_SMBUS2
	bool "python-smbus2"
	help
	  smbus2 is a drop-in replacement for smbus-cffi/smbus-python
	  in pure Python.

	  https://github.com/kplindegaard/smbus2
```

## package/python-sniffio/Config.in
```kconfig
config BR2_PACKAGE_PYTHON_SNIFFIO
	bool "python-sniffio"
	help
	  Sniff out which async library your code is running under.

	  https://github.com/python-trio/sniffio
```

## package/python-sockjs/Config.in
```kconfig
config BR2_PACKAGE_PYTHON_SOCKJS
	bool "python-sockjs"
	select BR2_PACKAGE_PYTHON_AIOHTTP # runtime
	select BR2_PACKAGE_PYTHON_ASYNC_TIMEOUT # runtime
	help
	  SockJS server implementation for aiohttp.

	  https://github.com/aio-libs/sockjs/
```

## package/python-soupsieve/Config.in
```kconfig
config BR2_PACKAGE_PYTHON_SOUPSIEVE
	bool "python-soupsieve"
	help
	  A modern CSS selector implementation for Beautiful Soup.

	  https://github.com/facelessuser/soupsieve
```

## package/python-spake2/Config.in
```kconfig
config BR2_PACKAGE_PYTHON_SPAKE2
	bool "python-spake2"
	depends on BR2_PACKAGE_HOST_RUSTC_TARGET_ARCH_SUPPORTS # python-cryptography
	select BR2_PACKAGE_PYTHON_CRYPTOGRAPHY # runtime
	help
	  SPAKE2 password-authenticated key exchange (in pure python).

	  This library implements the SPAKE2 password-authenticated
	  key exchange ("PAKE") algorithm. This allows two parties,
	  who share a weak password, to safely derive a strong shared
	  secret (and therefore build an encrypted+authenticated
	  channel).

	  https://github.com/warner/python-spake2
```

## package/python-stack-data/Config.in
```kconfig
config BR2_PACKAGE_PYTHON_STACK_DATA
	bool "python-stack-data"
	select BR2_PACKAGE_PYTHON_ASTTOKENS # runtime
	select BR2_PACKAGE_PYTHON_EXECUTING # runtime
	select BR2_PACKAGE_PYTHON_PURE_EVAL # runtime
	help
	  Extract data from python stack frames and tracebacks
	  for informative displays.

	  http://github.com/alexmojaki/stack_data
```

## package/python-stack_data/Config.in
```kconfig
config BR2_PACKAGE_PYTHON_STACK_DATA
	bool "python-stack_data"
	select BR2_PACKAGE_PYTHON_PURE_EVAL # runtime
	select BR2_PACKAGE_PYTHON_ASTTOKENS # runtime
	select BR2_PACKAGE_PYTHON_EXECUTING # runtime
	help
	This is a library that extracts data from stack frames and tracebacks,
	particularly to display more useful tracebacks than the default. It
	powers the tracebacks in IPython and futurecoder:

	  https://github.com/alexmojaki/stack_data
```

## package/python-starlette/Config.in
```kconfig
config BR2_PACKAGE_PYTHON_STARLETTE
	bool "python-starlette"
	select BR2_PACKAGE_PYTHON_ANYIO # runtime
	help
	  The little ASGI library that shines.

	  https://github.com/encode/starlette
```

## package/python-sympy/Config.in
```kconfig
config BR2_PACKAGE_PYTHON_SYMPY
	bool "python-sympy"
	select BR2_PACKAGE_PYTHON_MPMATH # runtime
	help
	  SymPy is a Python library for symbolic mathematics. It aims
	  to become a full-featured computer algebra system (CAS)
	  while keeping the code as simple as possible in order to be
	  comprehensible and easily extensible. SymPy is written
	  entirely in Python.

	  https://www.sympy.org/
```

## package/python-sysv-ipc/Config.in
```kconfig
config BR2_PACKAGE_PYTHON_SYSV_IPC
	bool "python-sysv-ipc"
	help
	  System V IPC primitives (semaphores, shared memory and
	  message queues) for Python.

	  https://github.com/osvenskan/sysv_ipc
```

## package/python-tcolorpy/Config.in
```kconfig
config BR2_PACKAGE_PYTHON_TCOLORPY
	bool "python-tcolorpy"
	help
	  Tcolopy is a Python library to apply true color for
	  terminal text.

	  https://github.com/thombashi/tcolorpy
```

## package/python-tempora/Config.in
```kconfig
config BR2_PACKAGE_PYTHON_TEMPORA
	bool "python-tempora"
	select BR2_PACKAGE_PYTHON_DATEUTIL # runtime
	select BR2_PACKAGE_PYTHON_JARACO_FUNCTOOLS # runtime
	help
	  Objects and routines pertaining to date and time.

	  https://github.com/jaraco/tempora
```

## package/python-textual/Config.in
```kconfig
config BR2_PACKAGE_PYTHON_TEXTUAL
	bool "python-textual"
	select BR2_PACKAGE_PYTHON_MARKDOWN_IT_PY # runtime
	select BR2_PACKAGE_PYTHON_MDIT_PY_PLUGINS # runtime
	select BR2_PACKAGE_PYTHON_PLATFORMDIRS # runtime
	select BR2_PACKAGE_PYTHON_PYGMENTS # runtime
	select BR2_PACKAGE_PYTHON_RICH # runtime
	select BR2_PACKAGE_PYTHON_TYPING_EXTENSIONS # runtime
	help
	  Modern Text User Interface framework.

	  https://github.com/Textualize/textual
```

## package/python-tftpy/Config.in
```kconfig
config BR2_PACKAGE_PYTHON_TFTPY
	bool "python-tftpy"
	help
	  tftpy is a pure Python implementation of the
	  Trivial FTP protocol.

	  https://github.com/msoulier/tftpy
```

## package/python-tinycss2/Config.in
```kconfig
config BR2_PACKAGE_PYTHON_TINYCSS2
	bool "python-tinycss2"
	select BR2_PACKAGE_PYTHON_WEBENCODINGS # runtime
	help
	  A tiny CSS parser.

	  https://www.courtbouillon.org/tinycss2
```

## package/python-tinyhtml5/Config.in
```kconfig
config BR2_PACKAGE_PYTHON_TINYHTML5
	bool "python-tinyhtml5"
	select BR2_PACKAGE_PYTHON_WEBENCODINGS # runtime
	help
	  HTML parser based on the WHATWG HTML specification.

	  https://github.com/CourtBouillon/tinyhtml5
```

## package/python-tinyrpc/Config.in
```kconfig
config BR2_PACKAGE_PYTHON_TINYRPC
	bool "python-tinyrpc"
	help
	  A small, modular, transport and protocol neutral RPC
	  library that, among other things, supports JSON-RPC and
	  zmq.

	  http://github.com/mbr/tinyrpc
```

## package/python-tomli-w/Config.in
```kconfig
config BR2_PACKAGE_PYTHON_TOMLI_W
	bool "python-tomli-w"
	help
	  A lil' TOML writer.

	  https://github.com/hukkin/tomli-w
```

## package/python-tomli/Config.in
```kconfig
config BR2_PACKAGE_PYTHON_TOMLI
	bool "python-tomli"
	help
	  A lil' TOML parser.

	  https://github.com/hukkin/tomli
```

## package/python-tomlkit/Config.in
```kconfig
config BR2_PACKAGE_PYTHON_TOMLKIT
	bool "python-tomlkit"
	help
	  Style preserving TOML library.

	  https://github.com/sdispater/tomlkit
```
