## package/procps-ng/Config.in
```kconfig
comment "procps-ng needs a toolchain w/ wchar"
	depends on BR2_USE_MMU
	depends on BR2_PACKAGE_BUSYBOX_SHOW_OTHERS
	depends on !BR2_USE_WCHAR

config BR2_PACKAGE_PROCPS_NG
	bool "procps-ng"
	depends on BR2_USE_MMU # fork()
	depends on BR2_PACKAGE_BUSYBOX_SHOW_OTHERS
	depends on BR2_USE_WCHAR
	select BR2_PACKAGE_NCURSES
	help
	  Standard informational utilities and process-handling tools.
	  Provides things like kill, ps, uptime, free, top, etc...

	  http://sourceforge.net/projects/procps-ng/
```

## package/procs/Config.in
```kconfig
config BR2_PACKAGE_PROCS
	bool "procs"
	depends on BR2_PACKAGE_HOST_RUSTC_TARGET_ARCH_SUPPORTS
	select BR2_PACKAGE_HOST_RUSTC
	help
	  procs is a modern replacement for ps written in Rust

	  https://github.com/dalance/procs.git
```

## package/proj/Config.in
```kconfig
config BR2_PACKAGE_PROJ
	bool "proj"
	depends on BR2_INSTALL_LIBSTDCPP
	depends on BR2_TOOLCHAIN_GCC_AT_LEAST_4_7 # C++11
	depends on BR2_TOOLCHAIN_HAS_THREADS_NPTL
	depends on BR2_USE_WCHAR
	select BR2_PACKAGE_SQLITE
	help
	  proj.4 is a standard UNIX filter function which converts
	  geographic longitude and latitude coordinates into cartesian
	  coordinates (and vice versa), and it is a C API for software
	  developers to include coordinate transformation in their own
	  software.

	  http://proj4.org/

if BR2_PACKAGE_PROJ

config BR2_PACKAGE_PROJ_APPS
	bool "build apps"
	select BR2_PACKAGE_LIBCURL
	help
	  Build and install proj command line apps. Those command line
	  applications are: cct, cs2cs, geod, gie, invgeod, invproj,
	  proj, projinfo, projsync.

endif

comment "proj needs a toolchain w/ C++, gcc >= 4.7, NPTL, wchar"
	depends on !BR2_INSTALL_LIBSTDCPP || \
		!BR2_TOOLCHAIN_GCC_AT_LEAST_4_7 || \
		!BR2_TOOLCHAIN_HAS_THREADS_NPTL || !BR2_USE_WCHAR
```

## package/protobuf-c/Config.in
```kconfig
config BR2_PACKAGE_PROTOBUF_C
	bool "protobuf-c"
	depends on BR2_INSTALL_LIBSTDCPP
	depends on BR2_TOOLCHAIN_HAS_THREADS
	# host-protobuf only builds on certain architectures
	depends on BR2_PACKAGE_HOST_PROTOBUF_ARCH_SUPPORTS
	depends on BR2_HOST_GCC_AT_LEAST_7 # c++17 for host variant
	help
	  Code generator and runtime libraries to use Protocol Buffers
	  from pure C (not C++).

	  https://github.com/protobuf-c/protobuf-c

comment "protobuf-c needs a toolchain w/ C++, threads, host gcc >= 7"
	depends on !BR2_INSTALL_LIBSTDCPP || !BR2_TOOLCHAIN_HAS_THREADS || !BR2_HOST_GCC_AT_LEAST_7
	depends on BR2_PACKAGE_HOST_PROTOBUF_ARCH_SUPPORTS
```

## package/protozero/Config.in
```kconfig
config BR2_PACKAGE_PROTOZERO
	bool "protozero"
	depends on BR2_INSTALL_LIBSTDCPP
	depends on BR2_TOOLCHAIN_GCC_AT_LEAST_4_7 # C++11
	help
	  Minimalistic protocol buffer decoder and encoder in C++.
	  Designed for high performance. Suitable for writing zero copy
	  parsers and encoders with minimal need for run-time allocation
	  of memory.
	  Low-level: this is designed to be a building block for writing
	  a very customized decoder for a stable protobuf schema. If
	  your protobuf schema is changing frequently or lazy decoding
	  is not critical for your application then this approach offers
	  no value: just use the C++ API that can be generated with
	  the Google Protobufs protoc program.

	  https://github.com/mapbox/protozero

comment "protozero needs a toolchain w/ C++, gcc >= 4.7"
	depends on !BR2_INSTALL_LIBSTDCPP || !BR2_TOOLCHAIN_GCC_AT_LEAST_4_7
```

## package/psimd/Config.in
```kconfig
config BR2_PACKAGE_PSIMD
	bool "psimd"
	help
	  Portable 128-bit SIMD intrinsics.

	  https://github.com/Maratyszcza/psimd
```

## package/pthreadpool/Config.in
```kconfig
config BR2_PACKAGE_PTHREADPOOL
	bool "pthreadpool"
	depends on BR2_TOOLCHAIN_HAS_THREADS
	select BR2_PACKAGE_FXDIV
	help
	  Pthreadpool is a portable and efficient thread pool
	  implementation.

	  https://github.com/Maratyszcza/pthreadpool

comment "pthreadpool needs a toolchain w/ threads"
	  depends on !BR2_TOOLCHAIN_HAS_THREADS
```

## package/pulseview/Config.in
```kconfig
config BR2_PACKAGE_PULSEVIEW
	bool "pulseview"
	depends on BR2_USE_MMU
	depends on BR2_TOOLCHAIN_SUPPORTS_ALWAYS_LOCKFREE_ATOMIC_INTS # boost-filesystem
	depends on BR2_USE_WCHAR  # libsigrok, qt5
	depends on BR2_TOOLCHAIN_HAS_THREADS_NPTL  # qt5
	depends on BR2_INSTALL_LIBSTDCPP
	depends on BR2_ENABLE_LOCALE
	depends on !BR2_STATIC_LIBS # libsigrok, qt5
	depends on BR2_TOOLCHAIN_GCC_AT_LEAST_7 # libsigrok
	depends on BR2_HOST_GCC_AT_LEAST_5  # qt5
	select BR2_PACKAGE_BOOST
	select BR2_PACKAGE_BOOST_FILESYSTEM
	select BR2_PACKAGE_BOOST_SERIALIZATION
	select BR2_PACKAGE_BOOST_SYSTEM
	select BR2_PACKAGE_LIBSIGROK
	select BR2_PACKAGE_LIBSIGROKCXX
	select BR2_PACKAGE_QT5
	select BR2_PACKAGE_QT5BASE
	select BR2_PACKAGE_QT5BASE_PNG
	select BR2_PACKAGE_QT5BASE_WIDGETS
	select BR2_PACKAGE_QT5SVG
	select BR2_PACKAGE_QT5TOOLS
	select BR2_PACKAGE_QT5TOOLS_LINGUIST_TOOLS
	help
	  PulseView is a Qt based logic analyzer, oscilloscope
	  and MSO GUI for sigrok.

	  http://sigrok.org/wiki/PulseView

comment "pulseview needs a toolchain w/ locale, wchar, threads, dynamic library, C++, gcc >= 7, host gcc >= 5"
	depends on BR2_USE_MMU
	depends on BR2_TOOLCHAIN_SUPPORTS_ALWAYS_LOCKFREE_ATOMIC_INTS
	depends on !BR2_USE_WCHAR \
		|| !BR2_TOOLCHAIN_HAS_THREADS_NPTL \
		|| !BR2_INSTALL_LIBSTDCPP \
		|| !BR2_ENABLE_LOCALE \
		|| BR2_STATIC_LIBS \
		|| !BR2_TOOLCHAIN_GCC_AT_LEAST_7 \
		|| !BR2_HOST_GCC_AT_LEAST_5
```

## package/pv/Config.in
```kconfig
config BR2_PACKAGE_PV
	bool "pv"
	depends on BR2_USE_MMU # fork()
	help
	  Pipe Viewer - is a terminal-based tool for
	  monitoring the progress of data through a
	  pipeline.

	  http://www.ivarch.com/programs/pv.shtml
```

## package/pxcore-dukluv/Config.in
```kconfig
config BR2_PACKAGE_PXCORE_DUKLUV
	bool "pxcore dukluv"
	help
	  dukluv library tuned for pxcore
```

## package/pxcore-libnode/Config.in
```kconfig
config BR2_PACKAGE_PXCORE_LIBNODE
	bool "pxcore libnode"
	select BR2_PACKAGE_OPENSSL
	select BR2_PACKAGE_HOST_QEMU
	select BR2_PACKAGE_HOST_QEMU_SYSTEM_MODE
	select BR2_PACKAGE_HOST_QEMU_LINUX_USER_MODE
```

## package/pxcore-tools/Config.in
```kconfig
config BR2_PACKAGE_PXCORE_TOOLS
	bool "pxcore tools"

if BR2_PACKAGE_PXCORE_TOOLS
config BR2_PACKAGE_PXCORE_RTCORE
	bool "rtcore"
	help
	  rtCore

config BR2_PACKAGE_PXCORE_DUKLUV
	bool "dukluv"
	help
	  dukluv

endif
```

## package/pxcore/Config.in
```kconfig
config BR2_PACKAGE_PXCORE
	bool "pxcore"
	select BR2_PACKAGE_OPENSSL
	select BR2_PACKAGE_WESTEROS
	select BR2_PACKAGE_UTIL_LINUX
	select BR2_PACKAGE_LIBPNG
	select BR2_PACKAGE_LIBCURL
	select BR2_PACKAGE_RTREMOTE
	help
	  pxCore is a small open source library that provides a portable
	  framebuffer and windowing abstraction for C++
```

## package/python-aerich/Config.in
```kconfig
config BR2_PACKAGE_PYTHON_AERICH
	bool "python-aerich"
	select BR2_PACKAGE_PYTHON_ANYIO # runtime
	select BR2_PACKAGE_PYTHON_ASYNCCLICK # runtime
	select BR2_PACKAGE_PYTHON_DICTDIFFER # runtime
	select BR2_PACKAGE_PYTHON_TORTOISE_ORM # runtime
	help
	  A database migrations tool for Tortoise ORM.

	  https://github.com/tortoise/aerich
```

## package/python-aexpect/Config.in
```kconfig
config BR2_PACKAGE_PYTHON_AEXPECT
	bool "python-aexpect"
	help
	  Aexpect.

	  http://avocado-framework.github.io/
```

## package/python-aioblescan/Config.in
```kconfig
config BR2_PACKAGE_PYTHON_AIOBLESCAN
	bool "python-aioblescan"
	help
	  Scanning Bluetooth for advertised info with asyncio.

	  https://github.com/frawau/aioblescan
```

## package/python-aiocoap/Config.in
```kconfig
config BR2_PACKAGE_PYTHON_AIOCOAP
	bool "python-aiocoap"
	help
	  Python CoAP library.

	  https://github.com/chrysn/aiocoap
```

## package/python-aioconsole/Config.in
```kconfig
config BR2_PACKAGE_PYTHON_AIOCONSOLE
	bool "python-aioconsole"
	help
	  Asynchronous console and interfaces for asyncio.

	  https://github.com/vxgmichel/aioconsole
```

## package/python-aiodns/Config.in
```kconfig
config BR2_PACKAGE_PYTHON_AIODNS
	bool "python-aiodns"
	select BR2_PACKAGE_PYTHON_PYCARES # runtime
	help
	  Simple DNS resolver for asyncio.

	  http://github.com/saghul/aiodns
```

## package/python-aiofiles/Config.in
```kconfig
config BR2_PACKAGE_PYTHON_AIOFILES
	bool "python-aiofiles"
	help
	  aiofiles aims to  handle local disk files in
	  asyncio applications.

	  https://pypi.org/project/aiofiles
```

## package/python-aiohappyeyeballs/Config.in
```kconfig
config BR2_PACKAGE_PYTHON_AIOHAPPYEYEBALLS
	bool "python-aiohappyeyeballs"
	help
	  Happy Eyeballs for asyncio.

	  https://github.com/aio-libs/aiohappyeyeballs
```

## package/python-aiohttp-cors/Config.in
```kconfig
config BR2_PACKAGE_PYTHON_AIOHTTP_CORS
	bool "python-aiohttp-cors"
	select BR2_PACKAGE_PYTHON_AIOHTTP # runtime
	help
	  CORS support for aiohttp.

	  https://github.com/aio-libs/aiohttp-cors
```

## package/python-aiohttp-remotes/Config.in
```kconfig
config BR2_PACKAGE_PYTHON_AIOHTTP_REMOTES
	bool "python-aiohttp-remotes"
	select BR2_PACKAGE_PYTHON_AIOHTTP # runtime
	select BR2_PACKAGE_PYTHON_TYPING_EXTENSIONS # runtime
	help
	  Control remote side information.

	  https://github.com/aio-libs/aiohttp-remotes
```

## package/python-aiohttp-security/Config.in
```kconfig
config BR2_PACKAGE_PYTHON_AIOHTTP_SECURITY
	bool "python-aiohttp-security"
	select BR2_PACKAGE_PYTHON_AIOHTTP # runtime
	help
	  Security for aiohttp.web.

	  https://github.com/aio-libs/aiohttp_security/
```

## package/python-aiohttp-session/Config.in
```kconfig
config BR2_PACKAGE_PYTHON_AIOHTTP_SESSION
	bool "python-aiohttp-session"
	select BR2_PACKAGE_PYTHON_AIOHTTP # runtime
	help
	  Sessions for aiohttp.web.

	  https://github.com/aio-libs/aiohttp_session/
```
