## package/adsp-ldr/Config.in.host
```kconfig
config BR2_PACKAGE_HOST_ADSP_LDR
	bool "host adsp-ldr"
	help
	  adsp-ldr is a tool that generates boot streams to be
	  loaded and executed by the boot ROM of Analog Devices
	  ADSP-SCXXX SoCs

	  https://github.com/analogdevicesinc/adsp-ldr
```

## package/adwaita-icon-theme/Config.in
```kconfig
config BR2_PACKAGE_ADWAITA_ICON_THEME
	bool "adwaita icon theme"
	depends on BR2_PACKAGE_LIBGTK2 || BR2_PACKAGE_LIBGTK3
	# host-libgtk3 -> host-librsvg -> host-pango -> host-harfbuzz
	depends on BR2_HOST_GCC_AT_LEAST_4_9
	help
	  Adwaita icon theme

comment "adwaita icon theme needs host gcc >= 4.9"
	depends on !BR2_HOST_GCC_AT_LEAST_4_9
```

## package/agec/Config.in
```kconfig
config BR2_PACKAGE_AGEC
	bool "agec"
	select BR2_PACKAGE_OPENSSL
	help
	  Agec is a simple file encryption tool that implements the
	  age format in C with minimal dependencies. The tool supports
	  asymmetric encryption based on X25519, and a passphrase
	  encryption based on scrypt.

	  https://git.sr.ht/~min/agec
```

## package/agent-proxy/Config.in.host
```kconfig
config BR2_PACKAGE_HOST_AGENT_PROXY
	bool "host agent-proxy"
	help
	  This is a simple, small proxy which was intended for use
	  with kgdb, or gdbserver type connections where you want to
	  share a text console and a debug session.

	  The idea is that you use the agent-proxy to connect to a
	  serial port directly or to a remote terminal server.

	  git://git.kernel.org/pub/scm/utils/kernel/kgdb/agent-proxy.git
```

## package/agentpp/Config.in
```kconfig
config BR2_PACKAGE_AGENTPP
	bool "agent++"
	depends on BR2_INSTALL_LIBSTDCPP
	depends on BR2_TOOLCHAIN_HAS_THREADS # snmp++
	depends on !BR2_STATIC_LIBS # snmp++
	select BR2_PACKAGE_SNMPPP
	help
	  AGENT++ is a set of C++ classes which provides a complete
	  protocol engine and dispatch table for the development of
	  SNMP agents. AGENT++ is a multilingual API which supports
	  SNMPv1, SNMPv2c, and SNMPv3. It provides various C++ classes
	  implementing prototypes for scalar and table SNMP managed
	  objects that can be customized by derivation. Additional
	  classes support the development of proxy agents as well as
	  sending notifications.

	  SNMPv3 support is enabled if SNMP++ enables it.

	  https://www.agentpp.com/api/cpp/agent_pp.html

comment "agent++ needs a toolchain w/ threads, C++, dynamic library"
	depends on !BR2_INSTALL_LIBSTDCPP || !BR2_TOOLCHAIN_HAS_THREADS || \
		BR2_STATIC_LIBS
```

## package/aichat/Config.in
```kconfig
config BR2_PACKAGE_AICHAT
	bool "aichat"
	depends on BR2_PACKAGE_HOST_RUSTC_TARGET_ARCH_SUPPORTS
	select BR2_PACKAGE_HOST_RUSTC
	help
	  AIChat helps seamlessly integrate different LLM models,
	  providing access via the CLI and network. It can serve
	  as a gateway to heterogeneous and distributed LLMs.

	  Handy features like roles, macros, and sessions help
	  simplify repetitive tasks and reuse of existing solutions.
	  Features like playgrounds and arenas help to explore and
	  compare models.

	  https://github.com/sigoden/aichat
```

## package/alfred/Config.in
```kconfig
config BR2_PACKAGE_ALFRED
	bool "alfred"
	depends on !BR2_STATIC_LIBS # dlopen()
	depends on BR2_TOOLCHAIN_HAS_THREADS # libnl
	select BR2_PACKAGE_LIBNL
	help
	  Alfred is a user space daemon for distributing arbitrary
	  local information over the mesh/network in a decentralized
	  fashion.

	  This data can be anything which appears to be useful -
	  originally designed to replace the batman-adv visualization
	  (vis), you may distribute hostnames, phone books,
	  administration information, DNS information, the local
	  weather forecast ...

	  https://www.open-mesh.org/projects/alfred/wiki

comment "alfred needs a toolchain w/ dynamic library, threads"
	depends on BR2_STATIC_LIBS || !BR2_TOOLCHAIN_HAS_THREADS
```

## package/alsa-plugins/Config.in
```kconfig
config BR2_PACKAGE_ALSA_PLUGINS
	bool "alsa-plugins"
	depends on BR2_PACKAGE_ALSA_LIB
	select BR2_PACKAGE_ALSA_LIB_HWDEP
	help
	  Advanced Linux Sound Architecture Plugins

	  http://www.alsa-project.org/
```

## package/amazon-alexa/Config.in
```kconfig
source "package/amazon-alexa/alexa-pryon-kwd/Config.in"
source "package/amazon-alexa/alexa-smart-screen-sdk/Config.in"
source "package/amazon-alexa/apl-client-library/Config.in"
source "package/amazon-alexa/apl-core-library/Config.in"
source "package/amazon-alexa/avs-device-sdk/Config.in"
```

## package/amazon-alexa/alexa-pryon-kwd/Config.in
```kconfig
menuconfig BR2_PACKAGE_ALEXA_PRYON_KWD
    bool "alexa-pryon-kwd"
    help
        Pryon Key Word Engine for alexa-device-sdk and alexa-smart-screen

if BR2_PACKAGE_ALEXA_PRYON_KWD
    config BR2_PACKAGE_ALEXA_PRYON_KWD_PLATFORM
        string "Pryon platform name"
        default "rpi3"
        help
            Platform binaries to be used

endif
```

## package/amazon-alexa/alexa-smart-screen-sdk/Config.in
```kconfig
menuconfig BR2_PACKAGE_ALEXA_SMART_SCREEN_SDK
    bool "alexa-smart-screen-sdk"
    select BR2_PACKAGE_APL_CORE_LIBRARY
    select BR2_PACKAGE_AVS_DEVICE_SDK
    select BR2_PACKAGE_WEBSOCKETPP
    select BR2_PACKAGE_ASIO
    select BR2_PACKAGE_RAPIDJSON
    help
        The Alexa Smart Screen SDK enables device makers to build screen-based products that
        complement Alexa voice responses with rich visuals.
        https://developer.amazon.com/alexa-voice-service/alexa-smart-screen-sdk


if BR2_PACKAGE_ALEXA_SMART_SCREEN_SDK
choice BR2_PACKAGE_ALEXA_SMART_SCREEN_SDK_BUILD_TYPE
    prompt "Build type"
    default BR2_PACKAGE_ALEXA_SMART_SCREEN_SDK_BUILD_TYPE_DEBUG
    help
        Select build type

config BR2_PACKAGE_ALEXA_SMART_SCREEN_SDK_BUILD_TYPE_RELEASE
    bool "Release"
    help
        Release build

config BR2_PACKAGE_ALEXA_SMART_SCREEN_SDK_BUILD_TYPE_DEBUG
    bool "Debug"
    help
        Debug build

endchoice # BR2_PACKAGE_ALEXA_SMART_SCREEN_SDK_BUILD_TYPE

config BR2_PACKAGE_ALEXA_SMART_SCREEN_SDK_ENABLE_JS_GUICLIENT
    bool "Enable JS GUIClient"
    default n
    help
        Builds the default GUIClient application

if BR2_PACKAGE_ALEXA_SMART_SCREEN_SDK_ENABLE_JS_GUICLIENT
    config BR2_PACKAGE_ALEXA_SMART_SCREEN_SDK_JS_GUICLIENT_INSTALL_PATH
        string "GUIClient install path"
        default "/www/alexa"
        help
            The path on the target where GUIClient should be installed
endif

config BR2_PACKAGE_ALEXA_SMART_SCREEN_SDK_USE_GSTREAMER
    bool "Use gstreamer"
    select BR2_PACKAGE_GSTREAMER1
    select BR2_PACKAGE_GST1_PLUGINS_BASE
    select BR2_PACKAGE_GST1_PLUGINS_GOOD
    select BR2_PACKAGE_GST1_PLUGINS_BAD
    select BR2_PACKAGE_GST1_LIBAV
    default y
    help
        Build gstreamer media player

config BR2_PACKAGE_ALEXA_SMART_SCREEN_SDK_MICROPHONE_BACKEND_PORTAUDIO
    bool "Portaudio microphone backend"
    select BR2_PACKAGE_PORTAUDIO
    default y
    help
        Use portaudio as the microphone backend.

endif
```

## package/amazon-alexa/apl-client-library/Config.in
```kconfig
config BR2_PACKAGE_APL_CLIENT_LIBRARY
    bool "apl-client-library"
    select BR2_PACKAGE_ASIO
    select BR2_PACKAGE_WEBSOCKETPP
    help
        APL Client Library provides communication between APLViewhostWeb and apl-core-library.
        Its job is making sure that APL Documents are correctly rendered and getting updated
        based on user's interaction.
```

## package/amazon-alexa/apl-core-library/Config.in
```kconfig
config BR2_PACKAGE_APL_CORE_LIBRARY
    bool "apl-core-library"
    select BR2_PACKAGE_RAPIDJSON
    help
        APL Core Library enables device makers to create their own "APL viewhost",
        bringing Alexa experiences with visual renderings to new devices or platforms
        using any programming language that can invoke C/C++ code.
```

## package/amazon-alexa/avs-device-sdk/Config.in
```kconfig
menuconfig BR2_PACKAGE_AVS_DEVICE_SDK
    bool "avs-device-sdk"
    select BR2_PACKAGE_OPENSSL
    select BR2_PACKAGE_LIBCURL
    select BR2_PACKAGE_LIBCURL_ENABLE_HTTP2
    select BR2_PACKAGE_SQLITE
    help
        An SDK for commercial device makers to integrate Alexa directly into connected products.

if BR2_PACKAGE_AVS_DEVICE_SDK

choice BR2_PACKAGE_AVS_DEVICE_SDK_BUILD_TYPE
    prompt "Build type"
    default BR2_PACKAGE_AVS_DEVICE_SDK_BUILD_TYPE_DEBUG
    help
        Select build type

config BR2_PACKAGE_AVS_DEVICE_SDK_BUILD_TYPE_RELEASE
    bool "Release"
    help
        Release build

config BR2_PACKAGE_AVS_DEVICE_SDK_BUILD_TYPE_DEBUG
    bool "Debug"
    help
        Debug build

endchoice # BR2_PACKAGE_AVS_DEVICE_SDK_BUILD_TYPE

config BR2_PACKAGE_AVS_DEVICE_SDK_USE_GSTREAMER
    bool "Use gstreamer"
    select BR2_PACKAGE_GSTREAMER1
    select BR2_PACKAGE_GST1_PLUGINS_BASE
    select BR2_PACKAGE_GST1_PLUGINS_GOOD
    select BR2_PACKAGE_GST1_PLUGINS_BAD
    select BR2_PACKAGE_GST1_LIBAV
    default y
    help
        Build gstreamer media player

config BR2_PACKAGE_AVS_DEVICE_SDK_MICROPHONE_BACKEND_PORTAUDIO
    bool "Portaudio microphone backend"
    select BR2_PACKAGE_PORTAUDIO
    default y
    help
        Use portaudio as the microphone backend.


endif # BR2_PACKAGE_AVS_DEVICE_SDK
```

## package/amazon-backend/Config.in
```kconfig
 config BR2_PACKAGE_AMAZON_BACKEND
	bool "amazon backend"
	select BR2_PACKAGE_WPEFRAMEWORK_CLIENTLIBRARIES
	select BR2_PACKAGE_GST1_PLUGINS_BAD
	select BR2_PACKAGE_GST1_PLUGINS_GOOD
	help
	  amazon backend for bme player
 
```

## package/amazon-ecr-credential-helper/Config.in
```kconfig
config BR2_PACKAGE_AMAZON_ECR_CREDENTIAL_HELPER
	bool "amazon-ecr-credential-helper"
	depends on BR2_PACKAGE_HOST_GO_TARGET_ARCH_SUPPORTS
	depends on BR2_TOOLCHAIN_HAS_THREADS_NPTL  # pthread_*_np()
	help
	  The Amazon ECR Docker Credential Helper is a credential
	  helper for the Docker daemon that makes it easier to use
	  Amazon Elastic Container Registry.

	  https://github.com/awslabs/amazon-ecr-credential-helper

comment "amazon-ecr-credential-helper needs a toolchain w/ NPTL"
	depends on BR2_PACKAGE_HOST_GO_TARGET_ARCH_SUPPORTS
	depends on !BR2_TOOLCHAIN_HAS_THREADS_NPTL
```

## package/amazon-ignition/Config.in
```kconfig
config BR2_PACKAGE_AMAZON_IGNITION
	select BR2_PACKAGE_JPEG
	select BR2_PACKAGE_ZLIB
	select BR2_PACKAGE_LIBCURL
	select BR2_PACKAGE_LIBPNG
	select BR2_PACKAGE_WPEFRAMEWORK
	select BR2_PACKAGE_WPEFRAMEWORK_VIRTUALINPUT
	bool "amazon-ignition"
	help
	  Amazon project

if BR2_PACKAGE_AMAZON_IGNITION
menu "Options"

choice
	prompt "Build type"
	default BR2_PACKAGE_AMAZON_IGNITION_BUILD_TYPE_RELEASE
	help
	  Select the build type to use.
	  
	config BR2_PACKAGE_AMAZON_IGNITION_BUILD_TYPE_RELEASE
		bool "release"
	config BR2_PACKAGE_AMAZON_IGNITION_BUILD_TYPE_RELEASE_DEBUG
		bool "release with debug symbols"
	config BR2_PACKAGE_AMAZON_IGNITION_BUILD_TYPE_DEBUG
		bool "debug"
	config BR2_PACKAGE_AMAZON_IGNITION_BUILD_TYPE_TESTING
		bool "testing"
endchoice

config BR2_PACKAGE_AMAZON_IGNITION_BUILD_SHARED_LIBRARY_LAUNCHER
	bool "shared library launcher"
	default "n"

config BR2_PACKAGE_AMAZON_IGNITION_DEVELOPER_MODE
	bool "developer mode"
	default "n"
	help
        Enable this to use info and debug traces

config BR2_PACKAGE_AMAZON_IGNITION_BUILD_TESTS
	bool "include tests"
	select BR2_PACKAGE_AMAZON_IGNITION_DEVELOPER_MODE
	default "n"
	
config BR2_PACKAGE_AMAZON_IGNITION_IG_INSTALL_PATH
	string "install path"
	default "/usr/share/ignition"
endmenu
endif
```

## package/amazon/Config.in
```kconfig
config BR2_PACKAGE_AMAZON
	select BR2_PACKAGE_JPEG
	select BR2_PACKAGE_ZLIB
	select BR2_PACKAGE_LIBCURL
	select BR2_PACKAGE_LIBPNG
	select BR2_PACKAGE_WPEFRAMEWORK
	select BR2_PACKAGE_WPEFRAMEWORK_VIRTUALINPUT
	bool "amazon"
	help
	  Amazon project

if BR2_PACKAGE_AMAZON
menu "Options"

config BR2_PACKAGE_AMAZON_INCLUDE_IGNITION
	bool "ignition"
	default "n"

config BR2_PACKAGE_AMAZON_PLATFORM_FAMILY_NAME
	string "family name"
	default "rpi-metrological"

config BR2_PACKAGE_AMAZON_PLATFORM_NAME
	string "platform name"
	default "rpi-metrological-2018-br"

config BR2_PACKAGE_AMAZON_NUMBER_OF_CONCURRENT_JOBS
	string "concurrent jobs"
	default "4"

config BR2_PACKAGE_AMAZON_TAG
	string "AVPK Version"
	default "1.2.0"
	
choice
	prompt "Build type"
	default BR2_PACKAGE_AMAZON_BUILD_TYPE_RELEASE
	help
	  Select the build type to use.
	  
	config BR2_PACKAGE_AMAZON_BUILD_TYPE_RELEASE
		bool "release"
	config BR2_PACKAGE_AMAZON_BUILD_TYPE_RELEASE_DEBUG
		bool "release with debug symbols"
	config BR2_PACKAGE_AMAZON_BUILD_TYPE_DEBUG
		bool "debug"
	config BR2_PACKAGE_AMAZON_BUILD_TYPE_TESTING
		bool "testing"
endchoice

choice
	prompt "Backend"
	default BR2_PACKAGE_AMAZON_BACKEND_DRM
	help
	  Select the backend you wish to use.
	  
	config BR2_PACKAGE_AMAZON_BACKEND_DRM
		bool "with drm"
	config BR2_PACKAGE_AMAZON_BACKEND_NO_DRM
		bool "without drm"
	config BR2_PACKAGE_AMAZON_BACKEND_FAKE
		bool "fake (for unittests)"
endchoice

config BR2_PACKAGE_AMAZON_IG_INSTALL_PATH
	string "install path"
	default "/usr/share/ignition"

config BR2_PACKAGE_AMAZON_IG_READ_WRITE_PATH
	string "read/write path"
	default "/root" 

config BR2_PACKAGE_AMAZON_IG_TEST_INSTALL_PATH
	string "test install path"
	default "/usr/share/ignition/test"

config BR2_PACKAGE_AMAZON_DTID
	string "Device ID"
	default "A71I8788P1ZV8"
	
config BR2_PACKAGE_AMAZON_CPU_BIT_WIDTH_AND_ENDIANNESS
	string "SOC endianness"
	default "LE32"

config BR2_PACKAGE_AMAZON_USE_ORIGINAL_SOURCES
	bool "Use original sources"
    help
	  This will try to clone the Amazon Code from the official Amazon repo's. Make sure you have access. 
	
endmenu
endif
```

## package/amlogic-boot-fip/Config.in.host
```kconfig
config BR2_PACKAGE_HOST_AMLOGIC_BOOT_FIP
	bool "host amlogic-boot-fip"
	depends on BR2_HOSTARCH = "x86_64"
	help
	  Firmware Image Package (FIP) sources used to sign Amlogic
	  u-boot binaries in LibreELEC images

	  https://github.com/LibreELEC/amlogic-boot-fip

config BR2_PACKAGE_HOST_AMLOGIC_BOOT_FIP_DEVICE
	string "fip device"
	default "khadas-vim3"
	depends on BR2_PACKAGE_HOST_AMLOGIC_BOOT_FIP
	help
	  Device for which you want to use this package.
	  See the list of supported SoCs:
	  https://github.com/LibreELEC/amlogic-boot-fip
```

## package/andes-spi-burn/Config.in.host
```kconfig
config BR2_PACKAGE_HOST_ANDES_SPI_BURN
	bool "host andes-spi-burn"
	depends on BR2_riscv
	help
	  Andes Technology SPI_burn tool to program bootloader and
	  device-tree blob onto flash memory of AE350 platform.

	  https://github.com/andestech/IntelJ3
```

## package/android-tools/Config.in.host
```kconfig
config BR2_PACKAGE_HOST_ANDROID_TOOLS
	bool "host android-tools"
	select BR2_PACKAGE_HOST_ANDROID_TOOLS_ADB if \
		!BR2_PACKAGE_HOST_ANDROID_TOOLS_FASTBOOT
	help
	  This package contains the fastboot and adb utilities, that
	  can be used to interact with target devices using of these
	  protocols.

if BR2_PACKAGE_HOST_ANDROID_TOOLS

config BR2_PACKAGE_HOST_ANDROID_TOOLS_FASTBOOT
	bool "fastboot"
	depends on BR2_HOST_GCC_AT_LEAST_5 # host-libselinux -> host-libsepol
	help
	  This option will build and install the fastboot utility for
	  the host, which can be used to reflash target devices
	  implementing the fastboot protocol.

comment "fastboot needs a toolchain w/ host gcc >= 5"
	depends on !BR2_HOST_GCC_AT_LEAST_5

config BR2_PACKAGE_HOST_ANDROID_TOOLS_ADB
	bool "adb"
	help
	  This option will build and install the adb utility for the
	  host, which can be used to interact with target devices
	  implementing the ADB protocol.

config BR2_PACKAGE_HOST_ANDROID_TOOLS_EXT4_UTILS
	bool "ext4 utils"
	depends on BR2_HOST_GCC_AT_LEAST_5 # host-libselinux -> host-libsepol
	help
	  This option will build and install the ext4 utils for the
	  host, i.e. make_ext4fs, ext4fixup, ext2simg, img2simg,
	  simg2img and simg2simg.

comment "ext4 utils needs a toolchain w/ host gcc >= 5"
	depends on !BR2_HOST_GCC_AT_LEAST_5

endif
```
