## package/apg/Config.in
```kconfig
config BR2_PACKAGE_APG
	bool "apg"
	select BR2_PACKAGE_LIBXCRYPT if BR2_TOOLCHAIN_USES_GLIBC
	help
	  Automated Password Generator (APG).

	  https://github.com/wilx/apg
```

## package/apr/Config.in
```kconfig
config BR2_PACKAGE_APR
	bool "apr"
	# apr really needs shared library support
	depends on !BR2_STATIC_LIBS
	depends on BR2_USE_MMU # fork() in apr_proc_fork()
	select BR2_PACKAGE_LIBXCRYPT if BR2_TOOLCHAIN_USES_GLIBC
	help
	  The mission of the Apache Portable Runtime (APR) project is to
	  create and maintain software libraries that provide a
	  predictable and consistent interface to underlying
	  platform-specific implementations

	  https://apr.apache.org

comment "apr needs a toolchain w/ dynamic library"
	depends on BR2_USE_MMU
	depends on BR2_STATIC_LIBS
```

## package/arm-gnu-toolchain/Config.in.host
```kconfig
config BR2_PACKAGE_HOST_ARM_GNU_TOOLCHAIN_SUPPORTS
	bool
	default y if BR2_HOSTARCH = "aarch64"
	default y if BR2_HOSTARCH = "x86_64"
```

## package/arp-scan/Config.in
```kconfig
config BR2_PACKAGE_ARP_SCAN
	bool "arp-scan"
	select BR2_PACKAGE_LIBPCAP
	help
	  The ARP scanner

	  arp-scan is a command-line tool that uses the ARP protocol to
	  discover and fingerprint IP hosts on the local network.

	  https://github.com/royhills/arp-scan

if BR2_PACKAGE_ARP_SCAN

config BR2_PACKAGE_ARP_SCAN_DATA
	bool "install data (OUI)"
	default y  # legacy
	help
	  Say 'y' here (the default) to install the data along the
	  binaries.

endif # BR2_PACKAGE_ARP_SCAN
```
