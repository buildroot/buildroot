## package/wpe/wpewebkit/Config.in
```kconfig
config BR2_PACKAGE_WPEWEBKIT_ARCH_SUPPORTS
	bool
	# ARM needs BLX, so v5t+, BE completely untested so disabled
	default y if BR2_arm && !BR2_ARM_CPU_ARMV4
	default y if BR2_aarch64 || BR2_aarch64_be
	default y if BR2_i386 || BR2_x86_64
	# Disabled on MIPS big endian due to sigbus
	default y if BR2_mipsel || BR2_mips64el
	# Disabled on PowerPC pending runtime testing
	# Disabled on SuperH because of segfault
	depends on BR2_USE_MMU # libglib2
	depends on BR2_TOOLCHAIN_HAS_SYNC_4
	depends on BR2_PACKAGE_LIBGPG_ERROR_ARCH_SUPPORTS # libgcrypt

comment "wpewebkit needs a toolchain w/ C++, wchar, threads, dynamic library, gcc >= 7"
	depends on BR2_PACKAGE_WPEWEBKIT_ARCH_SUPPORTS
	depends on !BR2_BINFMT_FLAT
	depends on !BR2_INSTALL_LIBSTDCPP || !BR2_USE_WCHAR \
		|| !BR2_TOOLCHAIN_HAS_THREADS || BR2_STATIC_LIBS \
		|| !BR2_TOOLCHAIN_GCC_AT_LEAST_7

comment "wpewebkit needs OpenGL ES and EGL"
	depends on BR2_PACKAGE_WPEWEBKIT_ARCH_SUPPORTS
	depends on !BR2_BINFMT_FLAT
	depends on !BR2_PACKAGE_HAS_LIBGLES || !BR2_PACKAGE_HAS_LIBEGL

config BR2_PACKAGE_WPEWEBKIT
	bool "wpewebkit"
	default y
	depends on !BR2_STATIC_LIBS # wayland
	depends on !BR2_BINFMT_FLAT # icu
	depends on BR2_INSTALL_LIBSTDCPP # harfbuzz, icu
	depends on BR2_TOOLCHAIN_HAS_THREADS # wayland, icu, libsoup
	depends on BR2_TOOLCHAIN_GCC_AT_LEAST_7
	depends on BR2_USE_WCHAR # icu, libsoup
	depends on BR2_PACKAGE_HAS_LIBGLES # libepoxy
	depends on BR2_PACKAGE_HAS_LIBEGL # libepoxy
	depends on BR2_PACKAGE_WPEWEBKIT_ARCH_SUPPORTS
	select BR2_PACKAGE_WPEBACKEND
	select BR2_PACKAGE_WPEBACKEND_RDK
	select BR2_PACKAGE_LIBEPOXY
	select BR2_PACKAGE_CAIRO
	select BR2_PACKAGE_CAIRO_PNG
	select BR2_PACKAGE_JPEG
	select BR2_PACKAGE_LIBPNG
	select BR2_PACKAGE_HARFBUZZ
	select BR2_PACKAGE_ICU
	select BR2_PACKAGE_WEBP
	select BR2_PACKAGE_WEBP_DEMUX
	select BR2_PACKAGE_LIBSOUP
	select BR2_PACKAGE_LIBSOUP_SSL
	select BR2_PACKAGE_LIBGCRYPT
	select BR2_PACKAGE_LIBXSLT
	select BR2_PACKAGE_XKEYBOARD_CONFIG
	select BR2_PACKAGE_OPENJPEG
	help
	  WPEWebkit browser

if BR2_PACKAGE_WPEWEBKIT

choice
        bool "version"
        default BR2_PACKAGE_WPEWEBKIT2_28
        help
          Choose the WPEWEBKIT version to be built.

config BR2_PACKAGE_WPEWEBKIT2_22
        bool "2.22"
        help
          Build WPEWEBKIT 2.22

config BR2_PACKAGE_WPEWEBKIT2_28
        bool "2.28"
        help
          Build WPEWEBKIT 2.28

endchoice

menu "Extra options"

choice
	bool "Debug options"
	default BR2_PACKAGE_WPEWEBKIT_DEBUG if BR2_ENABLE_DEBUG
	default BR2_PACKAGE_WPEWEBKIT_RELEASE
	help
	  Choose the debug flavor.

if !BR2_ENABLE_DEBUG

config BR2_PACKAGE_WPEWEBKIT_RELEASE
	bool "release"
	help
	  Release build

endif

config BR2_PACKAGE_WPEWEBKIT_DEBUG
	bool "debug"
	help
	  Debug build

endchoice

config BR2_PACKAGE_WPEWEBKIT_NO_JSC_OPTIMIZATIONS
        bool "no JSC optimizations"
        default n
        help
          Avoid JSC optimizations such as JIT and FTL so that backtraces involving JS can come up cleaner

if !BR2_PACKAGE_WPEWEBKIT_DEBUG

config BR2_PACKAGE_WPEWEBKIT_SYMBOLS
	bool "add symbols to a release build"
        default y if BR2_PACKAGE_WPEWEBKIT_DEBUG
        default n
	help
	  Add symbols to a release build

endif

if BR2_PACKAGE_WPEWEBKIT2_22

config BR2_PACKAGE_WPEWEBKIT_PREQ
	bool
	default y
	select BR2_PACKAGE_GSTREAMER1
	select BR2_PACKAGE_GST1_PLUGINS_BASE
	select BR2_PACKAGE_GST1_PLUGINS_GOOD
	select BR2_PACKAGE_GST1_PLUGINS_BAD

config BR2_PACKAGE_WPEWEBKIT_USE_WEB_AUDIO
	bool "Web Audio"
	default y
	help
	  Enable Web Audio

config BR2_PACKAGE_WPEWEBKIT_ENABLE_MEDIA_SOURCE
	depends on BR2_PACKAGE_GST1_PLUGINS_GOOD_PLUGIN_ISOMP4
	select BR2_PACKAGE_GST1_PLUGINS_BAD_PLUGIN_DEBUGUTILS if BR2_PACKAGE_GST1_PLUGINS_BAD
	bool "Media Source Extensions (MSE)"
	default y
	help
	  Enable Media Source Extensions

config BR2_PACKAGE_WPEWEBKIT_USE_ENCRYPTED_MEDIA
	bool "Encrypted Media Extensions (EME)"
	default y
        depends on !BR2_PACKAGE_GST1_PLUGINS_BAD_PLUGIN_DASH_MPD_NO_INIT_DATA_XML_PARSING
	help
	  Use Enable Encrypted Media Extensions (EME) API.

config BR2_PACKAGE_WPEWEBKIT_USE_GSTREAMER_GL
	bool "gstreamer-gl"
	depends on BR2_PACKAGE_GST1_PLUGINS_BAD_PLUGIN_GL
	default y if BR2_PACKAGE_WPEWEBKIT_USE_PUNCH_HOLE_NONE
	help
	  Use gstreamer-gl video sink for rendering

config BR2_PACKAGE_WPEWEBKIT_USE_GSTREAMER_WEBKIT_HTTP_SRC
	bool "Use WebKit for Media network resources loading"
	default y if !BR2_PACKAGE_HORIZON_SDK
	help
	  Use the WebKit network resource loader to download Media data over HTTP(S)

config BR2_PACKAGE_WPEWEBKIT_ENABLE_NATIVE_VIDEO
	bool "Enable native video"
	default y
	help
	  Defines ENABLE_NATIVE_VIDEO=ON

config BR2_PACKAGE_WPEWEBKIT_ENABLE_NATIVE_AUDIO
	bool "Enable native audio"
	default n
	help
	  Defines ENABLE_NATIVE_AUDIO=ON

config BR2_PACKAGE_WPEWEBKIT_ENABLE_TEXT_SINK
	bool "Enable text sink"
	default y
	help
	  Defines ENABLE_TEXT_SINK=ON

endif

if BR2_PACKAGE_WPEWEBKIT2_28

config BR2_PACKAGE_WPEWEBKIT_MULTIMEDIA
	bool "multimedia support"
	default y
	select BR2_PACKAGE_GSTREAMER1
	select BR2_PACKAGE_GST1_PLUGINS_BASE
	select BR2_PACKAGE_GST1_PLUGINS_GOOD
	help
	  This option pulls in all of the required dependencies
	  to enable multimedia (video/audio) support.

if BR2_PACKAGE_WPEWEBKIT_MULTIMEDIA

config BR2_PACKAGE_WPEWEBKIT_USE_GSTREAMER_GL
	bool "use gstreamer-gl"
	default y
	depends on BR2_PACKAGE_GST1_PLUGINS_BASE_LIB_OPENGL_OPENGL || BR2_PACKAGE_GST1_PLUGINS_BASE_LIB_OPENGL_GLES2
	help
	  Use the GStreamer GL elements for handling video content.
	  This is recommended as it improves performance of video
	  playback. In some target configurations incorrect rendering
	  might be produced, and disabling this option may help.

endif

config BR2_PACKAGE_WPEWEBKIT_WEBDRIVER
	bool "WebDriver support"
	help
	  Enable support for WebDriver. This will build and install the
	  WebKitWebDriver program in the target.

endif

choice
	bool "Punch hole"
	default BR2_PACKAGE_WPEWEBKIT_USE_PUNCH_HOLE_GSTREAMER if BR2_PACKAGE_GSTREAMER1 && !BR2_PACKAGE_GST1_PLUGINS_BASE_LIB_OPENGL
	default BR2_PACKAGE_WPEWEBKIT_USE_PUNCH_HOLE_NONE
	help
	  Choose the holepunch version.

config BR2_PACKAGE_WPEWEBKIT_USE_PUNCH_HOLE_NONE
	bool "none"
	help
	  Do not use the punch hole.

config BR2_PACKAGE_WPEWEBKIT_USE_PUNCH_HOLE_GSTREAMER
	bool "gstreamer"
	depends on BR2_PACKAGE_GSTREAMER1
	help
	  Use Gstreamer.

config BR2_PACKAGE_WPEWEBKIT_USE_PUNCH_HOLE_EXTERNAL
	bool "external"
	help
	  Use an external player.

endchoice

endmenu

endif
```

## package/wpebackend-rdk/Config.in
```kconfig
config BR2_PACKAGE_WPEBACKEND_RDK
	bool "wpebackend-rdk"
	select BR2_PACKAGE_LIBGLIB2
	select BR2_PACKAGE_LIBINPUT
	select BR2_PACKAGE_LIBWPE
	help
	  RDK-specific implementations of the WPEBackend interfaces.
```

## package/wpewebkit/Config.in
```kconfig
config BR2_PACKAGE_WPEWEBKIT_ARCH_SUPPORTS
	bool
	# ARM needs BLX, so v5t+, BE completely untested so disabled
	default y if BR2_arm && !BR2_ARM_CPU_ARMV4
	default y if BR2_aarch64 || BR2_aarch64_be
	default y if BR2_i386 || BR2_x86_64
	# Disabled on MIPS big endian due to sigbus
	default y if BR2_mipsel || BR2_mips64el
	# Disabled on PowerPC pending runtime testing
	# RISC-V needs the g/imafd ISA.
	default y if BR2_riscv && BR2_RISCV_ISA_RVI \
		&& BR2_RISCV_ISA_RVM && BR2_RISCV_ISA_RVA \
		&& BR2_RISCV_ISA_RVF && BR2_RISCV_ISA_RVD
	# Disabled on SuperH because of segfault
	depends on BR2_USE_MMU # libglib2
	depends on BR2_TOOLCHAIN_HAS_SYNC_4
	depends on BR2_PACKAGE_LIBGPG_ERROR_ARCH_SUPPORTS # libgcrypt

comment "wpewebkit needs a toolchain w/ C++, wchar, NPTL, dynamic library, gcc >= 11, host gcc >= 4.9"
	depends on BR2_PACKAGE_WPEWEBKIT_ARCH_SUPPORTS
	depends on !BR2_BINFMT_FLAT
	depends on !BR2_INSTALL_LIBSTDCPP || !BR2_USE_WCHAR \
		|| !BR2_TOOLCHAIN_HAS_THREADS_NPTL || BR2_STATIC_LIBS \
		|| !BR2_TOOLCHAIN_GCC_AT_LEAST_11 \
		|| !BR2_HOST_GCC_AT_LEAST_4_9

comment "wpewebkit needs an OpenGL ES w/ EGL-capable Wayland backend"
	depends on BR2_PACKAGE_WPEWEBKIT_ARCH_SUPPORTS
	depends on !BR2_BINFMT_FLAT
	depends on !BR2_PACKAGE_HAS_LIBGLES || !BR2_PACKAGE_HAS_LIBEGL

config BR2_PACKAGE_WPEWEBKIT
	bool "wpewebkit"
	depends on !BR2_STATIC_LIBS # wayland
	depends on !BR2_BINFMT_FLAT # icu
	depends on BR2_HOST_GCC_AT_LEAST_4_9 # icu, host-ruby
	depends on BR2_INSTALL_LIBSTDCPP # harfbuzz, icu
	depends on BR2_TOOLCHAIN_HAS_THREADS_NPTL
	depends on BR2_TOOLCHAIN_GCC_AT_LEAST_11
	depends on BR2_USE_WCHAR # icu, libsoup3
	depends on BR2_PACKAGE_HAS_LIBGLES # libepoxy
	depends on BR2_PACKAGE_HAS_LIBEGL # libepoxy
	depends on BR2_PACKAGE_WPEWEBKIT_ARCH_SUPPORTS
	select BR2_PACKAGE_CAIRO if BR2_ENDIAN = "BIG"
	select BR2_PACKAGE_CAIRO_PNG if BR2_ENDIAN = "BIG"
	select BR2_PACKAGE_HARFBUZZ
	select BR2_PACKAGE_ICU
	select BR2_PACKAGE_JPEG
	select BR2_PACKAGE_LIBEPOXY
	select BR2_PACKAGE_LIBGCRYPT
	select BR2_PACKAGE_LIBPNG
	select BR2_PACKAGE_LIBSOUP3
	select BR2_PACKAGE_LIBTASN1
	select BR2_PACKAGE_LIBXSLT
	select BR2_PACKAGE_WAYLAND
	select BR2_PACKAGE_WAYLAND_PROTOCOLS
	select BR2_PACKAGE_WEBP
	select BR2_PACKAGE_WEBP_DEMUX
	select BR2_PACKAGE_WEBP_MUX
	select BR2_PACKAGE_WPEBACKEND_FDO
	help
	  WPE (Web Platform for Embedded) port of the WebKit engine,
	  to allow embedders to create simple and performant systems
	  based on Web platform technologies.

	  https://wpewebkit.org/

if BR2_PACKAGE_WPEWEBKIT

config BR2_PACKAGE_WPEWEBKIT_SANDBOX
	bool "sandboxing support"
	depends on BR2_PACKAGE_LIBSECCOMP_ARCH_SUPPORTS # libseccomp
	depends on BR2_TOOLCHAIN_HEADERS_AT_LEAST_3_12 # libseccomp
	select BR2_PACKAGE_BUBBLEWRAP # runtime
	select BR2_PACKAGE_XDG_DBUS_PROXY # runtime
	select BR2_PACKAGE_LIBSECCOMP
	help
	  Enable sandboxing of the processes used for network operation,
	  disk asccess, and Web content rendering.

comment "sandboxing supports needs a toolchain w/ headers >= 3.12"
	depends on BR2_PACKAGE_LIBSECCOMP_ARCH_SUPPORTS
	depends on !BR2_TOOLCHAIN_HEADERS_AT_LEAST_3_12

config BR2_PACKAGE_WPEWEBKIT_MULTIMEDIA
	bool "multimedia support"
	select BR2_PACKAGE_GSTREAMER1
	select BR2_PACKAGE_GST1_PLUGINS_BAD
	select BR2_PACKAGE_GST1_PLUGINS_BAD_PLUGIN_DEBUGUTILS
	select BR2_PACKAGE_GST1_PLUGINS_BAD_PLUGIN_MPEGTSDEMUX
	select BR2_PACKAGE_GST1_PLUGINS_BAD_PLUGIN_SUBENC
	select BR2_PACKAGE_GST1_PLUGINS_BASE
	select BR2_PACKAGE_GST1_PLUGINS_BASE_PLUGIN_ALSA
	select BR2_PACKAGE_GST1_PLUGINS_BASE_PLUGIN_APP
	select BR2_PACKAGE_GST1_PLUGINS_BASE_PLUGIN_AUDIOCONVERT
	select BR2_PACKAGE_GST1_PLUGINS_BASE_PLUGIN_AUDIORESAMPLE
	select BR2_PACKAGE_GST1_PLUGINS_BASE_PLUGIN_PLAYBACK
	select BR2_PACKAGE_GST1_PLUGINS_BASE_PLUGIN_VIDEOCONVERTSCALE
	select BR2_PACKAGE_GST1_PLUGINS_BASE_PLUGIN_VOLUME
	select BR2_PACKAGE_GST1_PLUGINS_GOOD
	select BR2_PACKAGE_GST1_PLUGINS_GOOD_PLUGIN_AUDIOFX
	select BR2_PACKAGE_GST1_PLUGINS_GOOD_PLUGIN_AUTODETECT
	select BR2_PACKAGE_GST1_PLUGINS_GOOD_PLUGIN_ISOMP4
	select BR2_PACKAGE_GST1_PLUGINS_GOOD_PLUGIN_MATROSKA
	select BR2_PACKAGE_GST1_PLUGINS_GOOD_PLUGIN_RTSP
	select BR2_PACKAGE_GST1_PLUGINS_GOOD_PLUGIN_VPX
	select BR2_PACKAGE_GST1_LIBAV
	help
	  This option pulls in all of the required dependencies
	  to enable multimedia (video/audio) support.

if BR2_PACKAGE_WPEWEBKIT_MULTIMEDIA

config BR2_PACKAGE_WPEWEBKIT_MEDIA_STREAM
	bool "media-stream support"
	select BR2_PACKAGE_GST1_PLUGINS_BASE_PLUGIN_VIDEORATE
	help
	  This option enables media-stream support.

config BR2_PACKAGE_WPEWEBKIT_USE_GSTREAMER_GL
	bool "use gstreamer-gl"
	default y
	depends on BR2_PACKAGE_GST1_PLUGINS_BASE_LIB_OPENGL_HAS_PLATFORM
	help
	  Use the GStreamer GL elements for handling video content.
	  This is recommended as it improves performance of video
	  playback. In some target configurations incorrect rendering
	  might be produced, and disabling this option may help.

endif

config BR2_PACKAGE_WPEWEBKIT_WEBDRIVER
	bool "WebDriver support"
	help
	  Enable support for WebDriver. This will build and install the
	  WebKitWebDriver program in the target.

endif
```

## package/wrp-c/Config.in
```kconfig
config BR2_PACKAGE_WRP_C
    bool "wrp-c"
    default n
    help
      C library for Web Routing Protocol (WRP)
```

## package/wtfutil/Config.in
```kconfig
config BR2_PACKAGE_WTFUTIL
	bool "wtfutil"
	depends on BR2_USE_MMU  # fork()
	depends on BR2_PACKAGE_HOST_GO_TARGET_ARCH_SUPPORTS
	select BR2_PACKAGE_HOST_GO
	help
	  WTF is the personal information dashboard for your terminal.

	  https://wtfutil.com/
```

## package/x11r7/xdriver_xf86-video-amdgpu/Config.in
```kconfig
config BR2_PACKAGE_XDRIVER_XF86_VIDEO_AMDGPU
	bool "xf86-video-amdgpu"
	depends on BR2_USE_MMU # libdrm
	depends on BR2_PACKAGE_HAS_LIBGBM
	select BR2_PACKAGE_LIBDRM
	select BR2_PACKAGE_LIBDRM_AMDGPU
	select BR2_PACKAGE_LIBEPOXY
	select BR2_PACKAGE_XLIB_LIBXCOMPOSITE
	select BR2_PACKAGE_XORGPROTO
	help
	  AMD GPU video driver

comment "xf86-video-amdgpu needs GBM"
	depends on BR2_USE_MMU
	depends on !BR2_PACKAGE_HAS_LIBGBM
```

## package/x11r7/xdriver_xf86-video-mga/Config.in
```kconfig
config BR2_PACKAGE_XDRIVER_XF86_VIDEO_MGA
	bool "xf86-video-mga"
	select BR2_PACKAGE_LIBDRM
	select BR2_PACKAGE_XORGPROTO
	help
	  Matrox video driver
```

## package/x11r7/xdriver_xf86-video-nouveau/Config.in
```kconfig
config BR2_PACKAGE_XDRIVER_XF86_VIDEO_NOUVEAU
	bool "xf86-video-nouveau"
	depends on BR2_PACKAGE_HAS_LIBGL
	select BR2_PACKAGE_LIBDRM
	select BR2_PACKAGE_LIBDRM_NOUVEAU
	select BR2_PACKAGE_XORGPROTO
	help
	  Nouveau video driver

	  http://nouveau.freedesktop.org

comment "xf86-video-nouveau needs an OpenGL backend"
	depends on !BR2_PACKAGE_HAS_LIBGL
```

## package/x11r7/xdriver_xf86-video-openchrome/Config.in
```kconfig
config BR2_PACKAGE_XDRIVER_XF86_VIDEO_OPENCHROME
	bool "xf86-video-openchrome"
	depends on BR2_PACKAGE_HAS_LIBGL
	select BR2_PACKAGE_LIBDRM
	select BR2_PACKAGE_XLIB_LIBX11
	select BR2_PACKAGE_XLIB_LIBXCOMPOSITE
	select BR2_PACKAGE_XLIB_LIBXVMC
	select BR2_PACKAGE_XORGPROTO
	help
	  Openchrome, A free and Open Source video driver for the
	  VIA/S3G UniChrome and UniChrome Pro graphics chipsets.

	  https://www.freedesktop.org/wiki/Openchrome/

comment "xf86-video-openchrome needs an OpenGL backend"
	depends on !BR2_PACKAGE_HAS_LIBGL
```

## package/x11r7/xdriver_xf86-video-savage/Config.in
```kconfig
config BR2_PACKAGE_XDRIVER_XF86_VIDEO_SAVAGE
	bool "xf86-video-savage"
	select BR2_PACKAGE_LIBDRM
	select BR2_PACKAGE_XORGPROTO
	help
	  S3 Savage video driver
```

## package/x11r7/xdriver_xf86-video-sis/Config.in
```kconfig
config BR2_PACKAGE_XDRIVER_XF86_VIDEO_SIS
	bool "xf86-video-sis"
	select BR2_PACKAGE_LIBDRM
	select BR2_PACKAGE_XORGPROTO
	help
	  SiS and XGI video driver
```

## package/x11r7/xdriver_xf86-video-tdfx/Config.in
```kconfig
config BR2_PACKAGE_XDRIVER_XF86_VIDEO_TDFX
	bool "xf86-video-tdfx"
	select BR2_PACKAGE_LIBDRM
	select BR2_PACKAGE_XORGPROTO
	help
	  3Dfx video driver
```

## package/x11r7/xlib_libxcvt/Config.in
```kconfig
config BR2_PACKAGE_XLIB_LIBXCVT
	bool "libxcvt"
	help
	  libxcvt is a library providing a standalone version of the X
	  server implementation of the VESA CVT standard timing mode-
	  lines generator.

	  https://gitlab.freedesktop.org/xorg/lib/libxcvt
```
