## package/wpe/wpeframework-cdmi/wpeframework-cdmi-playready-vgdrm/Config.in
```kconfig
config BR2_PACKAGE_WPEFRAMEWORK_CDMI_PLAYREADY_VGDRM
	bool "vgdrm"
	select BR2_PACKAGE_WPEFRAMEWORK_PLUGINS
	select BR2_PACKAGE_WPEFRAMEWORK_CDM
	depends on BR2_PACKAGE_VSS_SDK
	default n
	help
	  PlayReady using Video Guard DRM
```

## package/wpe/wpeframework-cdmi/wpeframework-cdmi-playready/Config.in
```kconfig
config BR2_PACKAGE_WPEFRAMEWORK_CDMI_PLAYREADY
	bool "playready (software)"
	select BR2_PACKAGE_WPEFRAMEWORK_PLUGINS
	select BR2_PACKAGE_WPEFRAMEWORK_CDM
	select BR2_PACKAGE_PLAYREADY if (!BR2_PACKAGE_BCM_REFSW_SAGE && !BR2_PACKAGE_PROVIDES_NEXUS_SAGE)
	default n
	help
	  PlayReady
```

## package/wpe/wpeframework-cdmi/wpeframework-cdmi-widevine-nexus-svp/Config.in
```kconfig
config BR2_PACKAGE_WPEFRAMEWORK_CDMI_WIDEVINE_NEXUS_SVP
	bool "widevine"
	select BR2_PACKAGE_WPEFRAMEWORK_PLUGINS
	select BR2_PACKAGE_WPEFRAMEWORK_CDM
    default n
	help
	  Broadcom WideVine SVP SAGE implementation
```

## package/wpe/wpeframework-cdmi/wpeframework-cdmi-widevine/Config.in
```kconfig
config BR2_PACKAGE_WPEFRAMEWORK_CDMI_WIDEVINE
	bool "widevine"
	depends on BR2_PACKAGE_WIDEVINE
	select BR2_PACKAGE_WPEFRAMEWORK_PLUGINS
	select BR2_PACKAGE_WPEFRAMEWORK_CDM
	default y
	help
	  WideVine
```

## package/wpe/wpeframework-cobalt/Config.in
```kconfig
menuconfig BR2_PACKAGE_WPEFRAMEWORK_COBALT
	bool "Cobalt"
    select BR2_PACKAGE_COBALT
	help
	   WPE Platform Cobalt plugin

if BR2_PACKAGE_WPEFRAMEWORK_COBALT

config BR2_PACKAGE_WPEFRAMEWORK_COBALT_AUTOSTART
    bool "Start Automatically"
    default n
    help
      Select this to start the plugin automatically when starting WPEFramework

config BR2_PACKAGE_WPEFRAMEWORK_COBALT_OUTOFPROCESS
    bool "Out of process"
    default y
    help
      Select this to run this plugin in its own process.
endif
```

## package/wpe/wpeframework-common/Config.in
```kconfig
config BR2_PACKAGE_WPEFRAMEWORK_COMMON
	bool

config BR2_PACKAGE_WPEFRAMEWORK_COMMANDER
        select BR2_PACKAGE_WPEFRAMEWORK_COMMON
	bool "Commander"
	help
	   Commander Plugin

menuconfig BR2_PACKAGE_WPEFRAMEWORK_DEVICEINFO
        select BR2_PACKAGE_WPEFRAMEWORK_COMMON
	bool "DeviceInfo"
	help
	   DeviceInfo Plugin

menuconfig BR2_PACKAGE_WPEFRAMEWORK_LOCATIONSYNC
        select BR2_PACKAGE_WPEFRAMEWORK_COMMON
	bool "LocationSync"
	help
	   LocationSync Plugin
	   WPE Platform Dictionary plugin
	   
if BR2_PACKAGE_WPEFRAMEWORK_LOCATIONSYNC
config BR2_PACKAGE_WPEFRAMEWORK_LOCATIONSYNC_URI
	string "location URI"
	default "location.webplatformforembedded.org"
endif	   

config BR2_PACKAGE_WPEFRAMEWORK_MONITOR
        select BR2_PACKAGE_WPEFRAMEWORK_COMMON
        bool "Monitor"
        help
           Monitor Plugin

config BR2_PACKAGE_WPEFRAMEWORK_TIMESYNC
        select BR2_PACKAGE_WPEFRAMEWORK_COMMON
	bool "TimeSync"
	help
	   TimeSync Plugin

menuconfig BR2_PACKAGE_WPEFRAMEWORK_REMOTECONTROL
        select BR2_PACKAGE_WPEFRAMEWORK_COMMON
	bool "RemoteControl"
	help
	   RemoteControl Plugin

if BR2_PACKAGE_WPEFRAMEWORK_REMOTECONTROL

config BR2_PACKAGE_WPEFRAMEWORK_REMOTECONTROL_IR
    bool "IR (Infrared)"
    help
       Select devices which are based on Infrared (IR) technology

config BR2_PACKAGE_WPEFRAMEWORK_REMOTECONTROL_IRNEXUS
    bool "BCM Nexus IR Remote Control Unit"
    default false
    depends on BR2_PACKAGE_BCM_REFSW && BR2_PACKAGE_WPEFRAMEWORK_REMOTECONTROL_IR
    help
       Enable the Nexus IR remote input

config BR2_PACKAGE_WPEFRAMEWORK_REMOTECONTROL_IRNEXUS_MODE
    string "IR mode"
    default "16"
    depends on BR2_PACKAGE_WPEFRAMEWORK_REMOTECONTROL_IRNEXUS
    help
       Sets the IR Mode to be used with IR Nexus. Every remote has a different mode and key mapping.

config BR2_PACKAGE_WPEFRAMEWORK_REMOTECONTROL_IRNEXUS_CODEMASK
    string "IR code mask"
    depends on BR2_PACKAGE_WPEFRAMEWORK_REMOTECONTROL_IRNEXUS
    help
       Sets a key code mask if the device generates same code based on trigger bit

config BR2_PACKAGE_WPEFRAMEWORK_REMOTECONTROL_RF
    bool "RF (Radio Frequency)"
    help
       Select devices which are based on Radio Frequency (RF) technology

endif

config BR2_PACKAGE_WPEFRAMEWORK_SNAPSHOT
        select BR2_PACKAGE_WPEFRAMEWORK_COMMON
	bool "Snapshot"
	help
	   Snapshot Plugin

config BR2_PACKAGE_WPEFRAMEWORK_TRACECONTROL
        select BR2_PACKAGE_WPEFRAMEWORK_COMMON
	bool "TraceControl"
	help
	   TraceControl Plugin

menuconfig BR2_PACKAGE_WPEFRAMEWORK_WEBKITBROWSER
        select BR2_PACKAGE_WPEFRAMEWORK_COMMON
	bool "WebKitBrowser"
	depends on BR2_PACKAGE_WPEWEBKIT
	help
	   WebKitBrowser Plugin

if BR2_PACKAGE_WPEFRAMEWORK_WEBKITBROWSER

config BR2_PACKAGE_WPEFRAMEWORK_WEBKITBROWSER_AUTOSTART
    bool "autostart"
    default y

config BR2_PACKAGE_WPEFRAMEWORK_WEBKITBROWSER_STARTURL
    string "start-url"
    default "about:blank"

config BR2_PACKAGE_WPEFRAMEWORK_WEBKITBROWSER_USERAGENT
    string "useragent"
    default "Mozilla/5.0 (Macintosh, Intel Mac OS X 10_11_4) AppleWebKit/602.1.28+ (KHTML, like Gecko) Version/9.1 Safari/601.5.17"

config BR2_PACKAGE_WPEFRAMEWORK_WEBKITBROWSER_MEMORYPROFILE
    string "memory-profile"
    default "128m"

config BR2_PACKAGE_WPEFRAMEWORK_WEBKITBROWSER_MEMORYPRESSURE
    string "memory-pressure"
    default "databaseprocess:50m,networkprocess:100m,webprocess:300m,rpcprocess:50m"

config BR2_PACKAGE_WPEFRAMEWORK_WEBKITBROWSER_MEDIADISKCACHE
    bool "media-disk-cache"
    default n

config BR2_PACKAGE_WPEFRAMEWORK_WEBKITBROWSER_DISKCACHE
    string "disk-cache"
    default "0"

config BR2_PACKAGE_WPEFRAMEWORK_WEBKITBROWSER_XHRCACHE
    bool "xhr-cache"
    default false

config BR2_PACKAGE_WPEFRAMEWORK_WEBKITBROWSER_TRANSPARENT
    bool "transparent"
    default false

config BR2_PACKAGE_WPEFRAMEWORK_YOUTUBE
    bool "youtube"
    help
      A wrapper around the youtube app to start it as a
      wpeframework plugin.

endif

config BR2_PACKAGE_WPEFRAMEWORK_WEBPROXY
        select BR2_PACKAGE_WPEFRAMEWORK_COMMON
	bool "WebProxy"
	help
	   WebProxy Plugin

config BR2_PACKAGE_WPEFRAMEWORK_WEBSERVER
        select BR2_PACKAGE_WPEFRAMEWORK_COMMON
        bool "WebServer"
        help
           WebServer Plugin


config BR2_PACKAGE_WPEFRAMEWORK_WEBSHELL
        select BR2_PACKAGE_WPEFRAMEWORK_COMMON
	bool "WebShell"
	help
	   WebShell Plugin
```

## package/wpe/wpeframework-compositor/Config.in
```kconfig
menuconfig BR2_PACKAGE_WPEFRAMEWORK_COMPOSITOR
	bool "Compositor"
	help
	   WPE Platform Compositor plugin

if BR2_PACKAGE_WPEFRAMEWORK_COMPOSITOR

if BR2_PACKAGE_BCM_REFSW
config BR2_PACKAGE_WPEFRAMEWORK_COMPOSITOR_NEXUS_SERVER
	bool "Nexus server"
	help
	  Choose this if the system has a already a resource server running like nxserver.

if BR2_PACKAGE_WPEFRAMEWORK_COMPOSITOR_NEXUS_SERVER
config BR2_PACKAGE_WPEFRAMEWORK_COMPOSITOR_SERVICE_EXTERNAL
    bool "External Compositor"
    help
        The master compositor is hosted in a different process. WPEFramework will attach to it.

config BR2_PACKAGE_WPEFRAMEWORK_COMPOSITOR_SERVICE_INTERNAL
    bool "Internal Compositor"
    help
        The master compositor is hosted in WPEFramework.

endif
endif

config BR2_PACKAGE_WPEFRAMEWORK_COMPOSITOR_AUTOTRACE
   bool "Enable Tracing at startup"
   help 
     If enabled the compositer plug-in will start tracing 
     when WPEFramework is started.
     
config BR2_PACKAGE_WPEFRAMEWORK_COMPOSITOR_OUTOFPROCESS
	bool "Out of process"
	help
	  Select this to run this plugin in its own process. 
     
config BR2_PACKAGE_WPEFRAMEWORK_COMPOSITOR_HARDWAREREADY
	string "Manual overrule of the time it takes to initialisize all hardware (ms)"
	default 0

config BR2_PACKAGE_WPEFRAMEWORK_COMPOSITOR_SYSTEM
	string "Callsign to report information."
	default Controller

endif
```

## package/wpe/wpeframework-cryptography/Config.in
```kconfig
menuconfig BR2_PACKAGE_WPEFRAMEWORK_CRYPTOGRAPHY
	bool "Cryptography"
	depends on BR2_PACKAGE_WPEFRAMEWORK
	help
	   WPE Platform cryptography abstraction

if BR2_PACKAGE_WPEFRAMEWORK_CRYPTOGRAPHY 

choice WPEFRAMEWORK_CRYPTOGRAPHY_IMP
	prompt "Implementation"
	default WPEFRAMEWORK_CRYPTOGRAPHY_IMPL_THUNDER
	help
	  Choose implementation type.

config WPEFRAMEWORK_CRYPTOGRAPHY_IMPL_THUNDER
	bool "Thunder"
	help
	  Use Thunder as cryptography backend.

config WPEFRAMEWORK_CRYPTOGRAPHY_IMPL_OPENSSL
	bool "OpenSSL"
	help
	  Use Openssl as cryptography backend.

config WPEFRAMEWORK_CRYPTOGRAPHY_IMPL_NEXUS
	bool "Nexus"
	depends on BR2_PACKAGE_HAS_NEXUS
	help
	  Use Nexus as cryptography backend.

endchoice 

endif 

comment "Cryptography needs WPEFramework"
	depends on !BR2_PACKAGE_WPEFRAMEWORK 
```

## package/wpe/wpeframework-devtools/Config.in
```kconfig
menu "development tools"

config BR2_PACKAGE_WPEFRAMEWORK_VERBOSE_BUILD
	bool "Verbose build"
	help
	   Allow the WPE Framework build to be more verbose. This will show build 
	   settings for all targets built, as well as details for packages found.
 
config BR2_PACKAGE_WPEFRAMEWORK_INSTALL_HEADERS
	bool "Install development header"
	help
	   Install headers to the target for development.
 
config BR2_PACKAGE_WPEFRAMEWORK_DISABLE_INITD
	bool "Disable init.d"
	help
		If enabled the init.d script will NOT be installed.
		
menu "test applications"

config BR2_PACKAGE_WPEFRAMEWORK_TEST_CYCLICINSPECTOR
	bool "CyclicBuffer inspector"
	help
		CyclicInspector is a small tool that allows you to inspect the
		contents of the memory mapped file used by the CyclicBuffer.
		This can be helpful during a post-mortem of a crashed program or
		when tracing failed.


config BR2_PACKAGE_WPEFRAMEWORK_TEST_LOADER
	bool "Test loader"
	help
		TestLoader is a verification and analyze tool for 
		WPEFramework software and plugins.

config BR2_PACKAGE_WPEFRAMEWORK_NETWORKTEST
	bool "NetworkTest"
	help
		NetworkTest is a verification and analyze tool for 
		WPEFramework software network functionality.

config BR2_PACKAGE_WPEFRAMEWORK_OUTOFPROCESSTEST
	bool "OutOfProcessPlugin"
	help
		out of Process test plugin to teste several features of Thunder

config BR2_PACKAGE_WPEFRAMEWORK_TEST_RPCLINK
	bool "RPC link test"
	help
		RPCLINK test tests the usage of RPC calls to out of process plugins.

config BR2_PACKAGE_WPEFRAMEWORK_EGLTEST
	select BR2_PACKAGE_WPEFRAMEWORK_COMMON
	bool "EGLTest"
	help
	   EGLTest Plugin

config BR2_PACKAGE_WPEFRAMEWORK_LINUX_ONEWIRE
	select BR2_PACKAGE_WPEFRAMEWORK_COMMON
	bool "Linux1Wire"
	help
	   Test application for the Core (Netlink/Connector) functionality.

config BR2_PACKAGE_WPEFRAMEWORK_EXAMPLEJSONRPC
	select BR2_PACKAGE_WPEFRAMEWORK_COMMON
	bool "jsonrpc example"
        default n
	help
	   Test application for the JSONRPC functionality.

config BR2_PACKAGE_WPEFRAMEWORK_TEST_UNITTESTS
   select BR2_PACKAGE_GTEST
	bool "Unit Tests"
	help
	   Builds Unit Tests

endmenu

endmenu
```

## package/wpe/wpeframework-dialserver/Config.in
```kconfig
config BR2_PACKAGE_WPEFRAMEWORK_DIALSERVER
	bool "DIALServer"
    default n
	help
	   WPE Platform DIALServer plugin
```

## package/wpe/wpeframework-doofah/Config.in
```kconfig
comment "WPEFramework Doofah plugin needs wpeframework"
	depends on !BR2_PACKAGE_WPEFRAMEWORK

menuconfig BR2_PACKAGE_WPEFRAMEWORK_DOOFAH
    bool "Doofah"
    depends on BR2_PACKAGE_WPEFRAMEWORK
    help
    	Plugin to act as a remote control on your test
    	workbench

if BR2_PACKAGE_WPEFRAMEWORK_DOOFAH 
config BR2_PACKAGE_WPEFRAMEWORK_DOOFAH_AUTOSTART
    bool "Start Automatically"
    default y
    help
      Select this to start the plugin automatically when starting WPEFramework

config BR2_PACKAGE_WPEFRAMEWORK_DOOFAH_CONNECTOR_CONFIG
    string "Connector config"
    help
      Set a custom connector configutarion 

endif
```

## package/wpe/wpeframework-dsgccclient/Config.in
```kconfig
config BR2_PACKAGE_WPEFRAMEWORK_DSGCC_CLIENT
    bool "DsgccClient"
    help
       WPE Platform Dsgcc Client plugin
```

## package/wpe/wpeframework-launcher/Config.in
```kconfig
config BR2_PACKAGE_WPEFRAMEWORK_LAUNCHER
	bool "Launcher"
        default n
	help
	   WPE Platform Launcher plugin
           This plugin can be used as a *temporary* solution
           to launch linux applications and linux scripts.
```

## package/wpe/wpeframework-linearbroadcastplayer/Config.in
```kconfig
config BR2_PACKAGE_WPEFRAMEWORK_LINEARBROADCASTPLAYER
	bool "LinearBroadcastPlayer"
	help
	   WPE Platform LinearBroadcastPlayer plugin
```
