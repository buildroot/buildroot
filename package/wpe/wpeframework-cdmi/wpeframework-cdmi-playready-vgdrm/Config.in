## package/wpe/wpeframework-netflix/Config.in
```kconfig
menuconfig BR2_PACKAGE_WPEFRAMEWORK_NETFLIX
    bool "Netflix"
    depends on BR2_PACKAGE_NETFLIX_LIB || BR2_PACKAGE_NETFLIX5_LIB || BR2_PACKAGE_NETFLIX52_LIB
    help
        WPE Platform Netflix plugin

if BR2_PACKAGE_WPEFRAMEWORK_NETFLIX

config BR2_PACKAGE_WPEFRAMEWORK_PLUGIN_NETFLIX_AUTOSTART
    depends on BR2_PACKAGE_WPEFRAMEWORK_NETFLIX
    bool "autostart"
    default n
menu "DPI options"
  config BR2_PACKAGE_WPEFRAMEWORK_PLUGIN_NETFLIX_MODEL
      depends on BR2_PACKAGE_WPEFRAMEWORK_NETFLIX
      string "model"
      default "Metrological Reference DPI Implementation"

  config BR2_PACKAGE_WPEFRAMEWORK_PLUGIN_NETFLIX_FRIENDLY_NAME
      depends on BR2_PACKAGE_WPEFRAMEWORK_NETFLIX
      string "friendly name"
      default "Metrological Netflix Implementation"

  config BR2_PACKAGE_WPEFRAMEWORK_PLUGIN_NETFLIX_VERSION_POSTFIX
      depends on BR2_PACKAGE_WPEFRAMEWORK_NETFLIX
      string "version postfix"
      default ""

  config BR2_PACKAGE_WPEFRAMEWORK_PLUGIN_NETFLIX_VIDEO_BUFFER_SIZE
      string "video buffer"
      default "193986560"
      help
          Video buffer capacity in bytes

  config BR2_PACKAGE_WPEFRAMEWORK_PLUGIN_NETFLIX_AUDIO_BUFFER_SIZE
      string "audio buffer"
      default "2621440"
      help
          Audio buffer capacity in bytes

  config BR2_PACKAGE_WPEFRAMEWORK_PLUGIN_NETFLIX_DISK_CACHE_SIZE
      string "disk cache"
      default "31457280"
      help
          Disk cache capacity in bytes

  config BR2_PACKAGE_WPEFRAMEWORK_PLUGIN_NETFLIX_SURFACE_CACHE_SIZE
      string "surface cache"
      default "36700160"
      help
          Surface cache capacity in bytes

  config BR2_PACKAGE_WPEFRAMEWORK_PLUGIN_NETFLIX_APPBOOTKEY
      depends on BR2_PACKAGE_WPEFRAMEWORK_NETFLIX
      string "appbootkey"
      help
          "Define a custom appbootkey, if left empty the built in key from Netflix will be used"

  menu "Audio codecs"

  config BR2_PACKAGE_WPEFRAMEWORK_PLUGIN_NETFLIX_DDP2
  	bool "DDP 2.0"
  	help
  	  Enable DDP 2.0

  config BR2_PACKAGE_WPEFRAMEWORK_PLUGIN_NETFLIX_DDP5_1
  	bool "DDP 5.1"
  	help
  	  Enable DDP 5.1

  config BR2_PACKAGE_WPEFRAMEWORK_PLUGIN_NETFLIX_DOLBY_ATMOS
  	bool "Dolby Atmos"
  	help
  	  Enable Dolby Atmos support

  endmenu

  menu "Video codecs"

  config BR2_PACKAGE_WPEFRAMEWORK_PLUGIN_VIDEO_AVC_HIGH
  	bool "avc-high"
  	help
  	  Enable AVC High support

  config BR2_PACKAGE_WPEFRAMEWORK_PLUGIN_NETFLIX_HDR10
  	bool "HDR10"
  	help
  	  Enable HDR10 support

  config BR2_PACKAGE_WPEFRAMEWORK_PLUGIN_NETFLIX_DOLBY_VISION
  	bool "Dolby Vision"
  	help
  	  Enable Dolby Vision support

  config BR2_PACKAGE_WPEFRAMEWORK_PLUGIN_NETFLIX_HEVC
  	bool "HEVC"
  	help
  	  Enable HEVC support

  config BR2_PACKAGE_WPEFRAMEWORK_PLUGIN_NETFLIX_VP9_P0
  	bool "VP9 profile 0"
  	help
  	  Enable VP9 profile 0 support

  config BR2_PACKAGE_WPEFRAMEWORK_PLUGIN_NETFLIX_VP9_P2
  	bool "VP9 profile 2"
  	help
  	  Enable VP9 profile 2 support

  config BR2_PACKAGE_WPEFRAMEWORK_PLUGIN_NETFLIX_VP9_HDR
  	bool "VP9 HDR"
  	help
  	  Enable VP9 HDR support

  endmenu

  config BR2_PACKAGE_WPEFRAMEWORK_PLUGIN_NETFLIX_DEFAULT_LAUGUAGE
  	string "Default lauguage"
  	default "en"
  	help
  	  define the default language
endmenu

config BR2_PACKAGE_WPEFRAMEWORK_PLUGIN_NETFLIX_SUSPEND_TIMEOUT
    depends on BR2_PACKAGE_WPEFRAMEWORK_NETFLIX
    int "suspend timeout"
    range 0 300000
    default 5000
    help
        Suspend timeout in milliseconds. If timeout is exceeded, deactivate application.
        min. 0 millisecond
        max. 300000 milliseconds

config BR2_PACKAGE_WPEFRAMEWORK_PLUGIN_NETFLIX_RESUME_TIMEOUT
    depends on BR2_PACKAGE_WPEFRAMEWORK_NETFLIX
    int "resume timeout"
    range 0 300000
    default 30000
    help
        Resume timeout in milliseconds. If timeout is exceeded, deactivate application.
        min. 0 millisecond
        max. 300000 milliseconds

config BR2_PACKAGE_WPEFRAMEWORK_PLUGIN_NETFLIX_FULLHD
    depends on BR2_PACKAGE_WPEFRAMEWORK_NETFLIX
    bool "fullhd"
    default n

config BR2_PACKAGE_WPEFRAMEWORK_PLUGIN_NETFLIX_HIGHRESUI
    depends on BR2_PACKAGE_WPEFRAMEWORK_NETFLIX
    bool "high resolution (1080p) UI"
    default n

config BR2_PACKAGE_WPEFRAMEWORK_PLUGIN_NETFLIX_KEY_REPEAT_DELAY
    depends on BR2_PACKAGE_WPEFRAMEWORK_NETFLIX
    int "key repeat delay"
    default 1000
    help
        Key repeat delay in milliseconds.

config BR2_PACKAGE_WPEFRAMEWORK_PLUGIN_NETFLIX_APPBOOTKEY
    depends on BR2_PACKAGE_WPEFRAMEWORK_NETFLIX
    string "appbootkey"
    help
        "Define a custom appbootkey, if left empty the built in key from Netflix will be used. Leave empty to use the default key"

config BR2_PACKAGE_WPEFRAMEWORK_PLUGIN_NETFLIX_DEVICE_KEYS
    depends on BR2_PACKAGE_WPEFRAMEWORK_NETFLIX
    string "device keys"
    help 
        "Define the location where the hareware bound ESN and encryption keys can be found. Leave empty to disable"

config BR2_PACKAGE_WPEFRAMEWORK_NETFLIX_USER
    string "user"
    help
        The user that amazon prime should use (root is not allowed)

config BR2_PACKAGE_WPEFRAMEWORK_NETFLIX_GROUP
    string "group"
    default BR2_PACKAGE_WPEFRAMEWORK_NETFLIX_USER
    help
        The group that amazon prime user should use (root is not allowed)

endif

comment "netflix is dependent on the netflix package compiled as library"
    depends on !BR2_PACKAGE_NETFLIX_LIB && !BR2_PACKAGE_NETFLIX5_LIB && !BR2_PACKAGE_NETFLIX52_LIB
```

## package/wpe/wpeframework-packager/Config.in
```kconfig
config BR2_PACKAGE_WPEFRAMEWORK_PACKAGER
	bool "Packager"
	depends on BR2_PACKAGE_WPEFRAMEWORK_PROVISIONPROXY
        select BR2_PACKAGE_OPKG
	help
	   WPE Platform Packager plugin

comment "Packager is dependent on the provision proxy wpeframework extension"
    depends on !BR2_PACKAGE_WPEFRAMEWORK_PROVISIONPROXY
```

## package/wpe/wpeframework-playgiga/Config.in
```kconfig
config BR2_PACKAGE_WPEFRAMEWORK_PLAYGIGA
	bool "PlayGiga"
	depends on BR2_PACKAGE_PLAYGIGA
	help
	   WPE Platform PlayGiga plugin
```

## package/wpe/wpeframework-poc/Config.in
```kconfig
menuconfig BR2_PACKAGE_WPEFRAMEWORK_POC
	bool "Concept plugins"
	help
	   WPE Platform plugins to prove a concept.

if BR2_PACKAGE_WPEFRAMEWORK_POC
source "package/wpe/wpeframework-poc/wpeframework-spotify/Config.in"
source "package/wpe/wpeframework-poc/wpeframework-wifi/Config.in"
endif
```

## package/wpe/wpeframework-poc/wpeframework-wifi/Config.in
```kconfig
config BR2_PACKAGE_WPEFRAMEWORK_WIFI
	select BR2_PACKAGE_WPA_SUPPLICANT
	select BR2_PACKAGE_READLINE
	bool "WPE Plugin for Wifi access"
	help
          Todo

if BR2_PACKAGE_WPEFRAMEWORK_WIFI
# options for the plugin
endif
```

## package/wpe/wpeframework-power/Config.in
```kconfig
config BR2_PACKAGE_WPEFRAMEWORK_POWER
	bool "PowerControl"
	help
	   WPE Platform PowerControl plugin
```

## package/wpe/wpeframework-provisioning/Config.in
```kconfig
menuconfig BR2_PACKAGE_WPEFRAMEWORK_PROVISIONING
	bool "Provisioning"
	select BR2_PACKAGE_WPEFRAMEWORK_SECURE_SOCKET
	select BR2_PACKAGE_WPEFRAMEWORK_PROVISIONPROXY
	help
	   WPE Platform Provisioning plugin

if BR2_PACKAGE_WPEFRAMEWORK_PROVISIONING
menuconfig BR2_PACKAGE_WPEFRAMEWORK_PROVISIONING_CLOUD
    bool "Cloud provisioning"
    default n

if BR2_PACKAGE_WPEFRAMEWORK_PROVISIONING_CLOUD
    config BR2_PACKAGE_WPEFRAMEWORK_PROVISIONING_PROVISIONING_CACHE_PERIODE
        int "cache period (s)"
        default 2592000
        help
            Define the cache period in seconds.
            Set to 0 to disable.

    config BR2_PACKAGE_WPEFRAMEWORK_PROVISIONING_URI
        string "provisioning URI"
        default "provisioning-sdk.metrological.com:80"

    config BR2_PACKAGE_WPEFRAMEWORK_PROVISIONING_OPERATOR
        string "operator"
        default "metrological"
endif

menuconfig BR2_PACKAGE_WPEFRAMEWORK_PROVISIONING_FILES
    bool "File provisioning"
    default n

if BR2_PACKAGE_WPEFRAMEWORK_PROVISIONING_FILES
    config BR2_PACKAGE_WPEFRAMEWORK_PROVISIONING_VAULT_LOCATION
        string "vault"
        default "vault"
        help
            Define where the vault json files can be found. The
            location will be relative to the plugins persitent
            path.

            Leave empty to skip the json config entry.
endif

menuconfig BR2_PACKAGE_WPEFRAMEWORK_PROVISIONING_WIDEVINE
    bool "Widevine provisioning"
    default n

if BR2_PACKAGE_WPEFRAMEWORK_PROVISIONING_WIDEVINE
choice BR2_PACKAGE_WPEFRAMEWORK_PROVISIONING_WIDEVINE_LOG_LEVEL
    prompt "Debug Level"
    default BR2_PACKAGE_WPEFRAMEWORK_PROVISIONING_WIDEVINE_LOG_LEVEL_-1
config BR2_PACKAGE_WPEFRAMEWORK_PROVISIONING_WIDEVINE_LOG_LEVEL_-1
    bool "Silent"
config BR2_PACKAGE_WPEFRAMEWORK_PROVISIONING_WIDEVINE_LOG_LEVEL_0
    bool "Error"
config BR2_PACKAGE_WPEFRAMEWORK_PROVISIONING_WIDEVINE_LOG_LEVEL_1
    bool "Warnings"
config BR2_PACKAGE_WPEFRAMEWORK_PROVISIONING_WIDEVINE_LOG_LEVEL_2
    bool "Info"
config BR2_PACKAGE_WPEFRAMEWORK_PROVISIONING_WIDEVINE_LOG_LEVEL_3
    bool "Debug"
config BR2_PACKAGE_WPEFRAMEWORK_PROVISIONING_WIDEVINE_LOG_LEVEL_4
    bool "Verbose"
endchoice
endif

endif # BR2_PACKAGE_WPEFRAMEWORK_PROVISIONING

comment "Provisioning is dependent on the provision proxy wpeframework extension"
    depends on !BR2_PACKAGE_WPEFRAMEWORK_PROVISIONPROXY


menuconfig BR2_PACKAGE_WPEFRAMEWORK_PROVISIONING_BLOBWRITER
    depends on BR2_PACKAGE_WPEFRAMEWORK_PROVISIONING
	bool "BlobWriter"
	default n
	help
	    Plugin to transfor Provisioning Blobs into entries.
            in a TEE vault.

config BR2_PACKAGE_WPEFRAMEWORK_PROVISIONING_BLOBWRITER_BLOBS
    depends on BR2_PACKAGE_WPEFRAMEWORK_PROVISIONING_BLOBWRITER
    string "blobs"
    default ""
    help
        Define a string that contains the blobs to be written to files.
        format: (label:file:always;label:file:always) where 'always' is dump/overwrite file
        "labelx:/mnt/flash/labelx.bin:true;labely:/mnt/flash/labely.bin:false"

comment "BlobWriter is dependent on the provisioning plugin"
    depends on !BR2_PACKAGE_WPEFRAMEWORK_PROVISIONING
```
