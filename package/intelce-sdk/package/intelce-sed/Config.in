## package/intelce-sdk/package/intelce-sed/Config.in
```kconfig
config BR2_PACKAGE_INTELCE_SED
	bool "sed"
	select BR2_USE_WCHAR
	help
	  Super-useful stream editor.

	  http://sed.sourceforge.net/

	  Most people will answer Y.
```

## package/intelce-sdk/package/intelce-smd_avcap_shim/Config.in
```kconfig
config BR2_PACKAGE_INTELCE_SMD_AVCAP_SHIM
	bool "smd_avcap_shim"
	default n
	depends on BR2_PACKAGE_INTELCE_SDK
	select BR2_PACKAGE_INTELCE_SYSTEM_UTILS
	select BR2_PACKAGE_INTELCE_API
	select BR2_PACKAGE_INTELCE_AUTO_EAS
	select BR2_PACKAGE_INTELCE_OSAL
	select BR2_PACKAGE_INTELCE_COMMON
	select BR2_PACKAGE_INTELCE_SVEN
	select BR2_PACKAGE_INTELCE_CORE
	select BR2_PACKAGE_INTELCE_AVCAP
	select BR2_PACKAGE_INTELCE_SMD_COMMON
	select BR2_PACKAGE_INTELCE_CLOCK_RECOVERY
	select BR2_PACKAGE_INTELCE_CLOCK
	help
	  None
```

## package/intelce-sdk/package/intelce-smd_sample_apps/Config.in
```kconfig
config BR2_PACKAGE_INTELCE_SMD_SAMPLE_APPS
	bool "smd_sample_apps"
	default n
	depends on BR2_PACKAGE_INTELCE_SDK
	select BR2_PACKAGE_INTELCE_PAL
	select BR2_PACKAGE_INTELCE_AUTO_EAS
	select BR2_PACKAGE_INTELCE_OSAL
	select BR2_PACKAGE_INTELCE_HTUPLE
	select BR2_PACKAGE_INTELCE_SMD_TOOLS
	select BR2_PACKAGE_INTELCE_SVEN
	select BR2_PACKAGE_INTELCE_SMD_COMMON
	select BR2_PACKAGE_INTELCE_PLATFORM_CONFIG
	select BR2_PACKAGE_INTELCE_API
	select BR2_PACKAGE_INTELCE_CORE
	select BR2_PACKAGE_INTELCE_AUDIO
	select BR2_PACKAGE_INTELCE_AUDIO_FW
	select BR2_PACKAGE_INTELCE_CLOCK
	select BR2_PACKAGE_INTELCE_CLOCK_RECOVERY
	select BR2_PACKAGE_INTELCE_DEMUX
	select BR2_PACKAGE_INTELCE_VIDDEC
	select BR2_PACKAGE_INTELCE_VIDPPROC
	select BR2_PACKAGE_INTELCE_DISPLAY
	select BR2_PACKAGE_INTELCE_VIDREND
	select BR2_PACKAGE_INTELCE_BUFMON
	select BR2_PACKAGE_INTELCE_GSTREAMER
	select BR2_PACKAGE_INTELCE_EDL
	select BR2_PACKAGE_INTELCE_SYSTEM_UTILS
	select BR2_PACKAGE_INTELCE_TSOUT
	select BR2_PACKAGE_INTELCE_IDL
	select BR2_PACKAGE_INTELCE_AVCAP
	select BR2_PACKAGE_INTELCE_SMD_AVCAP_SHIM
	select BR2_PACKAGE_INTELCE_REMUX
	select BR2_PACKAGE_INTELCE_VIDSINK
	select BR2_PACKAGE_INTELCE_VIDENC
	select BR2_PACKAGE_INTELCE_MUX
	select BR2_PACKAGE_INTELCE_SEC
	help
	  None
```

## package/intelce-sdk/package/intelce-smd_tools/Config.in
```kconfig
config BR2_PACKAGE_INTELCE_SMD_TOOLS
	bool "smd_tools"
	default n
	depends on BR2_PACKAGE_INTELCE_SDK
	select BR2_PACKAGE_INTELCE_PAL
	select BR2_PACKAGE_INTELCE_AUTO_EAS
	select BR2_PACKAGE_INTELCE_OSAL
	select BR2_PACKAGE_INTELCE_HTUPLE
	select BR2_PACKAGE_INTELCE_SVEN
	select BR2_PACKAGE_INTELCE_SMD_COMMON
	help
	  None
```

## package/intelce-sdk/package/intelce-soc_audio/Config.in
```kconfig
config BR2_PACKAGE_INTELCE_SOC_AUDIO
	bool "soc_audio"
	default n
	depends on BR2_PACKAGE_INTELCE_SDK
	select BR2_PACKAGE_INTELCE_OSAL
	select BR2_PACKAGE_INTELCE_COMMON
	select BR2_PACKAGE_INTELCE_SMD_TOOLS
	select BR2_PACKAGE_INTELCE_SVEN
	select BR2_PACKAGE_INTELCE_CORE
	select BR2_PACKAGE_INTELCE_COSAI
	select BR2_PACKAGE_INTELCE_SMD_COMMON
	select BR2_PACKAGE_INTELCE_API
	help
	  None
```

## package/intelce-sdk/package/intelce-system_utils/Config.in
```kconfig
config BR2_PACKAGE_INTELCE_SYSTEM_UTILS
	bool "system_utils"
	default n
	depends on BR2_PACKAGE_INTELCE_SDK
	select BR2_PACKAGE_INTELCE_OSAL
	select BR2_PACKAGE_INTELCE_SMD_COMMON
	select BR2_PACKAGE_INTELCE_PAL
	select BR2_PACKAGE_INTELCE_SVEN
	help
	  None
```

## package/intelce-sdk/package/intelce-thermal/Config.in
```kconfig
config BR2_PACKAGE_INTELCE_THERMAL
	bool "thermal"
	default n
	depends on BR2_PACKAGE_INTELCE_SDK
	select BR2_PACKAGE_INTELCE_OSAL
	select BR2_PACKAGE_INTELCE_PAL
	help
	  None
```

## package/intelce-sdk/package/intelce-transcoder_common/Config.in
```kconfig
config BR2_PACKAGE_INTELCE_TRANSCODER_COMMON
	bool "transcoder_common"
	default n
	depends on BR2_PACKAGE_INTELCE_SDK
	select BR2_PACKAGE_INTELCE_API
	select BR2_PACKAGE_INTELCE_OSAL
	select BR2_PACKAGE_INTELCE_SMD_COMMON
	select BR2_PACKAGE_INTELCE_CORE
	help
	  None
```

## package/intelce-sdk/package/intelce-transcoder_device/Config.in
```kconfig
config BR2_PACKAGE_INTELCE_TRANSCODER_DEVICE
	bool "transcoder_device"
	default n
	depends on BR2_PACKAGE_INTELCE_SDK
	select BR2_PACKAGE_INTELCE_API
	select BR2_PACKAGE_INTELCE_OSAL
	select BR2_PACKAGE_INTELCE_SMD_COMMON
	select BR2_PACKAGE_INTELCE_SMD_TOOLS
	select BR2_PACKAGE_INTELCE_CORE
	select BR2_PACKAGE_INTELCE_HTUPLE
	select BR2_PACKAGE_INTELCE_SYSTEM_UTILS
	select BR2_PACKAGE_INTELCE_TRANSCODER_COMMON
	select BR2_PACKAGE_INTELCE_SEC
	select BR2_PACKAGE_INTELCE_KEYREFRESH
	select BR2_PACKAGE_INTELCE_PLATFORM_CONFIG
	help
	  None
```

## package/intelce-sdk/package/intelce-transcoder_pipeline/Config.in
```kconfig
config BR2_PACKAGE_INTELCE_TRANSCODER_PIPELINE
	bool "transcoder_pipeline"
	default n
	depends on BR2_PACKAGE_INTELCE_SDK
	select BR2_PACKAGE_INTELCE_API
	select BR2_PACKAGE_INTELCE_OSAL
	select BR2_PACKAGE_INTELCE_SMD_COMMON
	select BR2_PACKAGE_INTELCE_CORE
	select BR2_PACKAGE_INTELCE_DEMUX
	select BR2_PACKAGE_INTELCE_VIDDEC
	select BR2_PACKAGE_INTELCE_VIDPPROC
	select BR2_PACKAGE_INTELCE_AUDIO
	select BR2_PACKAGE_INTELCE_AUDIO_FW
	select BR2_PACKAGE_INTELCE_TRANSCODER_COMMON
	select BR2_PACKAGE_INTELCE_VIDEO_CES
	select BR2_PACKAGE_INTELCE_VIDENC
	select BR2_PACKAGE_INTELCE_MUX
	help
	  None
```

## package/intelce-sdk/package/intelce-transcoder_server/Config.in
```kconfig
config BR2_PACKAGE_INTELCE_TRANSCODER_SERVER
	bool "transcoder_server"
	default n
	depends on BR2_PACKAGE_INTELCE_SDK
	select BR2_PACKAGE_INTELCE_SMD_COMMON
	select BR2_PACKAGE_INTELCE_TRANSCODER_COMMON
	select BR2_PACKAGE_INTELCE_TRANSCODER_PIPELINE
	help
	  None
```

## package/intelce-sdk/package/intelce-viddec_fw/Config.in
```kconfig
config BR2_PACKAGE_INTELCE_VIDDEC_FW
bool "viddec_fw"
default n
depends on BR2_PACKAGE_INTELCE_SDK
select BR2_PACKAGE_INTELCE_PAL
select BR2_PACKAGE_INTELCE_AUTO_EAS
select BR2_PACKAGE_INTELCE_OSAL
select BR2_PACKAGE_INTELCE_PLATFORM_CONFIG
select BR2_PACKAGE_INTELCE_SMD_TOOLS
select BR2_PACKAGE_INTELCE_SVEN
select BR2_PACKAGE_INTELCE_CORE
select BR2_PACKAGE_INTELCE_FW_LOAD if BR2_PACKAGE_INTELCE_SDK_V36
select BR2_PACKAGE_INTELCE_SMD_COMMON
select BR2_PACKAGE_INTELCE_HTUPLE
help
None
```

## package/intelce-sdk/package/intelce-video_ces/Config.in
```kconfig
config BR2_PACKAGE_INTELCE_VIDEO_CES
bool "video_ces"
default n
depends on BR2_PACKAGE_INTELCE_SDK
select BR2_PACKAGE_INTELCE_SYSTEM_UTILS
select BR2_PACKAGE_INTELCE_PAL
select BR2_PACKAGE_INTELCE_AUTO_EAS
select BR2_PACKAGE_INTELCE_OSAL
select BR2_PACKAGE_INTELCE_HTUPLE
select BR2_PACKAGE_INTELCE_COMMON
select BR2_PACKAGE_INTELCE_SMD_TOOLS
select BR2_PACKAGE_INTELCE_SVEN
select BR2_PACKAGE_INTELCE_CORE
select BR2_PACKAGE_INTELCE_SMD_COMMON
select BR2_PACKAGE_INTELCE_API
select BR2_PACKAGE_INTELCE_PLATFORM_CONFIG
select BR2_PACKAGE_INTELCE_INTEL_CE_PM
select BR2_PACKAGE_INTELCE_SEC
select BR2_PACKAGE_INTELCE_FW_LOAD if BR2_PACKAGE_INTELCE_SDK_V36
help
None
```

## package/intelce-sdk/package/intelce-vidpproc_fw/Config.in
```kconfig
config BR2_PACKAGE_INTELCE_VIDPPROC_FW
bool "vidpproc_fw"
default n
depends on BR2_PACKAGE_INTELCE_SDK
select BR2_PACKAGE_INTELCE_PAL
select BR2_PACKAGE_INTELCE_AUTO_EAS
select BR2_PACKAGE_INTELCE_OSAL
select BR2_PACKAGE_INTELCE_PLATFORM_CONFIG
select BR2_PACKAGE_INTELCE_SMD_TOOLS
select BR2_PACKAGE_INTELCE_SVEN
select BR2_PACKAGE_INTELCE_CORE
select BR2_PACKAGE_INTELCE_SMD_COMMON
select BR2_PACKAGE_INTELCE_HTUPLE
select BR2_PACKAGE_INTELCE_FW_LOAD if BR2_PACKAGE_INTELCE_SDK_V36
select BR2_PACKAGE_INTELCE_IPCLIB if BR2_PACKAGE_INTELCE_SDK_V21
help
None
```

## package/intelce-sdk/package/intelce-vidsink/Config.in
```kconfig
config BR2_PACKAGE_INTELCE_VIDSINK
	bool "vidsink"
	default n
	depends on BR2_PACKAGE_INTELCE_SDK
	select BR2_PACKAGE_INTELCE_SYSTEM_UTILS
	select BR2_PACKAGE_INTELCE_API
	select BR2_PACKAGE_INTELCE_CORE
	select BR2_PACKAGE_INTELCE_OSAL
	select BR2_PACKAGE_INTELCE_AUTO_EAS
	select BR2_PACKAGE_INTELCE_SVEN
	select BR2_PACKAGE_INTELCE_SMD_TOOLS
	select BR2_PACKAGE_INTELCE_COMMON
	select BR2_PACKAGE_INTELCE_SMD_COMMON
	select BR2_PACKAGE_INTELCE_VIDREND
	select BR2_PACKAGE_INTELCE_VIDPPROC
	help
	  None
```

## package/intelce-sdk/package/intelce-watchdog/Config.in
```kconfig
config BR2_PACKAGE_INTELCE_WATCHDOG
	bool "watchdog"
	default n
	depends on BR2_PACKAGE_INTELCE_SDK
	help
	  None
```

## package/iotools/Config.in
```kconfig
config BR2_PACKAGE_IOTOOLS
	bool "iotools"
	help
	  Tools for poking all types of IO, supported are:
	  - CMOS NVRAM (via /dev/nvram)
	  - CPU ID (x86)
	  - IO port (x86, PowerPC)
	  - MMIO
	  - MSR (x86)
	  - PCI configuration space
	  - SCOM (PowerPC)
	  - SMBus

	  https://github.com/andy-shev/iotools
```

## package/iotop/Config.in
```kconfig
comment "iotop depends on python3"
	depends on !BR2_PACKAGE_PYTHON3

config BR2_PACKAGE_IOTOP
	bool "iotop"
	depends on BR2_PACKAGE_PYTHON3
	select BR2_PACKAGE_PYTHON3_CURSES
	help
	  iotop does for I/O usage what top does for CPU usage.

	  http://guichaz.free.fr/iotop/
```

## package/ipmitool/Config.in
```kconfig
config BR2_PACKAGE_IPMITOOL
	bool "ipmitool"
	depends on BR2_USE_MMU # fork()
	help
	  IPMItool provides a simple command-line interface to
	  IPMI-enabled devices.

	  ipmitool will look up the IANA PEN (Enterprise Numbers)
	  registry in /usr/share/misc/iana/. The IANA PEN is optional,
	  it can be provided by the iana-assignment package or by a
	  rootfs overlay.

	  https://codeberg.org/IPMITool/ipmitool/

if BR2_PACKAGE_IPMITOOL

config BR2_PACKAGE_IPMITOOL_LANPLUS
	bool "enable lanplus interface"
	select BR2_PACKAGE_OPENSSL
	help
	  Enables the IPMI v2.0 RMCP+ LAN interface typically used to
	  send IPMI commands to the BMC of a remote server.
	  Not needed if you only want to communicate with the local BMC
	  of your device using the OpenIPMI ipmi_si kernel module, or if
	  using the legacy IPMI v1.5 RMCP LAN interface.

config BR2_PACKAGE_IPMITOOL_USB
	bool "enable usb interface"
	help
	  Enables the IPMI USB interface typically used to send inband
	  IPMI commands to the BMC of a server.

config BR2_PACKAGE_IPMITOOL_IPMIEVD
	bool "ipmievd"
	help
	  IPMI event daemon for sending events to syslog

config BR2_PACKAGE_IPMITOOL_IPMISHELL
	bool "ipmishell"
	select BR2_PACKAGE_READLINE
	help
	  IPMI shell interface

endif
```

## package/iptables/Config.in
```kconfig
config BR2_PACKAGE_IPTABLES
	bool "iptables"
	help
	  Linux kernel firewall, NAT, and packet mangling tools.

	  http://www.netfilter.org/projects/iptables/index.html

if BR2_PACKAGE_IPTABLES

config BR2_PACKAGE_IPTABLES_BPF_NFSYNPROXY
	bool "bpfc and nfsynproxy"
	select BR2_PACKAGE_LIBPCAP
	help
	  Build bpf compiler and nfsynproxy configuration tool.

config BR2_PACKAGE_IPTABLES_NFTABLES
	bool "nftables compat"
	# uses dlfcn
	depends on !BR2_STATIC_LIBS
	depends on BR2_USE_WCHAR
	depends on BR2_TOOLCHAIN_HEADERS_AT_LEAST_3_12
	select BR2_PACKAGE_LIBMNL
	select BR2_PACKAGE_LIBNFTNL
	help
	  Build nftables compat utilities.

if BR2_PACKAGE_IPTABLES_NFTABLES

config BR2_PACKAGE_IPTABLES_NFTABLES_DEFAULT
	bool "use nftables compat by default"
	help
	  Make the nftables compat variant of iptables, iptables-save,
	  and iptables-restore the default. This only adjusts symlinks
	  in /usr/sbin, the legacy variants can still be called
	  directly.

endif

comment "nftables compat needs a toolchain w/ wchar, dynamic library, headers >= 3.12"
	depends on !BR2_TOOLCHAIN_HEADERS_AT_LEAST_3_12 || \
		!BR2_USE_WCHAR || BR2_STATIC_LIBS

endif
```

## package/iptraf-ng/Config.in
```kconfig
config BR2_PACKAGE_IPTRAF_NG
	bool "iptraf-ng"
	depends on BR2_USE_MMU # fork()
	select BR2_PACKAGE_NCURSES
	help
	  IPTraf-ng is a console-based network monitoring program for
	  Linux that gathers displays information about IP traffic.

	  https://github.com/iptraf-ng/iptraf-ng

	  IPTraf-ng is a fork of original IPTraf v3.0.0
	  (http://iptraf.seul.org).
```

## package/iputils/Config.in
```kconfig
config BR2_PACKAGE_IPUTILS
	bool "iputils"
	depends on BR2_USE_MMU # fork()
	help
	  This package is set of small useful utilities for Linux
	  networking. It includes complete versions of ping, arping,
	  etc.

	  https://github.com/iputils/iputils

if BR2_PACKAGE_IPUTILS

config BR2_PACKAGE_IPUTILS_ARPING
	bool "arping"
	default y
	help
	  Installs arping.

config BR2_PACKAGE_IPUTILS_CLOCKDIFF
	bool "clockdiff"
	default y
	help
	  Installs clockdiff.

config BR2_PACKAGE_IPUTILS_PING
	bool "ping"
	default y
	help
	  Installs ping.

config BR2_PACKAGE_IPUTILS_TRACEPATH
	bool "tracepath"
	default y
	help
	  Installs tracepath.

comment "ninfod needs a toolchain w/ threads"
	depends on !BR2_TOOLCHAIN_HAS_THREADS

endif
```
