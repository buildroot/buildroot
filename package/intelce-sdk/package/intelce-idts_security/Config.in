## package/intelce-sdk/package/intelce-idts_security/Config.in
```kconfig
config BR2_PACKAGE_INTELCE_IDTS_SECURITY
	bool "idts_security"
	default n
	depends on BR2_PACKAGE_INTELCE_SDK
	select BR2_PACKAGE_INTELCE_PAL
	select BR2_PACKAGE_INTELCE_OSAL
	select BR2_PACKAGE_INTELCE_NAND_CONFIG
	select BR2_PACKAGE_INTELCE_FLASH_APPDATA
	select BR2_PACKAGE_INTELCE_SEC
	select BR2_PACKAGE_OPENSSL
	select BR2_PACKAGE_INTELCE_IDTS_COMMON
	select BR2_PACKAGE_INTELCE_IDTSAL  if BR2_PACKAGE_INTELCE_SDK_V36
	help
	  None
```

## package/intelce-sdk/package/intelce-idtsal/Config.in
```kconfig
config BR2_PACKAGE_INTELCE_IDTSAL
	bool "idtsal"
	default n
	depends on BR2_PACKAGE_INTELCE_SDK
	help
	  None
```

## package/intelce-sdk/package/intelce-init_man/Config.in
```kconfig
config BR2_PACKAGE_INTELCE_INIT_MAN
	bool "init_man"
	default n
	depends on BR2_PACKAGE_INTELCE_SDK
	help
	  None
```

## package/intelce-sdk/package/intelce-intel_ce_pm/Config.in
```kconfig
config BR2_PACKAGE_INTELCE_INTEL_CE_PM
bool "intel_ce_pm"
default n
depends on BR2_PACKAGE_INTELCE_SDK
select BR2_PACKAGE_INTELCE_PAL
select BR2_PACKAGE_INTELCE_OSAL
select BR2_PACKAGE_INTELCE_CLOCK_CONTROL
select BR2_PACKAGE_INTELCE_SYSTEM_UTILS
select BR2_PACKAGE_INTELCE_8051_SDK
select BR2_PACKAGE_INTELCE_IOSF  if BR2_PACKAGE_INTELCE_SDK_V36
help
None
```

## package/intelce-sdk/package/intelce-iosf/Config.in
```kconfig
config BR2_PACKAGE_INTELCE_IOSF
	bool "iosf"
	default n
	depends on BR2_PACKAGE_INTELCE_SDK
	help
	  None
```

## package/intelce-sdk/package/intelce-ipclib/Config.in
```kconfig
config BR2_PACKAGE_INTELCE_IPCLIB
bool "ipclib"
default n
depends on BR2_PACKAGE_INTELCE_SDK
select BR2_PACKAGE_INTELCE_PAL
select BR2_PACKAGE_INTELCE_AUTO_EAS
select BR2_PACKAGE_INTELCE_OSAL
select BR2_PACKAGE_INTELCE_HTUPLE
select BR2_PACKAGE_INTELCE_SMD_TOOLS
select BR2_PACKAGE_INTELCE_SVEN
select BR2_PACKAGE_INTELCE_SMD_COMMON

help
None
```

## package/intelce-sdk/package/intelce-itstore/Config.in
```kconfig
config BR2_PACKAGE_INTELCE_ITSTORE
	bool "itstore"
	default n
	depends on BR2_PACKAGE_INTELCE_SDK
	select BR2_PACKAGE_INTELCE_SEC
	select BR2_PACKAGE_INTELCE_OSAL
	help
	  None
```

## package/intelce-sdk/package/intelce-keyrefresh/Config.in
```kconfig
config BR2_PACKAGE_INTELCE_KEYREFRESH
	bool "keyrefresh"
	default n
	depends on BR2_PACKAGE_INTELCE_SDK
	select BR2_PACKAGE_INTELCE_SEC
	help
	  None
```

## package/intelce-sdk/package/intelce-loaddrivers/Config.in
```kconfig
config BR2_PACKAGE_INTELCE_LOADDRIVERS
	bool "Install driver init scripts"
	depends on BR2_PACKAGE_INTELCE_SDK
	help
	  Install driver init scripts.
```

## package/intelce-sdk/package/intelce-mfhlib/Config.in
```kconfig
config BR2_PACKAGE_INTELCE_MFHLIB
bool "mfhlib"
default n
depends on BR2_PACKAGE_INTELCE_SDK
select BR2_PACKAGE_INTELCE_OSAL
select BR2_PACKAGE_INTELCE_PAL
select BR2_PACKAGE_INTELCE_NAND_CONFIG
select BR2_PACKAGE_INTELCE_FLASHTOOL
select BR2_PACKAGE_OPENSSL
select BR2_PACKAGE_INTELCE_IDTSAL if BR2_PACKAGE_INTELCE_SDK_V36
help
None
```

## package/intelce-sdk/package/intelce-mspod/Config.in
```kconfig
config BR2_PACKAGE_INTELCE_MSPOD
	bool "mspod"
	default n
	depends on BR2_PACKAGE_INTELCE_SDK
	select BR2_PACKAGE_INTELCE_AUTO_EAS
	select BR2_PACKAGE_INTELCE_OSAL
	select BR2_PACKAGE_INTELCE_IDL
	select BR2_PACKAGE_INTELCE_FLASH_APPDATA
	select BR2_PACKAGE_INTELCE_SVEN
	select BR2_PACKAGE_INTELCE_CORE
	help
	  None
```

## package/intelce-sdk/package/intelce-nand_config/Config.in
```kconfig
config BR2_PACKAGE_INTELCE_NAND_CONFIG
	bool "nand_config"
	default n
	depends on BR2_PACKAGE_INTELCE_SDK
	select BR2_PACKAGE_INTELCE_OSAL
	help
	  None
```

## package/intelce-sdk/package/intelce-nsprpub_mw_dep/Config.in
```kconfig
config BR2_PACKAGE_INTELCE_NSPRPUB_MW_DEP
	bool "nsprpub_mw_dep"
	default n
	depends on BR2_PACKAGE_INTELCE_SDK
	select BR2_PACKAGE_INTELCE_NSPR
	help
	  None
```

## package/intelce-sdk/package/intelce-osal/Config.in
```kconfig
config BR2_PACKAGE_INTELCE_OSAL
	bool "osal"
	default n
	depends on BR2_PACKAGE_INTELCE_SDK
	help
	  None
```

## package/intelce-sdk/package/intelce-pal/Config.in
```kconfig
config BR2_PACKAGE_INTELCE_PAL
	bool "pal"
	default n
	depends on BR2_PACKAGE_INTELCE_SDK
	help
	  None
```

## package/intelce-sdk/package/intelce-performancetools/Config.in
```kconfig
config BR2_PACKAGE_INTELCE_PERFORMANCETOOLS
	bool "performancetools"
	default n
	depends on BR2_PACKAGE_INTELCE_SDK
	help
	  None
```

## package/intelce-sdk/package/intelce-pic24/Config.in
```kconfig
config BR2_PACKAGE_INTELCE_PIC24
	bool "pic24"
	default n
	depends on BR2_PACKAGE_INTELCE_SDK
	help
	  None
```

## package/intelce-sdk/package/intelce-pic24_uart/Config.in
```kconfig
config BR2_PACKAGE_INTELCE_PIC24_UART
	bool "pic24_uart"
	default n
	depends on BR2_PACKAGE_INTELCE_SDK
	select BR2_PACKAGE_INTELCE_OSAL
	select BR2_PACKAGE_INTELCE_IDTS_COMMON
	help
	  None
```

## package/intelce-sdk/package/intelce-pic24_uart_drv/Config.in
```kconfig
config BR2_PACKAGE_INTELCE_PIC24_UART_DRV
	bool "pic24_uart_drv"
	default n
	depends on BR2_PACKAGE_INTELCE_SDK
	select BR2_PACKAGE_INTELCE_OSAL
	select BR2_PACKAGE_INTELCE_INTEL_CE_PM
	help
	  None
```

## package/intelce-sdk/package/intelce-platform_config/Config.in
```kconfig
config BR2_PACKAGE_INTELCE_PLATFORM_CONFIG
	bool "platform_config"
	default n
	depends on BR2_PACKAGE_INTELCE_SDK
	select BR2_PACKAGE_INTELCE_HTUPLE
	select BR2_PACKAGE_OPENSSL
	help
	  None
```

## package/intelce-sdk/package/intelce-punit_fw_upgrade/Config.in
```kconfig
config BR2_PACKAGE_INTELCE_PUNIT_FW_UPGRADE
bool "punit_fw_upgrade"
default n
depends on BR2_PACKAGE_INTELCE_SDK
select BR2_PACKAGE_INTELCE_IOSF if BR2_PACKAGE_INTELCE_SDK_V36
select BR2_PACKAGE_INTELCE_PAL
help
None
```

## package/intelce-sdk/package/intelce-pwm/Config.in
```kconfig
config BR2_PACKAGE_INTELCE_PWM
	bool "pwm"
	default n
	depends on BR2_PACKAGE_INTELCE_SDK
	help
	  None
```

## package/intelce-sdk/package/intelce-sec/Config.in
```kconfig
config BR2_PACKAGE_INTELCE_SEC
bool "sec"
default n
depends on BR2_PACKAGE_INTELCE_SDK
select BR2_PACKAGE_INTELCE_AUTO_EAS
select BR2_PACKAGE_INTELCE_OSAL
select BR2_PACKAGE_INTELCE_PAL
select BR2_PACKAGE_INTELCE_SVEN
select BR2_PACKAGE_INTELCE_CLOCK_CONTROL
select BR2_PACKAGE_INTELCE_SYSTEM_UTILS
select BR2_PACKAGE_INTELCE_INTEL_CE_PM
select BR2_PACKAGE_INTELCE_IOSF if BR2_PACKAGE_INTELCE_SDK_V36
help
None
```

## package/intelce-sdk/package/intelce-sec_diagnose/Config.in
```kconfig
config BR2_PACKAGE_INTELCE_SEC_DIAGNOSE
	bool "sec_diagnose"
	default n
	depends on BR2_PACKAGE_INTELCE_SDK
	select BR2_PACKAGE_INTELCE_OSAL
	select BR2_PACKAGE_INTELCE_PAL
	select BR2_PACKAGE_INTELCE_FLASHTOOL
	select BR2_PACKAGE_INTELCE_FLASH_APPDATA
	select BR2_PACKAGE_INTELCE_SEC
	select BR2_PACKAGE_INTELCE_HDMI_HDCP
	help
	  None
```

## package/intelce-sdk/package/intelce-sec_fw/Config.in
```kconfig
config BR2_PACKAGE_INTELCE_SEC_FW
	bool "sec_fw"
	default n
	depends on BR2_PACKAGE_INTELCE_SDK
	select BR2_PACKAGE_INTELCE_SEC
	select BR2_PACKAGE_INTELCE_FLASH_APPDATA
	select BR2_PACKAGE_INTELCE_OSAL
	select BR2_PACKAGE_INTELCE_PAL
	select BR2_PACKAGE_INTELCE_EXPAT
	select BR2_PACKAGE_INTELCE_CONFIG_DATABASE
	help
	  None
```
