## package/intelce-sdk/package/intelce-config_database/Config.in
```kconfig
config BR2_PACKAGE_INTELCE_CONFIG_DATABASE
	bool "config_database"
	default n
	depends on BR2_PACKAGE_INTELCE_SDK
	help
	  None
```

## package/intelce-sdk/package/intelce-core/Config.in
```kconfig
config BR2_PACKAGE_INTELCE_CORE
	bool "core"
	default n
	depends on BR2_PACKAGE_INTELCE_SDK
	select BR2_PACKAGE_INTELCE_SYSTEM_UTILS
	select BR2_PACKAGE_INTELCE_PAL
	select BR2_PACKAGE_INTELCE_PLATFORM_CONFIG
	select BR2_PACKAGE_INTELCE_AUTO_EAS
	select BR2_PACKAGE_INTELCE_OSAL
	select BR2_PACKAGE_INTELCE_HTUPLE
	select BR2_PACKAGE_INTELCE_SMD_TOOLS
	select BR2_PACKAGE_INTELCE_SVEN
	select BR2_PACKAGE_INTELCE_SMD_COMMON
	select BR2_PACKAGE_INTELCE_API
	select BR2_PACKAGE_INTELCE_PLATFORM_CONFIG
	select BR2_PACKAGE_INTELCE_INTEL_CE_PM
	help
	  None
```

## package/intelce-sdk/package/intelce-cosai/Config.in
```kconfig
config BR2_PACKAGE_INTELCE_COSAI
	bool "cosai"
	default n
	depends on BR2_PACKAGE_INTELCE_SDK
	help
	  None
```

## package/intelce-sdk/package/intelce-devmem/Config.in
```kconfig
config BR2_PACKAGE_INTELCE_DEVMEM
	bool "devmem"
	default n
	depends on BR2_PACKAGE_INTELCE_SDK
	select BR2_PACKAGE_INTELCE_PLATFORM_CONFIG
	help
	  None
```

## package/intelce-sdk/package/intelce-devtools/Config.in
```kconfig
config BR2_PACKAGE_INTELCE_DEVTOOLS
bool "devtools"
default n
depends on BR2_PACKAGE_INTELCE_SDK
select BR2_PACKAGE_OPENSSL
help
None
```

## package/intelce-sdk/package/intelce-display/Config.in
```kconfig
config BR2_PACKAGE_INTELCE_DISPLAY
bool "display"
default n
depends on BR2_PACKAGE_INTELCE_SDK
select BR2_PACKAGE_INTELCE_API
select BR2_PACKAGE_INTELCE_AUTO_EAS
select BR2_PACKAGE_INTELCE_CLOCK_CONTROL
select BR2_PACKAGE_INTELCE_CORE
select BR2_PACKAGE_INTELCE_HDMI_HDCP
select BR2_PACKAGE_INTELCE_IDL
select BR2_PACKAGE_INTELCE_OSAL
select BR2_PACKAGE_INTELCE_PAL
select BR2_PACKAGE_INTELCE_PLATFORM_CONFIG
select BR2_PACKAGE_INTELCE_SYSTEM_UTILS
select BR2_PACKAGE_INTELCE_SVEN
select BR2_PACKAGE_INTELCE_GENERIC_TIMER
select BR2_PACKAGE_INTELCE_IOSF if BR2_PACKAGE_INTELCE_SDK_V36
select BR2_PACKAGE_FREETYPE
select BR2_PACKAGE_LIBPNG
select BR2_PACKAGE_ZLIB
select BR2_PACKAGE_INTELCE_INTEL_CE_PM
help
None

config BR2_PACKAGE_PROVIDES_LIBGDL
    string
	default "intelce-display"
```

## package/intelce-sdk/package/intelce-edl/Config.in
```kconfig
config BR2_PACKAGE_INTELCE_EDL
	bool "edl"
	default n
	depends on BR2_PACKAGE_INTELCE_SDK
	select BR2_PACKAGE_INTELCE_OSAL
	select BR2_PACKAGE_INTELCE_IDL
	select BR2_PACKAGE_INTELCE_AUDIO
	select BR2_PACKAGE_INTELCE_SMD_COMMON
	select BR2_PACKAGE_INTELCE_SMD_TOOLS
	select BR2_PACKAGE_INTELCE_PAL
	select BR2_PACKAGE_INTELCE_FLASH_APPDATA
	select BR2_PACKAGE_INTELCE_SYSTEM_UTILS
	help
	  None
```

## package/intelce-sdk/package/intelce-fakeroot/Config.in
```kconfig
#config BR2_PACKAGE_INTELCE_FAKEROOT
#	bool "fakeroot"
#	help
#	  Run commands in an environment faking root privileges.
#
#	  http://joostje.op.het.net/fakeroot/

# dummy for fakeroot-source
config BR2_HOST_FAKEROOT
	bool
    select ! BR2_PACKAGE_INTELCE_TARGETFS
    select ! BR2_PACKAGE_INTELCE_TARGETFS_GATEWAY
    default n
depends on BR2_PACKAGE_INTELCE_SDK
```

## package/intelce-sdk/package/intelce-flash_appdata/Config.in
```kconfig
config BR2_PACKAGE_INTELCE_FLASH_APPDATA
bool "flash_appdata"
default n
depends on BR2_PACKAGE_INTELCE_SDK
select BR2_PACKAGE_INTELCE_FLASHTOOL
select BR2_PACKAGE_INTELCE_NAND_CONFIG
select BR2_PACKAGE_INTELCE_OSAL
select BR2_PACKAGE_INTELCE_PAL
select BR2_PACKAGE_INTELCE_MFHLIB
select BR2_PACKAGE_INTELCE_IDTSAL if BR2_PACKAGE_INTELCE_SDK_V36
help
None
```

## package/intelce-sdk/package/intelce-flash_encryption_signing_tools/Config.in
```kconfig
config BR2_PACKAGE_INTELCE_FLASH_ENCRYPTION_SIGNING_TOOLS
	bool "flash_encryption_signing_tools"
	default n
	depends on BR2_PACKAGE_INTELCE_SDK
	select BR2_PACKAGE_OPENSSL
	help
	  None
```

## package/intelce-sdk/package/intelce-flashtool/Config.in
```kconfig
config BR2_PACKAGE_INTELCE_FLASHTOOL
	bool "flashtool"
	default n
	depends on BR2_PACKAGE_INTELCE_SDK
	help
	  None
```

## package/intelce-sdk/package/intelce-freedesktop/Config.in
```kconfig
config BR2_PACKAGE_INTELCE_FREEDESTOP
bool "freedesktop"
default n
depends on BR2_PACKAGE_INTELCE_SDK
select BR2_PACKAGE_OPENSSL
help
None
```

## package/intelce-sdk/package/intelce-generic_timer/Config.in
```kconfig
config BR2_PACKAGE_INTELCE_GENERIC_TIMER
	bool "generic_timer"
	default n
	depends on BR2_PACKAGE_INTELCE_SDK
	select BR2_PACKAGE_INTELCE_AUTO_EAS
	select BR2_PACKAGE_INTELCE_OSAL
	select BR2_PACKAGE_INTELCE_HTUPLE
	select BR2_PACKAGE_INTELCE_SMD_TOOLS
	select BR2_PACKAGE_INTELCE_SVEN
	select BR2_PACKAGE_INTELCE_CORE
	select BR2_PACKAGE_INTELCE_SMD_COMMON
	select BR2_PACKAGE_INTELCE_API
	select BR2_PACKAGE_INTELCE_PLATFORM_CONFIG
	help
	  None
```

## package/intelce-sdk/package/intelce-gnuconfig/Config.in
```kconfig
config BR2_UPDATE_CONFIG
	bool "update config.sub and config.guess"
	default n
	depends on BR2_PACKAGE_INTELCE_SDK
	help
	  This just exists to easily update the config.sub / config.guess
	  files in packages to the latest version (since many bundled ones
	  don't support the latest possible targets)
```

## package/intelce-sdk/package/intelce-gpio/Config.in
```kconfig
config BR2_PACKAGE_INTELCE_GPIO
	bool "gpio"
	default n
	depends on BR2_PACKAGE_INTELCE_SDK
	help
	  None
```

## package/intelce-sdk/package/intelce-graphics/Config.in
```kconfig
config BR2_PACKAGE_INTELCE_GRAPHICS
	bool "graphics"
	default n
	depends on BR2_PACKAGE_INTELCE_SDK
	select BR2_PACKAGE_INTELCE_OSAL
	select BR2_PACKAGE_INTELCE_PAL
	select BR2_PACKAGE_INTELCE_DISPLAY
	select BR2_PACKAGE_FLEX
	select BR2_PACKAGE_HAS_LIBEGL
	select BR2_PACKAGE_HAS_LIBGLES
	help
	  None

config BR2_PACKAGE_PROVIDES_LIBEGL
	default "intelce-graphics"

config BR2_PACKAGE_PROVIDES_LIBGLES
	default "intelce-graphics"
```

## package/intelce-sdk/package/intelce-graphics_2d/Config.in
```kconfig
config BR2_PACKAGE_INTELCE_GRAPHICS_2D
	bool "graphics_2d"
	default n
	depends on BR2_PACKAGE_INTELCE_SDK
	select BR2_PACKAGE_INTELCE_OSAL
	select BR2_PACKAGE_INTELCE_PAL
	select BR2_PACKAGE_INTELCE_PLATFORM_CONFIG
	select BR2_PACKAGE_INTELCE_DISPLAY
	select BR2_PACKAGE_INTELCE_GRAPHICS
	select BR2_PACKAGE_INTELCE_SYSTEM_UTILS
	help
	  None
```

## package/intelce-sdk/package/intelce-graphics_apps/Config.in
```kconfig
config BR2_PACKAGE_INTELCE_GRAPHICS_APPS
	bool "graphics_apps"
	default n
	depends on BR2_PACKAGE_INTELCE_SDK
	select BR2_PACKAGE_INTELCE_GRAPHICS
	select BR2_PACKAGE_INTELCE_OSAL
	select BR2_PACKAGE_INTELCE_PAL
	select BR2_PACKAGE_INTELCE_DISPLAY
	select BR2_PACKAGE_INTELCE_JPEG
	select BR2_PACKAGE_INTELCE_SMD_SAMPLE_APPS
	help
	  None
```

## package/intelce-sdk/package/intelce-gsven/Config.in
```kconfig
config BR2_PACKAGE_INTELCE_GSVEN
bool "gsven"
default n
depends on BR2_PACKAGE_INTELCE_SDK
select BR2_PACKAGE_INTELCE_HTUPLE
select BR2_PACKAGE_INTELCE_AUTO_EAS
select BR2_PACKAGE_INTELCE_OSAL
select BR2_PACKAGE_INTELCE_PAL
select BR2_PACKAGE_INTELCE_PLATFORM_CONFIG
select BR2_PACKAGE_INTELCE_SMD_COMMON
select BR2_PACKAGE_INTELCE_SVEN
select BR2_PACKAGE_INTELCE_LIBVNCSERVER
select BR2_PACKAGE_INTELCE_IOSF if BR2_PACKAGE_INTELCE_SDK_V36
help
None
```

## package/intelce-sdk/package/intelce-hdmi_hdcp/Config.in
```kconfig
config BR2_PACKAGE_INTELCE_HDMI_HDCP
	bool "hdmi_hdcp"
	default n
	depends on BR2_PACKAGE_INTELCE_SDK
	select BR2_PACKAGE_OPENSSL
	select BR2_PACKAGE_INTELCE_FLASHTOOL
	select BR2_PACKAGE_INTELCE_SEC
	select BR2_PACKAGE_INTELCE_OSAL
	select BR2_PACKAGE_INTELCE_PAL
	select BR2_PACKAGE_INTELCE_FLASH_APPDATA
	help
	  None
```

## package/intelce-sdk/package/intelce-htuple/Config.in
```kconfig
config BR2_PACKAGE_INTELCE_HTUPLE
	bool "htuple"
	default n
	depends on BR2_PACKAGE_INTELCE_SDK
	select BR2_PACKAGE_INTELCE_SMD_COMMON
	help
	  None
```

## package/intelce-sdk/package/intelce-idl/Config.in
```kconfig
config BR2_PACKAGE_INTELCE_IDL
bool "idl"
default n
depends on BR2_PACKAGE_INTELCE_SDK
select BR2_PACKAGE_INTELCE_OSAL
select BR2_PACKAGE_INTELCE_PAL
select BR2_PACKAGE_INTELCE_GPIO if BR2_PACKAGE_INTELCE_SDK_V36
help
None
```

## package/intelce-sdk/package/intelce-idts_common/Config.in
```kconfig
config BR2_PACKAGE_INTELCE_IDTS_COMMON
bool "idts_common"
default n
depends on BR2_PACKAGE_INTELCE_SDK
select BR2_PACKAGE_INTELCE_PAL
select BR2_PACKAGE_INTELCE_OSAL
select BR2_PACKAGE_INTELCE_IDL
select BR2_PACKAGE_OPENSSL
select BR2_PACKAGE_INTELCE_IDTSAL if BR2_PACKAGE_INTELCE_SDK_V36
select BR2_PACKAGE_INTELCE_GRAPHICS if BR2_PACKAGE_INTELCE_SDK_V21
help
None
```

## package/intelce-sdk/package/intelce-idts_core/Config.in
```kconfig
config BR2_PACKAGE_INTELCE_IDTS_CORE
	bool "idts_core"
	default n
	depends on BR2_PACKAGE_INTELCE_SDK
	select BR2_PACKAGE_INTELCE_COMMON
	select BR2_PACKAGE_INTELCE_HTUPLE
	select BR2_PACKAGE_INTELCE_PAL
	select BR2_PACKAGE_INTELCE_OSAL
	select BR2_PACKAGE_INTELCE_IDL
	select BR2_PACKAGE_INTELCE_API
	select BR2_PACKAGE_INTELCE_FLASHTOOL
	select BR2_PACKAGE_INTELCE_NAND_CONFIG
	select BR2_PACKAGE_INTELCE_FLASH_APPDATA
	select BR2_PACKAGE_INTELCE_CORE
	select BR2_PACKAGE_INTELCE_CLOCK
	select BR2_PACKAGE_INTELCE_CLOCK_CONTROL
	select BR2_PACKAGE_INTELCE_CLOCK_RECOVERY
	select BR2_PACKAGE_INTELCE_DEMUX
	select BR2_PACKAGE_INTELCE_SVEN
	select BR2_PACKAGE_INTELCE_PLATFORM_CONFIG
	select BR2_PACKAGE_INTELCE_AUTO_EAS
	select BR2_PACKAGE_INTELCE_CORE
	select BR2_PACKAGE_INTELCE_IDTS_COMMON
	select BR2_PACKAGE_INTELCE_MFHLIB
	select BR2_PACKAGE_INTELCE_PWM  if BR2_PACKAGE_INTELCE_SDK_V36
	select BR2_PACKAGE_INTELCE_SYSTEM_UTILS
	select BR2_PACKAGE_INTELCE_IDTSAL  if BR2_PACKAGE_INTELCE_SDK_V36
	help
	  None
```

## package/intelce-sdk/package/intelce-idts_media/Config.in
```kconfig
config BR2_PACKAGE_INTELCE_IDTS_MEDIA
	bool "idts_media"
	default n
	depends on BR2_PACKAGE_INTELCE_SDK
	select BR2_PACKAGE_INTELCE_COMMON
	select BR2_PACKAGE_INTELCE_HTUPLE
	select BR2_PACKAGE_INTELCE_PAL
	select BR2_PACKAGE_INTELCE_OSAL
	select BR2_PACKAGE_INTELCE_IDL
	select BR2_PACKAGE_INTELCE_API
	select BR2_PACKAGE_INTELCE_FLASHTOOL
	select BR2_PACKAGE_INTELCE_NAND_CONFIG
	select BR2_PACKAGE_INTELCE_FLASH_APPDATA
	select BR2_PACKAGE_INTELCE_PIC24_UART
	select BR2_PACKAGE_INTELCE_PIC24_UART_DRV
	select BR2_PACKAGE_INTELCE_SEC
	select BR2_PACKAGE_INTELCE_DISPLAY
	select BR2_PACKAGE_INTELCE_CORE
	select BR2_PACKAGE_INTELCE_CLOCK
	select BR2_PACKAGE_INTELCE_CLOCK_CONTROL
	select BR2_PACKAGE_INTELCE_CLOCK_RECOVERY
	select BR2_PACKAGE_INTELCE_BUFMON
	select BR2_PACKAGE_INTELCE_AUDIO
	select BR2_PACKAGE_INTELCE_DEMUX
	select BR2_PACKAGE_INTELCE_REMUX
	select BR2_PACKAGE_INTELCE_VIDDEC
	select BR2_PACKAGE_INTELCE_SVEN
	select BR2_PACKAGE_INTELCE_VIDPPROC
	select BR2_PACKAGE_INTELCE_DISPLAY
	select BR2_PACKAGE_INTELCE_SMD_COMMON
	select BR2_PACKAGE_INTELCE_VIDREND
	select BR2_PACKAGE_INTELCE_PLATFORM_CONFIG
	select BR2_PACKAGE_INTELCE_AUTO_EAS
	select BR2_PACKAGE_INTELCE_CORE
	select BR2_PACKAGE_INTELCE_GRAPHICS
	select BR2_PACKAGE_INTELCE_SMD_SAMPLE_APPS
	select BR2_PACKAGE_INTELCE_SMD_TOOLS
	select BR2_PACKAGE_INTELCE_DIRECTFB_1_6
	select BR2_PACKAGE_INTELCE_IDTS_COMMON
	select BR2_PACKAGE_INTELCE_MFHLIB
	select BR2_PACKAGE_INTELCE_PWM
	select BR2_PACKAGE_INTELCE_SYSTEM_UTILS
	select BR2_PACKAGE_INTELCE_IDTSAL
	help
	  None
```
