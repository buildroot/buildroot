## package/libyang-cpp/Config.in
```kconfig
config BR2_PACKAGE_LIBYANG_CPP
	bool "libyang-cpp"
	depends on BR2_INSTALL_LIBSTDCPP
	depends on BR2_TOOLCHAIN_GCC_AT_LEAST_10
	depends on BR2_TOOLCHAIN_HAS_SYNC_4 # libyang
	depends on BR2_TOOLCHAIN_HAS_THREADS # libyang
	depends on !BR2_STATIC_LIBS # libyang
	select BR2_PACKAGE_LIBYANG
	help
	  C++ bindings for the libyang library (v4).

	  libyang-cpp implements modern C++ RAII wrappers around the
	  libyang C API, used by sysrepo, Kea + NETCONF, etc.

	  https://github.com/CESNET/libyang-cpp

comment "libyang-cpp needs a toolchain w/ threads, dynamic library, C++, gcc >= 10"
	depends on BR2_TOOLCHAIN_HAS_SYNC_4
	depends on !BR2_TOOLCHAIN_HAS_THREADS || BR2_STATIC_LIBS || \
		!BR2_INSTALL_LIBSTDCPP || !BR2_TOOLCHAIN_GCC_AT_LEAST_10
```

## package/libyang/Config.in
```kconfig
config BR2_PACKAGE_LIBYANG
	bool "libyang"
	depends on BR2_TOOLCHAIN_HAS_SYNC_4 # __sync_*_4 intrinsics
	depends on BR2_TOOLCHAIN_HAS_THREADS
	depends on !BR2_STATIC_LIBS
	select BR2_PACKAGE_PCRE2
	help
	  Libyang is YANG data modeling language parser and toolkit
	  written (and providing API) in C.

	  https://github.com/CESNET/libyang

comment "libyang needs a toolchain w/ threads, dynamic library"
	depends on BR2_TOOLCHAIN_HAS_SYNC_4
	depends on !BR2_TOOLCHAIN_HAS_THREADS || BR2_STATIC_LIBS
```

## package/libyxope/Config.in
```kconfig
config BR2_PACKAGE_LIBYXOPE
    bool "libyxope"
    depends on BR2_PACKAGE_LIBDRM
    depends on BR2_PACKAGE_MESA3D_GBM
    help
        Library to enable Thunder plugins to use EGL without modification on a PI 4

comment "libyxope requires libgbm and libdrm"
   depends on !BR2_PACKAGE_MESA3D_GBM || !BR2_PACKAGE_LIBDRM
```

## package/libzenoh-c/Config.in
```kconfig
config BR2_PACKAGE_LIBZENOH_C_ARCH_SUPPORTS
	bool
	default y if BR2_aarch64
	default y if BR2_arm
	default y if BR2_x86_64
	depends on BR2_PACKAGE_HOST_RUSTC_TARGET_ARCH_SUPPORTS

config BR2_PACKAGE_LIBZENOH_C
	bool "libzenoh-c"
	depends on BR2_PACKAGE_LIBZENOH_C_ARCH_SUPPORTS
	depends on BR2_TOOLCHAIN_USES_GLIBC
	select BR2_PACKAGE_HOST_RUSTC
	help
	  This package provides a C binding based on the main
	  Zenoh implementation written in Rust.

	  https://github.com/eclipse-zenoh/zenoh-c

comment "libzenoh-c needs a glibc toolchain"
	depends on BR2_PACKAGE_LIBZENOH_C_ARCH_SUPPORTS
	depends on !BR2_TOOLCHAIN_USES_GLIBC
```

## package/libzenoh-pico/Config.in
```kconfig
config BR2_PACKAGE_LIBZENOH_PICO
	bool "libzenoh-pico"
	# upstream hardcodes using asm("nop"), which is bogus and
	# doesn't work on or1k
	depends on !BR2_or1k
	depends on BR2_TOOLCHAIN_HAS_THREADS
	help
	  zenoh-pico is the Eclipse zenoh implementation that targets
	  constrained devices and offers a native C API. It is fully
	  compatible with its main Rust Zenoh implementation,
	  providing a lightweight implementation of most
	  functionalities.

	  https://github.com/eclipse-zenoh/zenoh-pico

comment "libzenoh-pico needs a toolchain w/ threads"
	depends on !BR2_or1k
	depends on !BR2_TOOLCHAIN_HAS_THREADS
```

## package/libzippp/Config.in
```kconfig
config BR2_PACKAGE_LIBZIPPP
	bool "libzippp"
	depends on BR2_INSTALL_LIBSTDCPP
	depends on !BR2_STATIC_LIBS # libzip
	select BR2_PACKAGE_LIBZIP
	select BR2_PACKAGE_ZLIB
	help
	  C++ wrapper for libzip

	  https://github.com/ctabin/libzippp

comment "libzippp needs a toolchain w/ C++, dynamic library"
	depends on !BR2_INSTALL_LIBSTDCPP || BR2_STATIC_LIBS
```

## package/lighttpd/Config.in
```kconfig
comment "lighttpd needs a toolchain w/ dynamic library"
	depends on BR2_USE_MMU
	depends on BR2_STATIC_LIBS

config BR2_PACKAGE_LIGHTTPD
	bool "lighttpd"
	depends on BR2_USE_MMU # fork()
	depends on !BR2_STATIC_LIBS
	select BR2_PACKAGE_XXHASH
	help
	  lighttpd a secure, fast, compliant and very flexible
	  web-server which has been optimized for high-performance
	  environments. It has a very low memory footprint compared to
	  other webservers and takes care of cpu-load. Its advanced
	  feature-set (FastCGI, CGI, Auth, Output-Compression,
	  URL-Rewriting and many more) make lighttpd the perfect
	  webserver-software for every server that is suffering load
	  problems.

	  https://www.lighttpd.net/

if BR2_PACKAGE_LIGHTTPD

config BR2_PACKAGE_LIGHTTPD_BROTLI
	bool "brotli support"
	select BR2_PACKAGE_BROTLI
	help
	  Enable brotli support for lighttpd mod_deflate.

config BR2_PACKAGE_LIGHTTPD_BZIP2
	bool "bzip2 support"
	select BR2_PACKAGE_BZIP2
	help
	  Enable bzip2 support for lighttpd mod_deflate.

config BR2_PACKAGE_LIGHTTPD_KRB5
	bool "krb5 support"
	select BR2_PACKAGE_LIBKRB5
	help
	  Enable Kerberos5 support for lighttpd mod_auth.

config BR2_PACKAGE_LIGHTTPD_LDAP
	bool "ldap support"
	depends on BR2_USE_WCHAR # openldap
	select BR2_PACKAGE_OPENLDAP
	help
	  Enable LDAP support for lighttpd mod_auth mod_vhostdb_ldap.

comment "ldap support needs a toolchain w/ wchar"
	depends on !BR2_USE_WCHAR

config BR2_PACKAGE_LIGHTTPD_LUA
	bool "lua support"
	depends on BR2_PACKAGE_LUA
	help
	  Enable Lua support. Needed to support mod_magnet

config BR2_PACKAGE_LIGHTTPD_MAXMINDDB
	bool "maxminddb support"
	select BR2_PACKAGE_LIBMAXMINDDB
	help
	  Enable MaxMind GeoIP2 support. Needed to support mod_maxminddb

config BR2_PACKAGE_LIGHTTPD_MYSQL
	bool "mysql support"
	depends on BR2_PACKAGE_MARIADB
	help
	  Enable mysql support for lighttpd mod_vhostdb_mysql.

comment "mysql support needs mariadb"
	depends on !BR2_PACKAGE_MARIADB

config BR2_PACKAGE_LIGHTTPD_OPENSSL
	bool "openssl support"
	select BR2_PACKAGE_OPENSSL
	help
	  Enable OpenSSL support for lighttpd.

config BR2_PACKAGE_LIGHTTPD_PAM
	bool "pam authentication support"
	default y
	depends on BR2_PACKAGE_LINUX_PAM
	help
	  Enable PAM authentication support for lighttpd.

config BR2_PACKAGE_LIGHTTPD_PCRE
	bool "pcre support"
	select BR2_PACKAGE_PCRE2
	help
	  Enable PCRE support. Needed to support mod_rewrite

config BR2_PACKAGE_LIGHTTPD_PGSQL
	bool "pgsql support"
	depends on BR2_USE_MMU # postgresql
	depends on BR2_USE_WCHAR # postgresql
	depends on !BR2_OPTIMIZE_FAST # postgresql
	select BR2_PACKAGE_POSTGRESQL
	help
	  Enable postgres support for lighttpd mod_vhostdb_pgsql.

comment "pgsql support needs a toolchain w/ wchar"
	depends on BR2_USE_MMU
	depends on !BR2_USE_WCHAR

comment "pgsql support can't be built with Optimize for fast"
	depends on BR2_OPTIMIZE_FAST

config BR2_PACKAGE_LIGHTTPD_WEBDAV
	bool "webdav support"
	select BR2_PACKAGE_LIBXML2
	select BR2_PACKAGE_SQLITE
	help
	  Enable webdav support. Needed to support mod_webdav

config BR2_PACKAGE_LIGHTTPD_ZLIB
	bool "zlib support"
	select BR2_PACKAGE_ZLIB
	help
	  Enable zlib support for lighttpd mod_deflate.

config BR2_PACKAGE_LIGHTTPD_ZSTD
	bool "zstd support"
	select BR2_PACKAGE_ZSTD
	help
	  Enable zstd support for lighttpd mod_deflate.

endif
```

## package/lilv/Config.in
```kconfig
config BR2_PACKAGE_LILV
	bool "lilv"
	depends on !BR2_STATIC_LIBS
	select BR2_PACKAGE_LV2
	select BR2_PACKAGE_SERD
	select BR2_PACKAGE_SORD
	select BR2_PACKAGE_SRATOM
	help
	  Lilv is a C library to make the use of LV2 plugins as simple
	  as possible for applications.

	  https://drobilla.net/software/lilv.html

comment "lilv needs a toolchain w/ dynamic library"
	depends on BR2_STATIC_LIBS
```

## package/linux-pam/Config.in
```kconfig
config BR2_PACKAGE_LINUX_PAM
	bool "linux-pam"
	depends on BR2_ENABLE_LOCALE
	depends on BR2_USE_WCHAR
	depends on !BR2_STATIC_LIBS
	depends on BR2_USE_MMU # fork()
	depends on BR2_TOOLCHAIN_GCC_AT_LEAST_4_9 # C11/stdatomic.h
	select BR2_PACKAGE_LIBXCRYPT if BR2_TOOLCHAIN_USES_GLIBC
	help
	  A Security Framework that Provides Authentication for
	  Applications

	  http://linux-pam.org

if BR2_PACKAGE_LINUX_PAM

config BR2_PACKAGE_LINUX_PAM_LASTLOG
	bool "pam_lastlog.so"
	help
	  Build pam_lastlog.so module.

endif

comment "linux-pam needs a toolchain w/ wchar, locale, dynamic library, gcc >= 4.9"
	depends on BR2_USE_MMU
	depends on !BR2_ENABLE_LOCALE || !BR2_USE_WCHAR \
		|| BR2_STATIC_LIBS || !BR2_TOOLCHAIN_GCC_AT_LEAST_4_9
```

## package/llama-cpp/Config.in
```kconfig
config BR2_PACKAGE_LLAMA_CPP_ARCH_SUPPORTS
	bool
	default y
	depends on !BR2_s390x_z13 # ggml requires z14 or higher

config BR2_PACKAGE_LLAMA_CPP
	bool "llama.cpp"
	depends on BR2_INSTALL_LIBSTDCPP
	depends on BR2_PACKAGE_LLAMA_CPP_ARCH_SUPPORTS
	depends on BR2_TOOLCHAIN_HAS_THREADS
	depends on BR2_TOOLCHAIN_GCC_AT_LEAST_9
	# llama.cpp needs libexecinfo when built with uclibc,
	# and libexecinfo needs dynamic libraries.
	depends on !BR2_TOOLCHAIN_USES_UCLIBC \
		|| (BR2_TOOLCHAIN_USES_UCLIBC && !BR2_STATIC_LIBS)
	depends on BR2_USE_WCHAR
	select BR2_PACKAGE_LIBEXECINFO if BR2_TOOLCHAIN_USES_UCLIBC
	help
	  LLM inference in C/C++

	  https://github.com/ggml-org/llama.cpp

if BR2_PACKAGE_LLAMA_CPP

config BR2_PACKAGE_LLAMA_CPP_TOOLS
	bool "Enable tools"
	help
	  Build CLI tools like llama-cli, llama-bench, etc.

config BR2_PACKAGE_LLAMA_CPP_SERVER
	bool "Enable server"
	help
	  Build OpenAI API-compatible web server, llama-server.

config BR2_PACKAGE_LLAMA_CPP_VULKAN
	bool "Vulkan support"
	depends on !BR2_ARM_CPU_ARMV5
	depends on !BR2_STATIC_LIBS # vulkan-loader
	select BR2_PACKAGE_VULKAN_LOADER
	help
	  Enable Vulkan backend for GPU acceleration.

endif

comment "llama-cpp needs a toolchain w/ C++, wchar, threads, and gcc >= 9"
	depends on !BR2_INSTALL_LIBSTDCPP || !BR2_USE_WCHAR \
		|| !BR2_TOOLCHAIN_HAS_THREADS \
		|| !BR2_TOOLCHAIN_GCC_AT_LEAST_9

comment "llama-cpp needs a uclibc toolchain w/ dynamic library"
	depends on BR2_TOOLCHAIN_USES_UCLIBC && BR2_STATIC_LIBS
```

## package/llvm-project/compiler-rt/Config.in
```kconfig
config BR2_PACKAGE_COMPILER_RT
	bool "compiler-rt"
	depends on BR2_PACKAGE_LLVM
	depends on BR2_TOOLCHAIN_USES_GLIBC # asan lib requires
	depends on BR2_HOST_GCC_AT_LEAST_5 # host-clang
	help
	  A collection of runtime libraries primarily used by clang and
	  llvm to provide builtins, sanitizer runtimes, and profiling
	  at runtime.

	  https://compiler-rt.llvm.org/

comment "compiler-rt requires llvm to be enabled, a glibc toolchain, host gcc >= 5"
	depends on !BR2_PACKAGE_LLVM
	depends on !BR2_TOOLCHAIN_USES_GLIBC ||	!BR2_HOST_GCC_AT_LEAST_5
```

## package/llvm-project/libclc/Config.in
```kconfig
config BR2_PACKAGE_LIBCLC
	bool "libclc"
	depends on BR2_PACKAGE_LLVM_ARCH_SUPPORTS
	depends on BR2_HOST_GCC_AT_LEAST_7 # host-llvm
	help
	  libclc is an open source, BSD licensed implementation of
	  the library requirements of the OpenCL C programming language,
	  as specified by the OpenCL 1.1 Specification.

	  http://libclc.llvm.org/

comment "libclc needs host gcc >= 7"
	depends on BR2_PACKAGE_LLVM_ARCH_SUPPORTS
	depends on !BR2_HOST_GCC_AT_LEAST_7
```

## package/llvm-project/lld/Config.in.host
```kconfig
config BR2_PACKAGE_HOST_LLD
	bool "host lld"
	depends on BR2_PACKAGE_LLVM_ARCH_SUPPORTS # llvm
	depends on BR2_HOST_GCC_AT_LEAST_7 # host-llvm
	help
	  LLD is a linker from the LLVM project that is a drop-in
	  replacement for system linkers, and runs much faster than
	  them. It also provides features that are useful for
	  toolchain developers.

	  https://lld.llvm.org/

comment "host lld needs host gcc >= 7"
	depends on BR2_PACKAGE_LLVM_ARCH_SUPPORTS
	depends on !BR2_HOST_GCC_AT_LEAST_7
```

## package/lmdb/Config.in
```kconfig
config BR2_PACKAGE_LMDB
	bool "lmdb"
	depends on BR2_TOOLCHAIN_HAS_THREADS
	help
	  OpenLDAP Lightning Memory-Mapped Database

	  LMDB is compact, fast, powerful, and robust and implements
	  a simplified variant of the BerkeleyDB (BDB) API.

	  https://symas.com/lmdb/

comment "lmdb needs a toolchain w/ threads"
	depends on !BR2_TOOLCHAIN_HAS_THREADS
```

## package/lockfile-progs/Config.in
```kconfig
config BR2_PACKAGE_LOCKFILE_PROGS
	bool "lockfile programs"
	depends on BR2_USE_MMU # liblockfile
	select BR2_PACKAGE_LIBLOCKFILE
	help
	  Build lockfile utility programs.
```

## package/log4c/Config.in
```kconfig
config BR2_PACKAGE_LOG4C
	bool "log4c"
	help
	  Log4c is a library of C for flexible logging to files, syslog and other destinations.
	  It is modeled after the Log for Java library (http://jakarta.apache.org/log4j/),
	  staying as close to their API as is reasonable. Here is a short introduction to Log4j
	  which describes the API, and design rationale.
 
	  http://log4c.sourceforge.net/
```

## package/log4cxx/Config.in
```kconfig
config BR2_PACKAGE_LOG4CXX
	bool "log4cxx"
	# apr really needs shared library support
	depends on !BR2_STATIC_LIBS
	depends on BR2_INSTALL_LIBSTDCPP
	depends on BR2_TOOLCHAIN_HAS_THREADS
	depends on BR2_USE_WCHAR # mbsinit
	depends on BR2_USE_MMU # apr
	depends on BR2_USE_WCHAR || BR2_TOOLCHAIN_GCC_AT_LEAST_7 # boost
	depends on BR2_TOOLCHAIN_SUPPORTS_ALWAYS_LOCKFREE_ATOMIC_INTS || BR2_TOOLCHAIN_GCC_AT_LEAST_7 # boost-thread
	depends on !BR2_TOOLCHAIN_HAS_GCC_BUG_64735 || BR2_TOOLCHAIN_GCC_AT_LEAST_7 # boost-thread
	select BR2_PACKAGE_APR
	select BR2_PACKAGE_APR_UTIL
	select BR2_PACKAGE_BOOST if !BR2_TOOLCHAIN_GCC_AT_LEAST_7
	select BR2_PACKAGE_BOOST_ATOMIC if !BR2_TOOLCHAIN_GCC_AT_LEAST_7
	select BR2_PACKAGE_BOOST_CHRONO if !BR2_TOOLCHAIN_GCC_AT_LEAST_7
	select BR2_PACKAGE_BOOST_DATE_TIME if !BR2_TOOLCHAIN_GCC_AT_LEAST_7
	select BR2_PACKAGE_BOOST_THREAD if !BR2_TOOLCHAIN_GCC_AT_LEAST_7
	help
	  Apache log4cxx is a logging framework for C++ patterned
	  after Apache log4j.

	  https://logging.apache.org/log4cxx/

comment "log4cxx needs a toolchain w/ C++, threads, dynamic library, wchar"
	depends on !BR2_INSTALL_LIBSTDCPP || !BR2_TOOLCHAIN_HAS_THREADS || \
		BR2_STATIC_LIBS || !BR2_USE_WCHAR
	depends on BR2_USE_MMU

comment "log4cxx needs a toolchain w/ wchar or gcc >= 7"
	depends on !(BR2_USE_WCHAR || BR2_TOOLCHAIN_GCC_AT_LEAST_7)
	depends on BR2_USE_MMU

comment "log4cxx needs a toolchain not affected by GCC bug 64735"
	depends on !BR2_TOOLCHAIN_GCC_AT_LEAST_7
	depends on BR2_TOOLCHAIN_HAS_GCC_BUG_64735
```

## package/log4qt/Config.in
```kconfig
config BR2_PACKAGE_LOG4QT
	bool "log4qt"
	depends on BR2_PACKAGE_QT5
	help
	  Log4Qt is a C++ port of the Apache Software Foundation
	  Log4j package using the Qt Framework. It is intended to be
	  used by open source and commercial Qt projects.

	  https://github.com/MEONMedical/Log4Qt

comment "log4qt needs qt5"
	depends on !BR2_PACKAGE_QT5
```

## package/lora-net/Config.in
```kconfig
source "package/lora-net/lora-gateway/Config.in"
source "package/lora-net/lora-packetforwarder/Config.in"
```

## package/lora-net/lora-gateway/Config.in
```kconfig
config BR2_PACKAGE_LORA_GATEWAY
	bool "lora-gateway"
	select BR2_PACKAGE_LIBUSB
	select BR2_PACKAGE_LIBMPSSE
	help
	  Driver/HAL to build a gateway using a concentrator board based 
	  on Semtech SX1301 multi-channel modem and SX1257/SX1255 RF 
	  transceivers.
```

## package/lora-net/lora-packetforwarder/Config.in
```kconfig
config BR2_PACKAGE_LORA_PACKETFORWARDER
	bool "lora-packetforwarder"
	select BR2_PACKAGE_LORA_GATEWAY
	help
	  Multi protocol packet forwarder supporting the TTN gateway-connector protocol.
```

## package/lowdown/Config.in
```kconfig
config BR2_PACKAGE_LOWDOWN
	bool "lowdown"
	depends on BR2_USE_WCHAR
	depends on !BR2_STATIC_LIBS
	help
	  Simple markdown translator to HTML5, terminal, and more.
	  Useful for providing the same help texts both for a CLI
	  and web.

	  https://kristaps.bsd.lv/lowdown/

comment "lowdown needs a toolchain w/ wchar and shared library support"
	depends on BR2_USE_WCHAR
	depends on !BR2_STATIC_LIBS
```

## package/lpac/Config.in
```kconfig
config BR2_PACKAGE_LPAC
	bool "lpac"
	depends on BR2_TOOLCHAIN_HAS_THREADS # pcsc-lite
	depends on BR2_USE_MMU # pcsc-lite
	depends on !BR2_STATIC_LIBS # pcsc-lite
	depends on BR2_TOOLCHAIN_GCC_AT_LEAST_4_9 # pcsc-lite
	select BR2_PACKAGE_PCSC_LITE
	help
	  C-based eUICC LPA.

	  https://github.com/estkme-group/lpac

comment "lpac needs a toolchain w/ threads, dynamic library, gcc >= 4.9"
	depends on BR2_USE_MMU
	depends on !BR2_TOOLCHAIN_HAS_THREADS || BR2_STATIC_LIBS || \
		!BR2_TOOLCHAIN_GCC_AT_LEAST_4_9
```
