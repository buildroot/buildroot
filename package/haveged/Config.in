## package/haveged/Config.in
```kconfig
config BR2_PACKAGE_HAVEGED
	bool "haveged"
	depends on BR2_USE_MMU # fork()
	depends on BR2_TOOLCHAIN_HAS_THREADS # semaphore.h
	help
	  The haveged project is an attempt to provide an easy-to-use,
	  unpredictable random number generator based upon an adaptation
	  of the HAVEGE algorithm.

	  http://www.issihosts.com/haveged/

comment "haveged needs a toolchain w/ threads"
	depends on BR2_USE_MMU
	depends on !BR2_TOOLCHAIN_HAS_THREADS
```

## package/heaptrack/Config.in
```kconfig
config BR2_PACKAGE_HEAPTRACK
	bool "heaptrack"
	depends on BR2_INSTALL_LIBSTDCPP
	depends on BR2_TOOLCHAIN_HAS_THREADS # boost, libunwind, elfutils
	depends on BR2_USE_WCHAR # boost, elfutils
	depends on BR2_TOOLCHAIN_SUPPORTS_ALWAYS_LOCKFREE_ATOMIC_INTS # boost-filesystem
	depends on BR2_PACKAGE_LIBUNWIND_ARCH_SUPPORTS # libunwind
	depends on BR2_TOOLCHAIN_GCC_AT_LEAST_8 # C++17 filesystem
	depends on !BR2_STATIC_LIBS # libunwind, elfutils
	depends on !BR2_TOOLCHAIN_USES_UCLIBC # no dlmopen() support
	select BR2_PACKAGE_BOOST
	select BR2_PACKAGE_BOOST_IOSTREAMS
	select BR2_PACKAGE_BOOST_PROGRAM_OPTIONS
	# For heaptrack_print
	select BR2_PACKAGE_BOOST_FILESYSTEM
	select BR2_PACKAGE_ELFUTILS
	select BR2_PACKAGE_LIBUNWIND
	select BR2_PACKAGE_ZLIB
	help
	  Heaptrack traces all memory allocations and annotates these
	  events with stack traces. Dedicated analysis tools then allow
	  you to interpret the heap memory profile to find hotspots,
	  memory leaks, allocation hotspots and temporary allocations.

	  Zstandard offers better (de)compression performance compared
	  with gzip/zlib, making heaptrack faster and datafiles smaller,
	  so enabling BR2_PACKAGE_ZSTD is recommended.

	  https://apps.kde.org/heaptrack/

comment "heaptrack needs a glibc or musl toolchain w/ C++, threads, wchar, gcc >= 8, dynamic library"
	depends on BR2_TOOLCHAIN_SUPPORTS_ALWAYS_LOCKFREE_ATOMIC_INTS
	depends on BR2_PACKAGE_LIBUNWIND_ARCH_SUPPORTS
	depends on !BR2_INSTALL_LIBSTDCPP \
		|| !BR2_TOOLCHAIN_HAS_THREADS \
		|| !BR2_USE_WCHAR \
		|| !BR2_TOOLCHAIN_GCC_AT_LEAST_8 \
		|| BR2_STATIC_LIBS \
		|| BR2_TOOLCHAIN_USES_UCLIBC
```

## package/hidapi/Config.in
```kconfig
config BR2_PACKAGE_HIDAPI
	bool "hidapi"
	depends on BR2_PACKAGE_HAS_UDEV
	depends on BR2_TOOLCHAIN_HAS_THREADS_NPTL
	depends on BR2_TOOLCHAIN_GCC_AT_LEAST_4_9 # libusb
	depends on BR2_USE_MMU # libgudev
	depends on BR2_USE_WCHAR # libgudev
	select BR2_PACKAGE_LIBUSB
	select BR2_PACKAGE_LIBGUDEV
	select BR2_PACKAGE_LIBICONV if !BR2_ENABLE_LOCALE
	# runtime UTF conversion support
	select BR2_TOOLCHAIN_GLIBC_GCONV_LIBS_COPY if BR2_TOOLCHAIN_USES_GLIBC
	help
	  HIDAPI is a multi-platform library which allows an application
	  to interface with USB and Bluetooth HID-Class devices on
	  Windows, Linux, and Mac OS X.

	  http://github.com/libusb/hidapi/

comment "hidapi needs udev /dev management and a toolchain w/ NPTL, gcc >= 4.9, wchar"
	depends on BR2_USE_MMU
	depends on !BR2_TOOLCHAIN_HAS_THREADS_NPTL || \
		!BR2_PACKAGE_HAS_UDEV || \
		!BR2_TOOLCHAIN_GCC_AT_LEAST_4_9 || \
		!BR2_USE_WCHAR
```

## package/httpdate/Config.in
```kconfig
config BR2_PACKAGE_HTTPDATE
	bool "httpdate"
	depends on BR2_USE_MMU # daemon()
	select BR2_PACKAGE_LIBCURL
	help
	  httpdate synchronizes the system time using the Date header
	  of HTTP and HTTPS servers, which is useful on networks where
	  NTP is blocked but web access is permitted. It is the
	  successor of htpdate.

	  https://github.com/twekkel/httpdate
```

## package/i2pd/Config.in
```kconfig
config BR2_PACKAGE_I2PD
	bool "i2pd"
	depends on BR2_USE_MMU # fork()
	depends on BR2_TOOLCHAIN_GCC_AT_LEAST_8 # string_view
	depends on BR2_TOOLCHAIN_HAS_ATOMIC
	# pthread_condattr_setclock
	depends on BR2_TOOLCHAIN_HAS_THREADS_NPTL
	depends on BR2_TOOLCHAIN_SUPPORTS_ALWAYS_LOCKFREE_ATOMIC_INTS # boost-filesystem
	depends on BR2_INSTALL_LIBSTDCPP
	depends on BR2_USE_WCHAR # boost
	select BR2_PACKAGE_BOOST
	select BR2_PACKAGE_BOOST_FILESYSTEM
	select BR2_PACKAGE_BOOST_PROGRAM_OPTIONS
	select BR2_PACKAGE_OPENSSL
	select BR2_PACKAGE_ZLIB
	help
	  i2pd (I2P Daemon) is a full-featured C++ implementation of I2P
	  client.

	  I2P (Invisible Internet Protocol) is a universal anonymous
	  network layer.
	  All communications over I2P are anonymous and end-to-end
	  encrypted, participants don't reveal their real IP addresses.

	  http://i2pd.website

comment "i2pd needs a toolchain w/ C++, gcc >= 8, NPTL, wchar"
	depends on BR2_USE_MMU
	depends on BR2_TOOLCHAIN_HAS_ATOMIC
	depends on BR2_TOOLCHAIN_SUPPORTS_ALWAYS_LOCKFREE_ATOMIC_INTS
	depends on !BR2_INSTALL_LIBSTDCPP || \
		!BR2_TOOLCHAIN_GCC_AT_LEAST_8 || \
		!BR2_TOOLCHAIN_HAS_THREADS_NPTL || !BR2_USE_WCHAR
```

## package/jwt-cpp/Config.in
```kconfig
config BR2_PACKAGE_JWT_CPP
	bool "jwt-cpp"
	depends on BR2_INSTALL_LIBSTDCPP
	depends on BR2_TOOLCHAIN_GCC_AT_LEAST_4_8 # C++11
	select BR2_PACKAGE_OPENSSL
	help
	  A header only library for creating and validating json web
	  tokens in c++

	  https://thalhammer.github.io/jwt-cpp/

comment "jwt-cpp needs a toolchain w/ C++, gcc >= 4.8"
	depends on !BR2_INSTALL_LIBSTDCPP || !BR2_TOOLCHAIN_GCC_AT_LEAST_4_8
```

## package/libaec/Config.in
```kconfig
config BR2_PACKAGE_LIBAEC
	bool "libaec"
	select BR2_HOST_CMAKE_AT_LEAST_3_26
	help
	  libaec provides fast lossless compression of 1 up to 32 bit
	  wide signed or unsigned integers (samples). It implements
	  Golomb-Rice compression method under the BSD license and
	  includes a free drop-in replacement for the SZIP library.

	  https://github.com/Deutsches-Klimarechenzentrum/libaec
```

## package/libdeflate/Config.in
```kconfig
config BR2_PACKAGE_LIBDEFLATE
	bool "libdeflate"
	depends on BR2_TOOLCHAIN_GCC_AT_LEAST_4_8 # C11
	help
	  Libdeflate is a heavily optimized library for DEFLATE/zlib/
	  gzip compression and decompression

	  https://github.com/ebiggers/libdeflate

comment "libdeflate needs a toolchain w/ gcc >= 4.8"
	depends on !BR2_TOOLCHAIN_GCC_AT_LEAST_4_8
```

## package/libdvdcss/Config.in
```kconfig
config BR2_PACKAGE_LIBDVDCSS
	bool "libdvdcss"
	depends on BR2_TOOLCHAIN_GCC_AT_LEAST_8 # std=c17
	help
	  libdvdcss is a simple library designed for accessing DVDs like
	  a block device without having to bother about the decryption.

	  http://www.videolan.org/developers/libdvdcss.html

comment "libdvdcss needs a toolchain w/ gcc >= 8"
	depends on !BR2_TOOLCHAIN_GCC_AT_LEAST_8
```

## package/libdvdnav/Config.in
```kconfig
config BR2_PACKAGE_LIBDVDNAV
	bool "libdvdnav"
	depends on BR2_TOOLCHAIN_GCC_AT_LEAST_8 # libdvdcss -> libdvdread
	depends on BR2_TOOLCHAIN_HAS_THREADS
	select BR2_PACKAGE_LIBDVDREAD
	help
	  libdvdnav is a library that allows easy use of sophisticated
	  DVD navigation features such as DVD menus, multiangle
	  playback and even interactive DVD games.

	  https://www.videolan.org/developers/libdvdnav.html

comment "libdvdnav needs a toolchain w/ threads, gcc >= 8"
	depends on !BR2_TOOLCHAIN_HAS_THREADS || \
		!BR2_TOOLCHAIN_GCC_AT_LEAST_8
```

## package/libdvdread/Config.in
```kconfig
config BR2_PACKAGE_LIBDVDREAD
	bool "libdvdread"
	depends on BR2_TOOLCHAIN_GCC_AT_LEAST_8 # libdvdcss
	select BR2_PACKAGE_LIBDVDCSS
	help
	  libdvdread provides a simple foundation for reading
	  DVD-Video images.

	  https://www.videolan.org/developers/libdvdnav.html

comment "libdvdread needs a toolchain w/ gcc >= 8"
	depends on !BR2_TOOLCHAIN_GCC_AT_LEAST_8
```

## package/libepoxy/Config.in
```kconfig
config BR2_PACKAGE_LIBEPOXY
	bool "libepoxy"
	depends on BR2_TOOLCHAIN_HAS_THREADS
	depends on !BR2_STATIC_LIBS # dlfcn.h
	select BR2_PACKAGE_XUTIL_UTIL_MACROS
	help
	  Epoxy is a library for handling OpenGL function pointer
	  management for you.

	  It can be built without EGL or GLX support for packages
	  that use libepoxy as a mandatory dependency but do not need
	  OpenGL entry points at runtime.

	  https://github.com/anholt/libepoxy

comment "libepoxy needs a toolchain w/ dynamic library, threads"
	depends on BR2_STATIC_LIBS || !BR2_TOOLCHAIN_HAS_THREADS
```

## package/libgpiod2/Config.in
```kconfig
config BR2_PACKAGE_LIBGPIOD2
	bool "libgpiod2"
	depends on BR2_TOOLCHAIN_HEADERS_AT_LEAST_5_10
	depends on !BR2_PACKAGE_LIBGPIOD
	help
	  This is a C library that abstracts the GPIO character
	  device operations on linux.

	  This package is the continuation of the libgpiod package
	  for versions 2.0 and above.

	  Note that a kernel of 5.10 or above is required for the
	  ioctls to work.

	  https://git.kernel.org/pub/scm/libs/libgpiod/libgpiod.git/

if BR2_PACKAGE_LIBGPIOD2

config BR2_PACKAGE_LIBGPIOD2_DBUS
	bool "install dbus-server and client"
	depends on BR2_PACKAGE_HAS_UDEV # libgudev
	depends on BR2_TOOLCHAIN_HAS_THREADS # libgudev
	depends on BR2_USE_MMU # libgudev
	depends on BR2_USE_WCHAR # libgudev
	select BR2_PACKAGE_LIBGUDEV
	help
	  Include dbus-server and client for managing GPIOs.

comment "libgpiod2 dbus needs udev /dev management"
	depends on BR2_USE_MMU
	depends on !BR2_PACKAGE_HAS_UDEV

comment "libgpiod2 dbus needs a toolchain w/ threads, wchar"
	depends on BR2_USE_MMU
	depends on !BR2_TOOLCHAIN_HAS_THREADS || !BR2_USE_WCHAR

config BR2_PACKAGE_LIBGPIOD2_TOOLS
	bool "install tools"
	help
	  Include a set of command-line tools for managing GPIOs.

endif

comment "libgpiod2 needs kernel headers >= 5.10"
	depends on !BR2_TOOLCHAIN_HEADERS_AT_LEAST_5_10

comment "libgpiod2 is incompatible with libgpiod"
	depends on BR2_PACKAGE_LIBGPIOD
```

## package/liblc3/Config.in
```kconfig
config BR2_PACKAGE_LIBLC3
	bool "liblc3"
	help
	  LC3 is an efficient low latency audio codec, specified by
	  the Bluetooth SIG for the LE Audio profiles. This is the
	  Google implementation of the encoder and decoder.

	  https://github.com/google/liblc3
```

## package/librdkafka/Config.in
```kconfig
config BR2_PACKAGE_LIBRDKAFKA
	bool "librdkafka"
	depends on !BR2_m68k_cf # assembler "out of range" error
	depends on BR2_TOOLCHAIN_HAS_THREADS
	select BR2_PACKAGE_LZ4
	help
	  librdkafka is a C library implementation of the
	  Apache Kafka protocol, providing Producer, Consumer
	  and Admin clients.

	  https://github.com/confluentinc/librdkafka

comment "librdkafka needs a toolchain w/ threads"
	depends on !BR2_m68k_cf
	depends on !BR2_TOOLCHAIN_HAS_THREADS
```

## package/libuio/Config.in
```kconfig
config BR2_PACKAGE_LIBUIO
	bool "libuio"
	select BR2_PACKAGE_ARGP_STANDALONE if !BR2_TOOLCHAIN_USES_GLIBC
	help
	  libuio is a light-weight C programming library to handle UIO
	  (Userspace I/O) device discovery and binding task.

	  http://github.com/Linutronix/libuio
```

## package/libusb-compat/Config.in
```kconfig
config BR2_PACKAGE_LIBUSB_COMPAT
	bool "libusb-compat"
	depends on BR2_PACKAGE_LIBUSB
	help
	  libusb-0.1 compatibility layer for libusb-1.0.

	  http://libusb.info/

if BR2_PACKAGE_LIBUSB_COMPAT

config BR2_PACKAGE_LIBUSB_COMPAT_EXAMPLES
	bool "build libusb-compat examples"
	help
	  Build and install the libusb-compat example programs (lsusb,
	  testlibusb and hotplug_monitor) in
	  /usr/libexec/libusb-compat/examples.

endif
```

## package/libvpl/Config.in
```kconfig
config BR2_PACKAGE_LIBVPL_ARCH_SUPPORTS
	bool
	default y if BR2_ARCH_IS_64 && !BR2_mips64 && !BR2_mips64el
	default y if BR2_arm

config BR2_PACKAGE_LIBVPL
	bool "libvpl"
	depends on BR2_PACKAGE_LIBVPL_ARCH_SUPPORTS
	depends on BR2_INSTALL_LIBSTDCPP
	depends on !BR2_STATIC_LIBS # dlfcn.h
	depends on BR2_TOOLCHAIN_GCC_AT_LEAST_7
	depends on BR2_TOOLCHAIN_HAS_THREADS
	help
	  oneAPI Video Processing Library (oneVPL) dispatcher,
	  tools, and examples

	  https://github.com/oneapi-src/oneVPL

comment "libvpl needs a toolchain w/ dynamic library, gcc >= 7, C++, threads"
	depends on BR2_PACKAGE_LIBVPL_ARCH_SUPPORTS
	depends on BR2_STATIC_LIBS || !BR2_TOOLCHAIN_GCC_AT_LEAST_7 || \
		!BR2_INSTALL_LIBSTDCPP || !BR2_TOOLCHAIN_HAS_THREADS
```

## package/libxmlsec1/Config.in
```kconfig
config BR2_PACKAGE_LIBXMLSEC1
	bool "libxmlsec1"
	depends on BR2_TOOLCHAIN_GCC_AT_LEAST_7 #-Wformat-overflow
	depends on BR2_TOOLCHAIN_HAS_ATOMIC
	select BR2_PACKAGE_OPENSSL
	select BR2_PACKAGE_LIBXML2
	help
	  XMLSec library provides C based implementation for major XML
	  Security standards:
	    - XML Signature Syntax and Processing
	    - XML Encryption Syntax and Processing

	  https://www.aleksey.com/xmlsec/
	  https://github.com/lsh123/xmlsec

comment "libxmlsec1 needs a toolchain w/ gcc >= 7"
	depends on  !BR2_TOOLCHAIN_GCC_AT_LEAST_7 || !BR2_TOOLCHAIN_HAS_ATOMIC
```

## package/luafilesystem/Config.in
```kconfig
config BR2_PACKAGE_LUAFILESYSTEM
	bool "luafilesystem"
	help
	  LuaFileSystem offers a portable way to access
	  the underlying directory structure and file attributes.

	  https://lunarmodules.github.io/luafilesystem/
```

## package/luaunbound/Config.in
```kconfig
config BR2_PACKAGE_LUAUNBOUND
	bool "luaunbound"
	select BR2_PACKAGE_UNBOUND
	help
	  A binding to libunbound.

	  https://www.zash.se/luaunbound.html
```

## package/mender/Config.in
```kconfig
config BR2_PACKAGE_MENDER
	bool "mender"
	depends on BR2_INSTALL_LIBSTDCPP
	depends on BR2_TOOLCHAIN_GCC_AT_LEAST_4_7 # (bundled yaml-cpp)
	depends on BR2_TOOLCHAIN_HAS_THREADS_NPTL # boost-log
	depends on BR2_TOOLCHAIN_SUPPORTS_ALWAYS_LOCKFREE_ATOMIC_INTS # boost-log
	depends on !BR2_TOOLCHAIN_HAS_GCC_BUG_64735 # boost-log
	depends on BR2_USE_MMU # libglib2
	depends on BR2_USE_WCHAR # boost, libarchive, libglib2
	depends on BR2_PACKAGE_SYSTEMD
	select BR2_PACKAGE_BOOST
	select BR2_PACKAGE_BOOST_FILESYSTEM
	select BR2_PACKAGE_BOOST_LOG
	select BR2_PACKAGE_CA_CERTIFICATES
	select BR2_PACKAGE_LIBARCHIVE
	select BR2_PACKAGE_LIBGLIB2
	select BR2_PACKAGE_LMDB
	select BR2_PACKAGE_OPENSSL
	select BR2_PACKAGE_OPENSSL_FORCE_LIBOPENSSL
	select BR2_PACKAGE_LIBOPENSSL_ENGINES
	select BR2_PACKAGE_LIBOPENSSL_ENABLE_MD4
	select BR2_PACKAGE_LIBOPENSSL_ENABLE_RMD160
	help
	  Mender is an open source over-the-air (OTA) software updater
	  for embedded Linux devices. Mender comprises a client
	  running at the embedded device, as well as a server that
	  manages deployments across many devices.

	  Notes:
	  For systems using uboot as the bootloader:
	    - uboot must have the mender uboot patches applied.
	    - uboot-tools must be selected.
	    - fw_printenv must be functional on the device.
	  The Mender Uboot patches are at:
	  https://github.com/mendersoftware/meta-mender/tree/master/meta-mender-core/recipes-bsp/u-boot/patches

	  For more information on Manual U-Boot integration, see:
	  https://docs.mender.io/3.4/system-updates-yocto-project/board-integration/bootloader-support/u-boot/manual-u-boot-integration

	  For systems using Grub2 as the bootloader:
	    - Mender depends on the mender-grubenv package.

	  The mender project recommends using uboot to load Grub2 as a
	  secondary bootloader whenever possible. Using Grub2 as a
	  secondary bootloader prevents users from porting the patches
	  for uboot to each new device.

	  https://github.com/mendersoftware/mender

comment "mender needs systemd"
	depends on !BR2_PACKAGE_SYSTEMD

comment "mender needs a toolchain w/ C++, NPTL, wchar, not affected by GCC bug 64735"
	depends on BR2_USE_MMU
	depends on BR2_TOOLCHAIN_SUPPORTS_ALWAYS_LOCKFREE_ATOMIC_INTS
	depends on BR2_TOOLCHAIN_HAS_GCC_BUG_64735
	depends on !BR2_INSTALL_LIBSTDCPP || !BR2_USE_WCHAR || \
		!BR2_TOOLCHAIN_HAS_THREADS_NPTL
```

## package/mini-snmpd/Config.in
```kconfig
config BR2_PACKAGE_MINI_SNMPD
	bool "mini-snmpd"
	help
	  Mini SNMPd is a minimal implementation targeted at small or
	  embedded UNIX systems with limited resources

	  Enable BR2_PACKAGE_LIBCONFUSE for /etc/mini-snmpd.conf support
	  with an example file.  Also enabling BR2_PACKAGE_ETHTOOL adds
	  ethtool-based interface statistics.

	  https://troglobit.com/mini-snmpd.html

if BR2_PACKAGE_MINI_SNMPD

config BR2_PACKAGE_MINI_SNMPD_INTERFACES
	int "Number of network interfaces"
	default 8
	range 1 256
	help
	  Max number of network interfaces exposed in IF-MIB::ifTable

endif
```
