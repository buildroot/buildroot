## package/python-jc/Config.in
```kconfig
config BR2_PACKAGE_PYTHON_JC
	bool "python-jc"
	help
	  Converts the output of popular command-line tools and file-
	  types to JSON.

	  Optionally requires python-pygments for syntax highlighting,
	  python-ruamel-yaml for yaml parsing and output and
	  python-xmltodict for xml parsing. PYTHON3_PYEXPAT is required
	  for xml and plist parsers.

	  https://github.com/kellyjonbrazil/jc
```

## package/python-jeepney/Config.in
```kconfig
config BR2_PACKAGE_PYTHON_JEEPNEY
	bool "python-jeepney"
	help
	  Low-level, pure Python DBus protocol wrapper.

	  https://gitlab.com/takluyver/jeepney
```

## package/python-jinja2/Config.in
```kconfig
config BR2_PACKAGE_PYTHON_JINJA2
	bool "python-jinja2"
	depends on BR2_PACKAGE_PYTHON3
	select BR2_PACKAGE_PYTHON_MARKUPSAFE # runtime
	select BR2_PACKAGE_PYTHON3_UNICODEDATA
	help
	  Jinja2 is a template engine written in pure Python. It
	  provides a Django inspired non-XML syntax but supports
	  inline expressions and an optional sandboxed environment.

	  http://jinja.pocoo.org/
```

## package/python-jsonmodels/Config.in
```kconfig
config BR2_PACKAGE_PYTHON_JSONMODELS
	bool "python-jsonmodels"
	depends on BR2_PACKAGE_PYTHON3 # python-dateutil -> host-python-setuptools-scm
	select BR2_PACKAGE_PYTHON_DATEUTIL # runtime
	select BR2_PACKAGE_PYTHON_SIX # runtime
	help
	  Models to make easier to deal with structures that are
	  converted to, or read from JSON.

	  https://github.com/beregond/jsonmodels
```

## package/python-jsonref/Config.in
```kconfig
config BR2_PACKAGE_PYTHON_JSONREF
	bool "python-jsonref"
	help
	  An implementation for automatic dereferencing of JSON Reference objects for Python.
```

## package/python-jsonschema-specifications/Config.in
```kconfig
config BR2_PACKAGE_PYTHON_JSONSCHEMA_SPECIFICATIONS
	bool "python-jsonschema-specifications"
	depends on BR2_PACKAGE_HOST_RUSTC_TARGET_ARCH_SUPPORTS # python-referencing -> python-rpds-py
	select BR2_PACKAGE_PYTHON_REFERENCING # runtime
	help
	  The JSON Schema meta-schemas and vocabularies, exposed as a
	  Registry.

	  https://github.com/python-jsonschema/jsonschema-specifications
```

## package/python-jsonschema/Config.in
```kconfig
config BR2_PACKAGE_PYTHON_JSONSCHEMA
	bool "python-jsonschema"
	depends on BR2_PACKAGE_HOST_RUSTC_TARGET_ARCH_SUPPORTS # python-rpds-py
	select BR2_PACKAGE_PYTHON_ATTRS # runtime
	select BR2_PACKAGE_PYTHON_JSONSCHEMA_SPECIFICATIONS # runtime
	select BR2_PACKAGE_PYTHON_REFERENCING # runtime
	select BR2_PACKAGE_PYTHON_RPDS_PY # runtime
	help
	  An implementation of JSON Schema validation for Python.

	  https://github.com/python-jsonschema/jsonschema
```

## package/python-keyring/Config.in
```kconfig
config BR2_PACKAGE_PYTHON_KEYRING
	bool "python-keyring"
	# python-secretstorage -> python-cryptography
	depends on BR2_PACKAGE_HOST_RUSTC_TARGET_ARCH_SUPPORTS
	select BR2_PACKAGE_PYTHON_JARACO_CLASSES # runtime
	select BR2_PACKAGE_PYTHON_JARACO_CONTEXT # runtime
	select BR2_PACKAGE_PYTHON_JARACO_FUNCTOOLS # runtime
	select BR2_PACKAGE_PYTHON_JEEPNEY # runtime
	select BR2_PACKAGE_PYTHON_SECRETSTORAGE # runtime
	help
	  The Python keyring lib provides a easy way to access the
	  system keyring service from Python.

	  https://pypi.python.org/pypi/keyring
```

## package/python-kflash/Config.in.host
```kconfig
config BR2_PACKAGE_HOST_PYTHON_KFLASH
	bool "host python-kflash"
	depends on BR2_RISCV_64 && !BR2_USE_MMU
	help
	  Kendryte UART ISP Utility - programming code to k210.

	  https://github.com/vowstar/kflash.py
```

## package/python-kivy/Config.in
```kconfig
config BR2_PACKAGE_PYTHON_KIVY
	bool "python-kivy"
	select BR2_PACKAGE_HOST_PYTHON_CYTHON
	select BR2_PACKAGE_LIBPNG # runtime
	select BR2_PACKAGE_MTDEV  # runtime
	select BR2_PACKAGE_PYTHON_DOCUTILS # runtime
	select BR2_PACKAGE_PYTHON_PYGMENTS # runtime
	help
	  A software library for rapid development of
	  hardware-accelerated multitouch applications.

	  http://kivy.org

# comment "python-kivy needs an OpenGL provider"
	#depends on !BR2_PACKAGE_HAS_LIBGL
```

## package/python-kmod/Config.in
```kconfig
config BR2_PACKAGE_PYTHON_KMOD
	bool "python-kmod"
	depends on !BR2_STATIC_LIBS # kmod
	select BR2_PACKAGE_HOST_PYTHON_CYTHON
	select BR2_PACKAGE_KMOD
	help
	  Python binding for kmod

	  https://github.com/maurizio-lombardi/python-kmod

comment "python-kmod needs a toolchain w/ dynamic library"
	depends on BR2_STATIC_LIBS
```

## package/python-lark/Config.in
```kconfig
config BR2_PACKAGE_PYTHON_LARK
	bool "python-lark"
	help
	  Lark is a parsing toolkit for Python, built with a focus
	  on ergonomics, performance and modularity.

	  https://github.com/lark-parser/lark
```

## package/python-legacy-cgi/Config.in
```kconfig
config BR2_PACKAGE_PYTHON_LEGACY_CGI
	bool "python-legacy-cgi"
	help
	  Fork of the standard library cgi and cgitb modules, being
	  deprecated in PEP-594.

	  https://github.com/jackrosenthal/legacy-cgi
```

## package/python-libconf/Config.in
```kconfig
config BR2_PACKAGE_PYTHON_LIBCONF
	bool "python-libconf"
	help
	  libconf is a pure-Python reader/writer for configuration files
	  in libconfig format, which is often used in C/C++ projects.

	  https://github.com/ChrisAichinger/python-libconf/
```

## package/python-libevdev/Config.in
```kconfig
config BR2_PACKAGE_PYTHON_LIBEVDEV
	bool "python-libevdev"
	select BR2_PACKAGE_LIBEVDEV # runtime
	help
	  Python wrapper for libevdev.

	  https://gitlab.freedesktop.org/libevdev/python-libevdev
```

## package/python-libyang/Config.in
```kconfig
config BR2_PACKAGE_PYTHON_LIBYANG
	bool "python-libyang"
	depends on BR2_TOOLCHAIN_HAS_SYNC_4 # libyang
	depends on BR2_TOOLCHAIN_HAS_THREADS # libyang
	depends on !BR2_STATIC_LIBS # libyang
	select BR2_PACKAGE_LIBYANG
	select BR2_PACKAGE_PYTHON_CFFI # runtime
	help
	  Python CFFI bindings for the libyang YANG library.

	  This package provides the 'libyang' Python module, used by
	  higher-level tooling such as python-sysrepo.

	  https://github.com/CESNET/libyang-python

comment "python-libyang needs a toolchain w/ threads, dynamic library"
	depends on !BR2_TOOLCHAIN_HAS_SYNC_4
	depends on !BR2_TOOLCHAIN_HAS_THREADS || BR2_STATIC_LIBS
```

## package/python-lmdb/Config.in
```kconfig
config BR2_PACKAGE_PYTHON_LMDB
	bool "python-lmdb"
	select BR2_PACKAGE_PYTHON_CFFI # runtime
	select BR2_PACKAGE_PYTHON_PATCH_NG # runtime
	help
	  Universal Python binding for the LMDB 'Lightning' Database.

	  https://pypi.python.org/pypi/lmdb
```

## package/python-log-rate-limit/Config.in
```kconfig
config BR2_PACKAGE_PYTHON_LOG_RATE_LIMIT
	bool "python-log-rate-limit"
	help
	  Limit excessive log output with Python's standard logging
	  framework.

	  https://github.com/samuller/log-rate-limit
```

## package/python-logbook/Config.in
```kconfig
config BR2_PACKAGE_PYTHON_LOGBOOK
	bool "python-logbook"
	depends on BR2_PACKAGE_HOST_RUSTC_TARGET_ARCH_SUPPORTS
	select BR2_PACKAGE_PYTHON3_ZLIB
	select BR2_PACKAGE_PYTHON_TYPING_EXTENSIONS # runtime
	help
	  A logging replacement for Python.

	  http://logbook.pocoo.org/
```

## package/python-m2crypto/Config.in
```kconfig
config BR2_PACKAGE_PYTHON_M2CRYPTO
	bool "python-m2crypto"
	select BR2_PACKAGE_OPENSSL
	select BR2_PACKAGE_PYTHON3_PYEXPAT # runtime
	select BR2_PACKAGE_PYTHON3_SSL # runtime
	help
	  M2Crypto: A Python crypto and SSL toolkit.

	  https://gitlab.com/m2crypto/m2crypto
```

## package/python-magic-wormhole-mailbox-server/Config.in
```kconfig
config BR2_PACKAGE_PYTHON_MAGIC_WORMHOLE_MAILBOX_SERVER
	bool "python-magic-wormhole-mailbox-server"
	depends on BR2_PACKAGE_HOST_RUSTC_TARGET_ARCH_SUPPORTS # python-autobahn -> python-cryptography
	select BR2_PACKAGE_PYTHON3_SQLITE # runtime
	select BR2_PACKAGE_PYTHON_ATTRS # runtime
	select BR2_PACKAGE_PYTHON_AUTOBAHN # runtime
	select BR2_PACKAGE_PYTHON_SIX # runtime
	select BR2_PACKAGE_PYTHON_TWISTED # runtime
	help
	  This package is the main server that Magic-Wormhole clients
	  connect to. The server performs store-and-forward delivery
	  for small key-exchange and control messages. Bulk data is
	  sent over a direct TCP connection, or through a
	  transit-relay.

	  https://github.com/magic-wormhole/magic-wormhole-mailbox-server
```

## package/python-magic-wormhole-transit-relay/Config.in
```kconfig
config BR2_PACKAGE_PYTHON_MAGIC_WORMHOLE_TRANSIT_RELAY
	bool "python-magic-wormhole-transit-relay"
	depends on BR2_PACKAGE_HOST_RUSTC_TARGET_ARCH_SUPPORTS # python-autobahn -> python-cryptography
	select BR2_PACKAGE_PYTHON_AUTOBAHN # runtime
	select BR2_PACKAGE_PYTHON_TWISTED # runtime
	help
	  Transit Relay server for Magic-Wormhole.

	  This repository implements the Magic-Wormhole "Transit
	  Relay", a server that helps clients establish bulk-data
	  transit connections even when both are behind NAT
	  boxes. Each side makes a TCP connection to this server and
	  presents a handshake. Two connections with identical
	  handshakes are glued together, allowing them to pretend they
	  have a direct connection.

	  https://github.com/magic-wormhole/magic-wormhole-transit-relay
```

## package/python-magic-wormhole/Config.in
```kconfig
config BR2_PACKAGE_PYTHON_MAGIC_WORMHOLE
	bool "python-magic-wormhole"
	depends on BR2_PACKAGE_HOST_RUSTC_TARGET_ARCH_SUPPORTS # python-cryptography
	select BR2_PACKAGE_PYTHON_ATTRS # runtime
	select BR2_PACKAGE_PYTHON_AUTOBAHN # runtime
	select BR2_PACKAGE_PYTHON_AUTOMAT # runtime
	select BR2_PACKAGE_PYTHON_CLICK # runtime
	select BR2_PACKAGE_PYTHON_CRYPTOGRAPHY # runtime
	select BR2_PACKAGE_PYTHON_HUMANIZE # runtime
	select BR2_PACKAGE_PYTHON_PYNACL # runtime
	select BR2_PACKAGE_PYTHON_SIX # runtime
	select BR2_PACKAGE_PYTHON_SPAKE2 # runtime
	select BR2_PACKAGE_PYTHON_TQDM # runtime
	select BR2_PACKAGE_PYTHON_TWISTED # runtime
	select BR2_PACKAGE_PYTHON_TXTORCON # runtime
	help
	  Securely transfer data between computers.

	  This package provides a library and a command-line tool
	  named "wormhole", which makes it possible to get
	  arbitrary-sized files and directories (or short pieces of
	  text) from one computer to another. The two endpoints are
	  identified by using identical "wormhole codes": in general,
	  the sending machine generates and displays the code, which
	  must then be typed into the receiving machine.

	  https://github.com/magic-wormhole/magic-wormhole
```

## package/python-mako/Config.in
```kconfig
config BR2_PACKAGE_PYTHON_MAKO
	bool "python-mako"
	select BR2_PACKAGE_PYTHON_MARKUPSAFE # runtime
	help
	  Mako is a template library written in Python. It provides a
	  familiar, non-XML syntax which compiles into Python modules
	  for maximum performance.

	  https://pypi.python.org/pypi/Mako

if BR2_PACKAGE_PYTHON_MAKO

config BR2_PACKAGE_PYTHON_MAKO_EXT_PYGMENTPLUGIN
	bool "mako extension pygmentplugin"
	select BR2_PACKAGE_PYTHON_PYGMENTS # runtime
	help
	  Provide python-pygments support for
	  mako.ext.pygmentplugin

config BR2_PACKAGE_PYTHON_MAKO_EXT_BABELPLUGIN
	bool "mako extension babelplugin"
	select BR2_PACKAGE_PYTHON_BABEL # runtime
	help
	  Provide python-babel support for
	  mako.ext.babelplugin

endif
```

## package/python-markdown-it-py/Config.in
```kconfig
config BR2_PACKAGE_PYTHON_MARKDOWN_IT_PY
	bool "python-markdown-it-py"
	select BR2_PACKAGE_PYTHON_MDURL # runtime
	help
	  Python port of markdown-it. Markdown parsing, done right!

	  https://github.com/executablebooks/markdown-it-py
```
