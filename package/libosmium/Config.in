## package/libosmium/Config.in
```kconfig
config BR2_PACKAGE_LIBOSMIUM
	bool "libosmium"
	depends on BR2_INSTALL_LIBSTDCPP
	depends on BR2_TOOLCHAIN_GCC_AT_LEAST_5 # C++14
	depends on BR2_TOOLCHAIN_HAS_THREADS # boost
	depends on BR2_USE_WCHAR # boost
	select BR2_PACKAGE_BOOST
	select BR2_PACKAGE_PROTOZERO
	select BR2_PACKAGE_LZ4
	help
	  A fast and flexible C++ library for working with OpenStreetMap
	  data. Libosmium works on Linux, macOS and Windows.

	  https://osmcode.org/libosmium/

comment "libosmium needs a toolchain w/ C++, wchar, threads, gcc >= 5"
	depends on !BR2_INSTALL_LIBSTDCPP || !BR2_USE_WCHAR || \
		!BR2_TOOLCHAIN_GCC_AT_LEAST_5 || !BR2_TOOLCHAIN_HAS_THREADS
```

## package/libostree/Config.in
```kconfig
config BR2_PACKAGE_LIBOSTREE
	bool "libostree"
	depends on BR2_PACKAGE_LIBGPG_ERROR_ARCH_SUPPORTS # libgpgme, libgpg-error
	depends on BR2_TOOLCHAIN_HAS_THREADS # libglib2
	depends on BR2_USE_WCHAR # libglib2
	depends on BR2_USE_MMU # e2fsprogs, libglib2, libgpgme
	# doesn't build with musl due to lack of TEMP_FAILURE_RETRY()
	depends on !BR2_TOOLCHAIN_USES_MUSL
	depends on BR2_TOOLCHAIN_HEADERS_AT_LEAST_5_8 # loop_config
	select BR2_PACKAGE_E2FSPROGS
	select BR2_PACKAGE_LIBARCHIVE if BR2_s390x
	select BR2_PACKAGE_LIBGLIB2
	select BR2_PACKAGE_LIBGPG_ERROR
	select BR2_PACKAGE_LIBGPGME
	select BR2_PACKAGE_XZ
	help
	  OSTree is an upgrade system for Linux-based operating
	  systems.

	  https://ostree.readthedocs.io/en/latest/

comment "libostree needs a uClibc or glibc toolchain w/ threads, dynamic library, wchar, headers >= 5.8"
	depends on !BR2_TOOLCHAIN_HAS_THREADS || BR2_STATIC_LIBS \
		|| !BR2_USE_WCHAR || BR2_TOOLCHAIN_USES_MUSL || \
		!BR2_TOOLCHAIN_HEADERS_AT_LEAST_5_8
	depends on BR2_PACKAGE_LIBGPG_ERROR_ARCH_SUPPORTS
	depends on BR2_USE_MMU
```

## package/libp11/Config.in
```kconfig
config BR2_PACKAGE_LIBP11
	bool "libp11"
	depends on !BR2_STATIC_LIBS # dlopen
	depends on BR2_TOOLCHAIN_HAS_THREADS
	select BR2_PACKAGE_OPENSSL
	select BR2_PACKAGE_OPENSSL_FORCE_LIBOPENSSL
	help
	  OpenSSL engine for PKCS#11 modules. Part of the OpenSC
	  project.

	  https://github.com/OpenSC/OpenSC/wiki

comment "libp11 needs a toolchain w/ dynamic library, threads"
	depends on BR2_STATIC_LIBS || !BR2_TOOLCHAIN_HAS_THREADS
```

## package/libpam-pkcs11/Config.in
```kconfig
config BR2_PACKAGE_LIBPAM_PKCS11
	bool "libpam-pkcs11"
	depends on BR2_TOOLCHAIN_HAS_THREADS
	depends on BR2_USE_MMU # pcsc-lite -> fork()
	depends on !BR2_STATIC_LIBS
	depends on BR2_TOOLCHAIN_GCC_AT_LEAST_4_9 # pcsc-lite -> _Atomic keyword
	select BR2_PACKAGE_OPENSSL
	select BR2_PACKAGE_OPENSSL_FORCE_LIBOPENSSL
	select BR2_PACKAGE_PCSC_LITE
	help
	  The Linux-PAM login module for X.509 certificate
	  based user login.

	  https://github.com/OpenSC/pam_pkcs11

comment "libpam-pkcs11 needs a toolchain w/ threads, dynamic library, gcc >= 4.9"
	depends on BR2_USE_MMU
	depends on !BR2_TOOLCHAIN_HAS_THREADS || BR2_STATIC_LIBS || \
		!BR2_TOOLCHAIN_GCC_AT_LEAST_4_9
```

## package/libparodus/Config.in
```kconfig
config BR2_PACKAGE_LIBPARODUS
    bool "libparodus"
    default n
    select BR2_PACKAGE_NOPOLL
    select BR2_PACKAGE_NANOMSG
    select BR2_PACKAGE_MSGPACK_C
    select BR2_PACKAGE_UCRESOLV
    select BR2_PACKAGE_TROWER_BASE64
    select BR2_PACKAGE_CIMPLOG
    select BR2_PACKAGE_WRP_C
    select BR2_PACKAGE_WDMP_C
    help
       C implementation of the WebPA client coordinator
```

## package/libpeas/Config.in
```kconfig
config BR2_PACKAGE_LIBPEAS
	bool "libpeas"
	depends on BR2_USE_MMU # gobject-introspection
	depends on BR2_PACKAGE_GOBJECT_INTROSPECTION_ARCH_SUPPORTS
	depends on BR2_TOOLCHAIN_GCC_AT_LEAST_4_9 # gobject-introspection
	depends on BR2_HOST_GCC_AT_LEAST_8 # gobject-introspection -> host-qemu
	depends on BR2_TOOLCHAIN_USES_GLIBC # gobject-introspection
	depends on BR2_PACKAGE_PYTHON3 # gobject-introspection
	select BR2_PACKAGE_GOBJECT_INTROSPECTION
	select BR2_PACKAGE_LIBGLIB2
	help
	  libpeas is a gobject-based plugins engine, and is targeted at
	  giving every application the chance to assume its own
	  extensibility. It also has a set of features including, but
	  not limited to:
	    - multiple extension points
	    - On demand (lazy) programming language support for C,
	      Python and Lua
	    - Simplicity of the API

	  https://wiki.gnome.org/Projects/Libpeas

if BR2_PACKAGE_LIBPEAS

config BR2_PACKAGE_LIBPEAS_WIDGETS
	bool "widgets"
	depends on BR2_PACKAGE_LIBGTK3
	help
	  Build GTK+ widgetry

comment "widget support needs libgtk3"
	depends on !BR2_PACKAGE_LIBGTK3

endif

comment "libpeas needs python3"
	depends on BR2_PACKAGE_GOBJECT_INTROSPECTION_ARCH_SUPPORTS
	depends on BR2_USE_MMU
	depends on !BR2_PACKAGE_PYTHON3

comment "libpeas needs a glibc toolchain, gcc >= 4.9, host gcc >= 8"
	depends on BR2_PACKAGE_GOBJECT_INTROSPECTION_ARCH_SUPPORTS
	depends on BR2_USE_MMU
	depends on !BR2_TOOLCHAIN_USES_GLIBC || \
		!BR2_TOOLCHAIN_GCC_AT_LEAST_4_9 || !BR2_HOST_GCC_AT_LEAST_8
```

## package/libplacebo/Config.in
```kconfig
config BR2_PACKAGE_LIBPLACEBO
	bool "libplacebo"
	depends on BR2_TOOLCHAIN_HAS_THREADS_NPTL
	depends on BR2_INSTALL_LIBSTDCPP
	depends on BR2_TOOLCHAIN_GCC_AT_LEAST_10 # C++20
	depends on BR2_TOOLCHAIN_HAS_ATOMIC
	depends on !BR2_STATIC_LIBS # needs <dlfcn.h>
	help
	  libplacebo is, in a nutshell, the core rendering algorithms
	  and ideas of mpv rewritten as an independent library. As of
	  today, libplacebo contains a large assortment of video
	  processing shaders, focusing on both quality and
	  performance.

	  https://libplacebo.org

comment "libplacebo needs a toolchain w/ C++, dynamic library, NPTL threads, gcc >= 10"
	depends on BR2_USE_MMU
	depends on BR2_TOOLCHAIN_HAS_ATOMIC
	depends on !BR2_INSTALL_LIBSTDCPP || BR2_STATIC_LIBS || \
		!BR2_TOOLCHAIN_HAS_THREADS_NPTL || BR2_TOOLCHAIN_GCC_AT_LEAST_10
```

## package/libpqxx/Config.in
```kconfig
config BR2_PACKAGE_LIBPQXX
	bool "libpqxx"
	depends on BR2_PACKAGE_POSTGRESQL
	depends on BR2_TOOLCHAIN_HAS_THREADS
	depends on BR2_TOOLCHAIN_GCC_AT_LEAST_9 # C++17/charconv
	depends on BR2_INSTALL_LIBSTDCPP
	help
	  libpqxx is the official C++ client API for PostgreSQL, the
	  enterprise-strength open-source relational database.

	  http://pqxx.org/development/libpqxx/

comment "libpqxx needs toolchain w/ C++, gcc >= 9, threads"
	depends on BR2_PACKAGE_POSTGRESQL
	depends on !BR2_INSTALL_LIBSTDCPP || \
		!BR2_TOOLCHAIN_GCC_AT_LEAST_9 || \
		!BR2_TOOLCHAIN_HAS_THREADS
```

## package/libprovision/Config.in
```kconfig
config BR2_PACKAGE_LIBPROVISION
	bool "libprovision"
	select BR2_PACKAGE_LIBOPENSSL
 	depends on BR2_PACKAGE_CPPSDK_GENERICS || BR2_PACKAGE_WPEFRAMEWORK || BR2_PACKAGE_BRIDGE
	depends on BR2_arm || BR2_aarch64 || BR2_mipsel || BR2_i386
	depends on BR2_INSTALL_LIBSTDCPP
	depends on BR2_TOOLCHAIN_HAS_THREADS
	help
	  http://www.metrological.com
```

## package/libpsl/Config.in
```kconfig
config BR2_PACKAGE_LIBPSL
	bool "libpsl"
	depends on BR2_USE_WCHAR # libunistring, icu
	select BR2_PACKAGE_LIBICONV if !BR2_ENABLE_LOCALE
	select BR2_PACKAGE_LIBIDN2 if !BR2_PACKAGE_ICU && !BR2_PACKAGE_LIBIDN
	select BR2_PACKAGE_LIBUNISTRING if !BR2_PACKAGE_ICU
	help
	  C library to handle the Public Suffix List of TLDs.

	  https://github.com/rockdaboot/libpsl

comment "libpsl needs a toolchain w/ wchar"
	depends on !BR2_USE_WCHAR
```

## package/libpthsem/Config.in
```kconfig
config BR2_PACKAGE_LIBPTHSEM
	bool "libpthsem"
	depends on BR2_USE_MMU # fork()
	help
	  GNU pth is a user mode multi threading library. pthsem is an
	  extend version, with support for semaphores added.

	  https://github.com/linknx/pthsem

if BR2_PACKAGE_LIBPTHSEM

config BR2_PACKAGE_LIBPTHSEM_COMPAT
	bool "libpth compatibility"
	help
	  This option enables the compatibility with the original
	  libpth library.

endif
```

## package/libqb/Config.in
```kconfig
config BR2_PACKAGE_LIBQB
	bool "libqb"
	depends on BR2_TOOLCHAIN_HAS_THREADS
	depends on !BR2_STATIC_LIBS
	select BR2_PACKAGE_LIBXML2
	help
	  Library for client-server applications

	  https://github.com/ClusterLabs/libqb

comment "libqb needs a toolchain w/ threads, dynamic library"
	depends on !BR2_TOOLCHAIN_HAS_THREADS || BR2_STATIC_LIBS
```

## package/libqrtr-glib/Config.in
```kconfig
config BR2_PACKAGE_LIBQRTR_GLIB
	bool "libqrtr-glib"
	depends on BR2_USE_WCHAR # glib2
	depends on BR2_TOOLCHAIN_HAS_THREADS # glib2
	depends on BR2_USE_MMU # glib2
	depends on BR2_TOOLCHAIN_HEADERS_AT_LEAST_4_15 # da7653f0faab
	select BR2_PACKAGE_LIBGLIB2
	help
	  Qualcomm IPC Router protocol helper library.
	  Optional dependency for libqmi >= 1.28.0.

	  https://www.freedesktop.org/software/libqmi/libqrtr-glib/latest/

comment "libqrtr-glib needs a toolchain w/ wchar, threads, headers >= 4.15"
	depends on BR2_USE_MMU
	depends on !BR2_USE_WCHAR || !BR2_TOOLCHAIN_HAS_THREADS || \
		!BR2_TOOLCHAIN_HEADERS_AT_LEAST_4_15
```

## package/librelp/Config.in
```kconfig
config BR2_PACKAGE_LIBRELP
	bool "librelp"
	depends on BR2_TOOLCHAIN_HAS_THREADS
	select BR2_PACKAGE_LIBOPENSSL_ENGINES if BR2_PACKAGE_LIBOPENSSL
	help
	  Reliable Event Logging Protocol library

	  https://www.rsyslog.com/librelp/

comment "librelp needs a toolchain w/ threads"
	depends on !BR2_TOOLCHAIN_HAS_THREADS
```

## package/librespot/Config.in
```kconfig
config BR2_PACKAGE_LIBRESPOT
       bool "librespot"
       depends on BR2_PACKAGE_HOST_CARGO
       help
         librespot is an open source client library for Spotify. 
         
         It enables applications to use Spotify's service, without 
         using the official but closed-source libspotify. Additionally, 
         it will provide extra features which are not available 
         in the official library.
         
         https://github.com/plietar/librespot
```

## package/librtas/Config.in
```kconfig
config BR2_PACKAGE_LIBRTAS
	bool "librtas"
	depends on BR2_powerpc || BR2_powerpc64 || BR2_powerpc64le
	help
	  The librtas package provides an interface for Run-Time
	  Abstraction Services (RTAS) calls on PAPR platforms.
	  The libraries allow users to examine and manipulate hardware,
	  and parse RTAS events.

	  http://librtas.sourceforge.net/
```

## package/libsepol/Config.in
```kconfig
config BR2_PACKAGE_LIBSEPOL
	bool "libsepol"
	depends on BR2_TOOLCHAIN_HAS_THREADS # pthread
	depends on BR2_TOOLCHAIN_GCC_AT_LEAST_5
	help
	  Libsepol is the binary policy manipulation library. It doesn't
	  depend upon or use any of the other SELinux components.

	  http://selinuxproject.org/page/Main_Page

if BR2_PACKAGE_LIBSEPOL

config BR2_PACKAGE_LIBSEPOL_POLICY_VERSION
	int "Policy version"
	default 33 if BR2_TOOLCHAIN_HEADERS_AT_LEAST_5_8
	default 32 if BR2_TOOLCHAIN_HEADERS_AT_LEAST_5_5
	default 31 if BR2_TOOLCHAIN_HEADERS_AT_LEAST_4_13
	default 30 if BR2_TOOLCHAIN_HEADERS_AT_LEAST_4_3
	default 29 if BR2_TOOLCHAIN_HEADERS_AT_LEAST_3_14
	default 28 if BR2_TOOLCHAIN_HEADERS_AT_LEAST_3_5
	default 25
	help
	  The maximum SELinux policy version your kernel supports.

	  Here's a handy table to help you choose:
	  kernel version   SElinux policy max version
	  < 2.6.x          25
	  >= 2.6 < 3.5     26
	  >= 3.5 < 3.14    28 (27 and 28 were added at the same time)
	  >= 3.14 < 4.3    29
	  >= 4.3 < 4.13    30
	  >= 4.13 < 5.5    31
	  >= 5.5 < 5.8     32
	  >= 5.8           33

endif

comment "libsepol needs a toolchain w/ threads, gcc >= 5"
	depends on !BR2_TOOLCHAIN_HAS_THREADS || \
		!BR2_TOOLCHAIN_GCC_AT_LEAST_5
```

## package/libshdata/Config.in
```kconfig
config BR2_PACKAGE_LIBSHDATA
	bool "libshdata"
	depends on BR2_TOOLCHAIN_HAS_SYNC_4
	depends on BR2_TOOLCHAIN_HAS_ATOMIC # libfutils
	depends on BR2_INSTALL_LIBSTDCPP # libfutils
	depends on BR2_TOOLCHAIN_HAS_THREADS # libfutils
	select BR2_PACKAGE_LIBFUTILS
	select BR2_PACKAGE_ULOG
	help
	  This library provides lock free shared-memory tools

	  https://github.com/Parrot-Developers/libshdata

if BR2_PACKAGE_LIBSHDATA

config BR2_PACKAGE_LIBSHDATA_STRESS
	bool "libshdata-stress binary"
	depends on !BR2_STATIC_LIBS
	help
	  Install libshdata-stress binary as well

comment "libshdata-stress needs a toolchain w/ dynamic library"
	depends on BR2_STATIC_LIBS

endif

comment "libshdata needs a toolchain w/ C++, threads"
	depends on BR2_TOOLCHAIN_HAS_SYNC_4
	depends on BR2_TOOLCHAIN_HAS_ATOMIC
	depends on !BR2_INSTALL_LIBSTDCPP || !BR2_TOOLCHAIN_HAS_THREADS
```

## package/libsigc/Config.in
```kconfig
config BR2_PACKAGE_LIBSIGC
	bool "libsigc++ (latest)"
	depends on BR2_TOOLCHAIN_GCC_AT_LEAST_7 # C++17
	depends on BR2_INSTALL_LIBSTDCPP
	help
	  libsigc++ implements a typesafe callback system for standard
	  C++. It allows you to define signals and to connect those
	  signals to any callback function, either global or a member
	  function, regardless of whether it is static or virtual.

	  https://libsigcplusplus.github.io/libsigcplusplus/

comment "libsigc++ needs a toolchain w/ C++, gcc >= 7"
	depends on !BR2_INSTALL_LIBSTDCPP || !BR2_TOOLCHAIN_GCC_AT_LEAST_7
```

## package/libsigc2/Config.in
```kconfig
config BR2_PACKAGE_LIBSIGC2
	bool "libsigc++ (2.x.x)"
	depends on BR2_TOOLCHAIN_GCC_AT_LEAST_4_9 # C++11
	depends on BR2_INSTALL_LIBSTDCPP
	help
	  libsigc++ implements a typesafe callback system for standard
	  C++. It allows you to define signals and to connect those
	  signals to any callback function, either global or a member
	  function, regardless of whether it is static or virtual.

	  This is the last version before the API and ABI change
	  introduced in 3.0.0 which requires C++17.

	  https://libsigcplusplus.github.io/libsigcplusplus/

comment "libsigc++ (2.x.x) needs a toolchain w/ C++, gcc >= 4.9"
	depends on !BR2_INSTALL_LIBSTDCPP || !BR2_TOOLCHAIN_GCC_AT_LEAST_4_9
```

## package/libsolv/Config.in
```kconfig
config BR2_PACKAGE_LIBSOLV
	bool "libsolv"
	depends on BR2_USE_MMU # fork()
	select BR2_PACKAGE_ZLIB
	help
	  A free package dependency solver using a satisfiability
	  algorithm.

	  https://github.com/openSUSE/libsolv
```

## package/libsoup3/Config.in
```kconfig
config BR2_PACKAGE_LIBSOUP3
	bool "libsoup3"
	depends on BR2_USE_WCHAR # glib2, libpsl
	depends on BR2_TOOLCHAIN_HAS_THREADS # glib2
	depends on BR2_USE_MMU # glib2
	select BR2_PACKAGE_LIBGLIB2
	select BR2_PACKAGE_LIBPSL
	select BR2_PACKAGE_NGHTTP2
	select BR2_PACKAGE_SQLITE
	help
	  libsoup3 is an HTTP client/server library. It uses GObject
	  and the GLib main loop, to integrate well with GNOME
	  applications.

	  https://wiki.gnome.org/Projects/libsoup

if BR2_PACKAGE_LIBSOUP3

config BR2_PACKAGE_LIBSOUP3_SSL
	bool "https support"
	depends on !BR2_STATIC_LIBS # glib-networking, gnutls
	select BR2_PACKAGE_GLIB_NETWORKING # runtime
	select BR2_PACKAGE_GNUTLS # runtime
	help
	  Enable HTTPS (SSL) support.

comment "libsoup3 https support needs a toolchain w/ dynamic library"
	depends on BR2_STATIC_LIBS

endif

comment "libsoup3 needs a toolchain w/ wchar, threads"
	depends on BR2_USE_MMU
	depends on !BR2_USE_WCHAR || !BR2_TOOLCHAIN_HAS_THREADS
```

## package/libspdm/Config.in
```kconfig
config BR2_PACKAGE_LIBSPDM_CPU_FAMILY
	string
	# OpenSSL doesn't support "arc" (BR2_arcle || BR2_arceb), "arm"
	# (if BR2_arm || BR2_armeb) or "riscv32"/"riscv6"
	# (BR2_riscv && BR2_RISCV_32/BR2_RISCV_64). So we don't
	# support those here
	default "aarch64"	if BR2_aarch64 || BR2_aarch64_be
	default "ia32"		if BR2_i386
	default "x64"		if BR2_x86_64

config BR2_PACKAGE_LIBSPDM_ARCH_SUPPORTS
	bool
	default y if BR2_PACKAGE_LIBSPDM_CPU_FAMILY != ""

config BR2_PACKAGE_LIBSPDM
	bool "libspdm"
	depends on BR2_PACKAGE_LIBSPDM_ARCH_SUPPORTS
	select BR2_PACKAGE_OPENSSL
	select BR2_PACKAGE_OPENSSL_FORCE_LIBOPENSSL
	help
	  libspdm is a sample implementation that follows
	  the DMTF SPDM specifications

	  https://github.com/DMTF/libspdm
```
