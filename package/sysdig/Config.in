## package/sysdig/Config.in
```kconfig
config BR2_PACKAGE_SYSDIG
	bool "sysdig"
	depends on BR2_PACKAGE_LIBABSEIL_CPP_ARCH_SUPPORTS # falcosecurity-libs
	depends on BR2_PACKAGE_PROTOBUF_ARCH_SUPPORTS # falcosecurity-libs
	depends on BR2_LINUX_KERNEL # falcosecurity-libs
	depends on BR2_INSTALL_LIBSTDCPP
	depends on BR2_TOOLCHAIN_GCC_AT_LEAST_5 # falcosecurity-libs
	depends on BR2_TOOLCHAIN_HAS_THREADS # falcosecurity-libs
	depends on !BR2_STATIC_LIBS # falcosecurity-libs
	depends on BR2_TOOLCHAIN_USES_GLIBC # falcosecurity-libs
	depends on BR2_PACKAGE_LUAINTERPRETER_ABI_VERSION_5_1 # falcosecurity-libs
	depends on BR2_TOOLCHAIN_HAS_SYNC_4 || BR2_TOOLCHAIN_HAS_ATOMIC # falcosecurity-libs
	select BR2_PACKAGE_FALCOSECURITY_LIBS
	select BR2_PACKAGE_NCURSES
	select BR2_PACKAGE_JSON_FOR_MODERN_CPP
	select BR2_PACKAGE_YAML_CPP
	help
	  Sysdig is open source, system-level exploration:
	  capture system state and activity from a running Linux
	  instance, then save, filter and analyze.
	  Think of it as strace + tcpdump + lsof + awesome sauce.
	  With a little Lua cherry on top.

	  https://github.com/draios/sysdig/wiki

comment "sysdig needs a glibc toolchain w/ C++, threads, gcc >= 5, dynamic library, a Linux kernel, and luajit or lua 5.1 to be built"
	depends on BR2_PACKAGE_LIBABSEIL_CPP_ARCH_SUPPORTS
	depends on BR2_PACKAGE_PROTOBUF_ARCH_SUPPORTS
	depends on BR2_TOOLCHAIN_HAS_SYNC_4 || BR2_TOOLCHAIN_HAS_ATOMIC
	depends on !BR2_LINUX_KERNEL || !BR2_INSTALL_LIBSTDCPP \
		|| !BR2_TOOLCHAIN_HAS_THREADS \
		|| !BR2_TOOLCHAIN_GCC_AT_LEAST_5 || BR2_STATIC_LIBS \
		|| !BR2_TOOLCHAIN_USES_GLIBC \
		|| !BR2_PACKAGE_LUAINTERPRETER_ABI_VERSION_5_1
```

## package/sysklogd/Config.in
```kconfig
config BR2_PACKAGE_SYSKLOGD
	bool "sysklogd"
	depends on BR2_USE_MMU # fork()
	depends on BR2_PACKAGE_BUSYBOX_SHOW_OTHERS
	help
	  The continuation of the original sysklogd package, based on
	  the original Berkeley syslog daemon. Now with kernel
	  logging, and log rotation built-in. It can both receive from
	  and send to remote syslog servers. The v2.x series include
	  extended support for RFC5424 with an alt. syslogp() API for
	  clients.

	  https://github.com/troglobit/sysklogd/
```

## package/sysprof/Config.in
```kconfig
config BR2_PACKAGE_SYSPROF
	bool "sysprof"
	depends on BR2_USE_WCHAR # glib2, libdex, json-glib, elfutils
	depends on BR2_TOOLCHAIN_HAS_THREADS # glib2, libdex, json-glib, polkit, elfutils
	depends on BR2_USE_MMU # glib2, libdex, json-glib
	depends on BR2_TOOLCHAIN_GCC_AT_LEAST_7 # libunwind, polkit
	depends on BR2_PACKAGE_LIBUNWIND_ARCH_SUPPORTS
	depends on !BR2_STATIC_LIBS # libdex, libunwind, polkit, elfutils
	depends on !BR2_OPTIMIZE_FAST # polkit
	depends on BR2_INSTALL_LIBSTDCPP
	depends on BR2_TOOLCHAIN_HEADERS_AT_LEAST_5_12
	select BR2_PACKAGE_ELFUTILS
	select BR2_PACKAGE_JSON_GLIB
	select BR2_PACKAGE_LIBDEX
	select BR2_PACKAGE_LIBGLIB2
	select BR2_PACKAGE_LIBUNWIND
	select BR2_PACKAGE_POLKIT
	help
	  Sysprof is a statistical, system-wide profiler that can
	  profile user and kernel code using the perf API.

	  http://sysprof.com

comment "sysprof needs a toolchain w/ dynamic library, wchar, threads, C++, gcc >= 7, headers >= 5.12"
	depends on BR2_USE_MMU
	depends on BR2_PACKAGE_LIBUNWIND_ARCH_SUPPORTS
	depends on !BR2_USE_WCHAR || !BR2_TOOLCHAIN_HAS_THREADS || \
		!BR2_TOOLCHAIN_GCC_AT_LEAST_7 || \
		BR2_STATIC_LIBS || !BR2_INSTALL_LIBSTDCPP || \
		!BR2_TOOLCHAIN_HEADERS_AT_LEAST_5_12

comment "sysprof can't be built with Optimize for fast"
	depends on BR2_OPTIMIZE_FAST
```

## package/sysrepo-cpp/Config.in
```kconfig
config BR2_PACKAGE_SYSREPO_CPP
	bool "sysrepo-cpp"
	depends on BR2_USE_MMU # sysrepo
	depends on BR2_TOOLCHAIN_HAS_THREADS_NPTL # sysrepo
	depends on !BR2_STATIC_LIBS # sysrepo, libyang-cpp
	depends on BR2_INSTALL_LIBSTDCPP # sysrepo, libyang-cpp
	depends on BR2_TOOLCHAIN_GCC_AT_LEAST_10 # libyang-cpp
	depends on BR2_TOOLCHAIN_HAS_SYNC_4 # libyang-cpp
	# std::timespec build issue
	depends on !BR2_TOOLCHAIN_USES_UCLIBC
	select BR2_PACKAGE_SYSREPO
	select BR2_PACKAGE_LIBYANG_CPP
	help
	  C++20 RAII bindings for the sysrepo YANG datastore library.

	  This library provides modern C++ object-oriented bindings on
	  top of sysrepo, using RAII for automatic lifetime
	  management.

	  https://github.com/sysrepo/sysrepo-cpp

comment "sysrepo-cpp needs a glibc or musl toolchain w/ NPTL threads, dynamic libs, C++, gcc >= 10"
	depends on BR2_USE_MMU
	depends on BR2_TOOLCHAIN_HAS_SYNC_4
	depends on !BR2_TOOLCHAIN_HAS_THREADS_NPTL || \
		   BR2_STATIC_LIBS || \
		   !BR2_INSTALL_LIBSTDCPP || \
		   !BR2_TOOLCHAIN_GCC_AT_LEAST_10 || \
		   BR2_TOOLCHAIN_USES_UCLIBC
```

## package/system-config-printer/Config.in
```kconfig
config BR2_PACKAGE_SYSTEM_CONFIG_PRINTER
	bool "system-config-printer"
	depends on BR2_PACKAGE_CUPS
	help
	  Graphical user interface for CUPS administration

	  https://github.com/OpenPrinting/system-config-printer
```

## package/sysvinit/Config.in
```kconfig
config BR2_PACKAGE_SYSVINIT
	bool "sysvinit"
	depends on BR2_USE_MMU # fork()
	depends on BR2_INIT_SYSV
	depends on BR2_PACKAGE_BUSYBOX_SHOW_OTHERS
	select BR2_PACKAGE_LIBXCRYPT if BR2_TOOLCHAIN_USES_GLIBC
	help
	  System V style implementation of /sbin/init, parent of all
	  processes

	  http://savannah.nongnu.org/projects/sysvinit
```

## package/tailscale/Config.in
```kconfig
config BR2_PACKAGE_TAILSCALE
	bool "tailscale"
	depends on BR2_PACKAGE_HOST_GO_TARGET_ARCH_SUPPORTS
	select BR2_PACKAGE_HOST_GO
	help
	  The easiest, most secure way to use WireGuard and 2FA.

	  https://github.com/tailscale/tailscale
```

## package/targetcli-fb/Config.in
```kconfig
comment "targetcli-fb needs Python, a glibc toolchain, gcc >= 4.9, host gcc >= 8"
	depends on !BR2_PACKAGE_PYTHON3
	depends on BR2_USE_MMU
	depends on BR2_PACKAGE_GOBJECT_INTROSPECTION_ARCH_SUPPORTS
	depends on !BR2_HOST_GCC_AT_LEAST_8 || \
		!BR2_TOOLCHAIN_GCC_AT_LEAST_4_9 || \
		!BR2_TOOLCHAIN_USES_GLIBC

config BR2_PACKAGE_TARGETCLI_FB
	bool "targetcli-fb"
	depends on BR2_PACKAGE_PYTHON3 # python-configshell-fb
	depends on BR2_USE_MMU # python-gobject -> gobject-introspection
	depends on BR2_PACKAGE_GOBJECT_INTROSPECTION_ARCH_SUPPORTS # python-gobject -> gobject-introspection
	depends on BR2_HOST_GCC_AT_LEAST_8 # python-gobject -> gobject-introspection
	depends on BR2_TOOLCHAIN_GCC_AT_LEAST_4_9 # python-gobject -> gobject-introspection
	depends on BR2_TOOLCHAIN_USES_GLIBC # python-gobject -> gobject-introspection
	select BR2_PACKAGE_PYTHON_CONFIGSHELL_FB
	select BR2_PACKAGE_PYTHON_RTSLIB_FB
	select BR2_PACKAGE_PYTHON_SIX
	select BR2_PACKAGE_PYTHON_GOBJECT
	help
	  targetcli-fb is a command-line interface for configuring the
	  LIO generic SCSI target, present in 3.x Linux kernel
	  versions.

	  https://github.com/open-iscsi/targetcli-fb
```

## package/tbb/Config.in
```kconfig
config BR2_PACKAGE_TBB
	bool "tbb"
	# tbb needs fenv.h which is not provided by uclibc
	depends on !BR2_TOOLCHAIN_USES_UCLIBC
	depends on !BR2_STATIC_LIBS
	depends on BR2_TOOLCHAIN_HAS_THREADS
	depends on BR2_INSTALL_LIBSTDCPP
	depends on !BR2_TOOLCHAIN_HAS_GCC_BUG_64735 # exception_ptr
	help
	  Intel(R) Threading Building Blocks (Intel(R) TBB) lets you
	  easily write parallel C++ programs that take full advantage
	  of multicore performance, that are portable, composable and
	  have future-proof scalability.

	  https://www.threadingbuildingblocks.org/

comment "tbb needs a glibc or musl toolchain w/ dynamic library, threads, C++"
	depends on BR2_TOOLCHAIN_USES_UCLIBC || BR2_STATIC_LIBS || \
		!BR2_TOOLCHAIN_HAS_THREADS || !BR2_INSTALL_LIBSTDCPP

comment "tbb needs exception_ptr"
	depends on BR2_TOOLCHAIN_HAS_GCC_BUG_64735
```

## package/tbtools/Config.in
```kconfig
config BR2_PACKAGE_TBTOOLS
	bool "tbtools"
	depends on BR2_PACKAGE_HOST_RUSTC_TARGET_ARCH_SUPPORTS
	depends on BR2_TOOLCHAIN_USES_GLIBC
	depends on BR2_PACKAGE_HAS_UDEV
	select BR2_PACKAGE_HOST_RUSTC
	help
	  tbtools is a collection of tools for Linux Thunderbolt/USB4
	  development, debugging and validation.

	  https://github.com/intel/tbtools

comment "tbtools needs udev /dev management w/ glibc toolchain"
	depends on BR2_PACKAGE_HOST_RUSTC_TARGET_ARCH_SUPPORTS
	depends on !BR2_PACKAGE_HAS_UDEV || !BR2_TOOLCHAIN_USES_GLIBC
```

## package/tclbonjour/Config.in
```kconfig
config BR2_PACKAGE_TCLBONJOUR
	bool "tclbonjour"
	select BR2_PACKAGE_AVAHI
	select BR2_PACKAGE_AVAHI_LIBDNS_COMPAT
	help
	  A Tcl package for publishing and subscribing to network services via Multicast 
	  DNS/DNS-SD (also known as Bonjour on OS X).
	  
	  https://github.com/eviltwinskippy/tcl_bonjour
```

## package/tcludp/Config.in
```kconfig
config BR2_PACKAGE_TCLUDP
	bool "tcludp"
	help
	  The TclUpd project aims to provide an extension to the Tcl language 
	  which adds handing for UDP sockets

	  http://sourceforge.net/projects/tcludp/
```

## package/tditracer/Config.in
```kconfig
config BR2_PACKAGE_TDITRACER
	bool "tditracer"
	help
	  Tditracer contains tools to generate tdi traces
```

## package/tealdeer/Config.in
```kconfig
config BR2_PACKAGE_TEALDEER
	bool "tealdeer"
	depends on BR2_PACKAGE_HOST_RUSTC_TARGET_ARCH_SUPPORTS
	# Crypto dependency (ring) not available for mips, PowerPC, Sparc, s390x
	depends on !(BR2_mips || BR2_mipsel || BR2_mips64 || BR2_mips64el)
	depends on !(BR2_powerpc || BR2_powerpc64 || BR2_powerpc64le)
	depends on !(BR2_sparc || BR2_sparc64)
	depends on !BR2_s390x
	select BR2_PACKAGE_HOST_RUSTC
	help
	  A fast and full-featured tldr client. tldr pages are
	  simplified and community-driven man pages, see
	  https://tldr.sh/ for more information.

	  https://github.com/dbrgn/tealdeer/
```

## package/telemetry/Config.in
```kconfig
config BR2_PACKAGE_TELEMETRY
    bool "TELEMETRY"
    default n
    help
       TELEMETRY library component
```

## package/tensorflow-lite/Config.in
```kconfig
config BR2_PACKAGE_TENSORFLOW_LITE_ARCH_SUPPORTS
	bool
	default y if BR2_aarch64
	default y if BR2_arm
	default y if BR2_i386
	default y if BR2_x86_64
	depends on BR2_PACKAGE_CPUINFO_ARCH_SUPPORTS

config BR2_PACKAGE_TENSORFLOW_LITE
	bool "tensorflow-lite"
	depends on BR2_PACKAGE_TENSORFLOW_LITE_ARCH_SUPPORTS
	depends on BR2_INSTALL_LIBSTDCPP
	depends on BR2_TOOLCHAIN_GCC_AT_LEAST_8 # libabseil-cpp
	depends on BR2_TOOLCHAIN_HAS_THREADS # cpuinfo
	depends on BR2_TOOLCHAIN_USES_GLIBC
	depends on BR2_SHARED_LIBS
	select BR2_PACKAGE_CPUINFO
	select BR2_PACKAGE_EIGEN
	select BR2_PACKAGE_FARMHASH
	select BR2_PACKAGE_FFT2D
	select BR2_PACKAGE_FLATBUFFERS
	select BR2_PACKAGE_GEMMLOWP
	select BR2_PACKAGE_LIBABSEIL_CPP
	select BR2_PACKAGE_NEON_2_SSE
	select BR2_PACKAGE_RUY if BR2_PACKAGE_RUY_ARCH_SUPPORTS
	select BR2_PACKAGE_XNNPACK if BR2_PACKAGE_XNNPACK_ARCH_SUPPORTS
	help
	  Tensorflow Lite dynamic library and headers: Inference engine
	  to run previously trained machine learning models.

	  https://www.tensorflow.org/

comment "tensorflow-lite needs a toolchain w/ gcc >= 8, C++, threads"
	depends on !BR2_TOOLCHAIN_USES_GLIBC || !BR2_INSTALL_LIBSTDCPP || \
			!BR2_TOOLCHAIN_GCC_AT_LEAST_8 || !BR2_TOOLCHAIN_HAS_THREADS

comment "tensorflow-lite needs a toolchain w/ shared libraries"
	depends on !BR2_SHARED_LIBS
```

## package/termcolor/Config.in
```kconfig
config BR2_PACKAGE_TERMCOLOR
	bool "termcolor"
	depends on BR2_INSTALL_LIBSTDCPP
	depends on BR2_TOOLCHAIN_GCC_AT_LEAST_4_8 # C++11
	help
	  Termcolor is a header-only C++ library for printing colored
	  messages to the terminal.

	  https://github.com/ikalnytskyi/termcolor

comment "termcolor needs a toolchain w/ C++, gcc >= 4.8"
	depends on !BR2_INSTALL_LIBSTDCPP || !BR2_TOOLCHAIN_GCC_AT_LEAST_4_8
```

## package/tftpd/Config.in
```kconfig
config BR2_PACKAGE_TFTPD
	bool "tftpd"
	depends on BR2_USE_MMU # fork()
	depends on BR2_PACKAGE_BUSYBOX_SHOW_OTHERS
	help
	  HPA's Trivial File Transfer Protocol (tftp) server.

	  https://git.kernel.org/pub/scm/network/tftp/tftp-hpa.git
```

## package/thermald/Config.in
```kconfig
config BR2_PACKAGE_THERMALD
	bool "thermald"
	depends on BR2_i386 || BR2_x86_64 # needs <cpuid.h>
	depends on BR2_USE_MMU # uses fork()
	depends on BR2_USE_WCHAR # upower -> libgudev
	depends on BR2_INSTALL_LIBSTDCPP
	depends on BR2_TOOLCHAIN_HAS_THREADS # dbus-glib -> glib2, dbus, upower
	depends on BR2_USE_WCHAR # dbus-glib -> glib2
	depends on BR2_PACKAGE_HAS_UDEV # upower
	select BR2_PACKAGE_DBUS
	select BR2_PACKAGE_DBUS_GLIB
	select BR2_PACKAGE_LIBEVDEV
	select BR2_PACKAGE_LIBXML2
	select BR2_PACKAGE_UPOWER
	select BR2_PACKAGE_XZ
	help
	  Thermal Daemon is a Linux daemon for monitoring and
	  controlling platform temperatures. Once the system temperature
	  reaches a certain threshold, the Linux daemon activates
	  various cooling methods to try to cool the system.

	  https://github.com/intel/thermal_daemon

comment "thermald needs a toolchain w/ C++, wchar, threads"
	depends on BR2_i386 || BR2_x86_64
	depends on BR2_USE_MMU
	depends on !BR2_USE_WCHAR || !BR2_TOOLCHAIN_HAS_THREADS || \
		!BR2_INSTALL_LIBSTDCPP

comment "thermald needs udev /dev management"
	depends on BR2_i386 || BR2_x86_64
	depends on BR2_USE_MMU
	depends on !BR2_PACKAGE_HAS_UDEV
```

## package/thttpd/Config.in
```kconfig
config BR2_PACKAGE_THTTPD
	bool "thttpd"
	depends on BR2_USE_MMU # fork()
	select BR2_PACKAGE_LIBXCRYPT if BR2_TOOLCHAIN_USES_GLIBC
	help
	  thttpd is a simple, small, portable, fast, and secure HTTP
	  server

	  http://www.acme.com/software/thttpd/
```

## package/ti-sgx-um/Config.in
```kconfig
comment "ti-sgx-um needs udev and a glibc toolchain w/ threads"
	depends on BR2_arm
	depends on !BR2_PACKAGE_HAS_UDEV || !BR2_TOOLCHAIN_USES_GLIBC \
		|| !BR2_TOOLCHAIN_HAS_THREADS

config BR2_PACKAGE_TI_SGX_UM
	bool "ti-sgx-um"
	depends on BR2_TOOLCHAIN_HAS_THREADS # libdrm
	depends on BR2_PACKAGE_HAS_UDEV
	# pre-built binaries
	depends on BR2_TOOLCHAIN_USES_GLIBC
	depends on BR2_arm
	select BR2_PACKAGE_LIBDRM
	select BR2_PACKAGE_LIBDRM_OMAP
	select BR2_PACKAGE_HAS_LIBEGL
	select BR2_PACKAGE_HAS_LIBGBM
	select BR2_PACKAGE_LIBGBM_HAS_FEATURE_DMA_BUF
	select BR2_PACKAGE_HAS_LIBGLES
	select BR2_PACKAGE_HAS_POWERVR
	select BR2_PACKAGE_LIBFFI
	select BR2_PACKAGE_WAYLAND
	select BR2_PACKAGE_TI_SGX_KM if BR2_LINUX_KERNEL
	help
	  Graphics libraries for TI CPUs with SGX5xx GPU.
	  This package supports AM335x, AM437x, AM4430 and AM5430.
	  For older CPUs or kernels use the ti-gfx package.

	  https://git.ti.com/cgit/graphics/omap5-sgx-ddk-um-linux

if BR2_PACKAGE_TI_SGX_UM

config BR2_PACKAGE_PROVIDES_LIBEGL
	default "ti-sgx-um"

config BR2_PACKAGE_PROVIDES_LIBGBM
	default "ti-sgx-um"

config BR2_PACKAGE_PROVIDES_LIBGLES
	default "ti-sgx-um"

config BR2_PACKAGE_PROVIDES_POWERVR
	default "ti-sgx-um"

endif
```

## package/tig/Config.in
```kconfig
config BR2_PACKAGE_TIG
	bool "tig"
	depends on BR2_USE_MMU # fork()
	select BR2_PACKAGE_GIT # runtime
	select BR2_PACKAGE_NCURSES
	help
	  Tig is an ncurses-based text-mode interface for git. It
	  functions mainly as a Git repository browser, but can also
	  assist in staging changes for commit at chunk level and act
	  as a pager for output from various Git commands.

	  https://jonas.github.io/tig/
```

## package/tinifier/Config.in
```kconfig
config BR2_PACKAGE_TINIFIER
	bool "tinifier"
	depends on BR2_PACKAGE_HOST_GO_TARGET_ARCH_SUPPORTS
	select BR2_PACKAGE_HOST_GO
	help
	  CLI tool for images compressing

	  This tool uses tinypng.com API endpoint for compressing your
	  local jpg/png images (it supports parallel jobs).

	  https://github.com/tarampampam/tinifier
```

## package/tinycompress/Config.in
```kconfig
config BR2_PACKAGE_TINYCOMPRESS
	bool "tinycompress"
	depends on !BR2_STATIC_LIBS # dlfcn.h
	help
	  tinycompress is a library for compress audio offload in alsa.

	  https://www.alsa-project.org/

comment "tinycompress needs a toolchain w/ dynamic library"
	depends on BR2_STATIC_LIBS
```
