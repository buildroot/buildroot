## package/edk2-platforms/Config.in
```kconfig
config BR2_PACKAGE_EDK2_PLATFORMS
	bool
	help
	  EDK2 description files for all supported platforms.
	  The main EDK2 bootloader package will depend on these
	  description files while building firmware for some platforms.

	  https://github.com/tianocore/edk2-platforms
```

## package/embiggen-disk/Config.in
```kconfig
config BR2_PACKAGE_EMBIGGEN_DISK
	bool "embiggen-disk"
	depends on BR2_PACKAGE_HOST_GO_TARGET_ARCH_SUPPORTS
	depends on BR2_PACKAGE_HOST_GO_TARGET_CGO_LINKING_SUPPORTS
	depends on BR2_TOOLCHAIN_HAS_THREADS
	depends on !BR2_TOOLCHAIN_USES_UCLIBC # no fexecve
	depends on BR2_USE_MMU # util-linux
	select BR2_PACKAGE_UTIL_LINUX # sfdisk
	select BR2_PACKAGE_UTIL_LINUX_BINARIES # sfdisk
	help
	  embiggen-disk is a tool to resize disk partitions at runtime.

	  https://github.com/bradfitz/embiggen-disk

comment "embiggen-disk needs a glibc or musl toolchain w/ threads"
	depends on BR2_USE_MMU
	depends on BR2_PACKAGE_HOST_GO_TARGET_ARCH_SUPPORTS && \
		BR2_PACKAGE_HOST_GO_TARGET_CGO_LINKING_SUPPORTS
	depends on !BR2_TOOLCHAIN_HAS_THREADS || BR2_TOOLCHAIN_USES_UCLIBC
```

## package/erlang-fast-xml/Config.in
```kconfig
config BR2_PACKAGE_ERLANG_FAST_XML
	bool "erlang-fast-xml"
	select BR2_PACKAGE_ERLANG_P1_UTILS
	select BR2_PACKAGE_EXPAT
	help
	  XML utilities for Erlang

	  https://github.com/processone/fast_xml
```

## package/erlang-fast-yaml/Config.in
```kconfig
config BR2_PACKAGE_ERLANG_FAST_YAML
	bool "erlang-fast-yaml"
	select BR2_PACKAGE_ERLANG_P1_UTILS
	select BR2_PACKAGE_LIBYAML
	help
	  Erlang wrapper for libyaml C library

	  https://github.com/processone/fast_yaml
```

## package/erlang-p1-yconf/Config.in
```kconfig
config BR2_PACKAGE_ERLANG_P1_YCONF
	bool "erlang-p1-yconf"
	select BR2_PACKAGE_ERLANG_FAST_YAML
	help
	  YAML configuration processor.
```

## package/erlang-stun/Config.in
```kconfig
config BR2_PACKAGE_ERLANG_STUN
	bool "erlang-stun"
	select BR2_PACKAGE_ERLANG_P1_TLS
	select BR2_PACKAGE_ERLANG_P1_UTILS
	help
	  STUN library for Erlang

	  https://github.com/processone/stun
```

## package/erlang-xmpp/Config.in
```kconfig
comment "erlang-xmpp needs a toolchain w/ C++"
	depends on !BR2_INSTALL_LIBSTDCPP

config BR2_PACKAGE_ERLANG_XMPP
	bool "erlang-xmpp"
	depends on BR2_INSTALL_LIBSTDCPP # erlang-p1-stringprep
	select BR2_PACKAGE_ERLANG_FAST_XML
	select BR2_PACKAGE_ERLANG_IDNA
	select BR2_PACKAGE_ERLANG_P1_STRINGPREP
	select BR2_PACKAGE_ERLANG_P1_TLS
	select BR2_PACKAGE_ERLANG_P1_UTILS
	select BR2_PACKAGE_ERLANG_P1_ZLIB
	help
	  XMPP library for Erlang.

	  https://github.com/processone/xmpp
```

## package/erlang/Config.in
```kconfig
config BR2_PACKAGE_HOST_ERLANG_ARCH_SUPPORTS
	bool
	default y if BR2_HOSTARCH = "aarch64"
	default y if BR2_HOSTARCH = "x86_64"
	default y if BR2_HOSTARCH = "x86"

config BR2_PACKAGE_ERLANG_ARCH_SUPPORTS
	bool
	# see HOWTO/INSTALL.md for Erlang's supported platforms
	# when using its native atomic ops implementation or gcc's
	# __atomic_* builtins
	default y if BR2_i386 || BR2_x86_64 || BR2_powerpc || \
		BR2_sparc_v9 || BR2_arm || BR2_aarch64 || BR2_mipsel || \
		BR2_RISCV_64
	# erlang needs host-erlang
	depends on BR2_PACKAGE_HOST_ERLANG_ARCH_SUPPORTS

comment "erlang needs a glibc or musl toolchain w/ dynamic library, threads, wchar"
	depends on BR2_USE_MMU # fork()
	depends on BR2_PACKAGE_ERLANG_ARCH_SUPPORTS
	depends on BR2_STATIC_LIBS || !BR2_TOOLCHAIN_HAS_THREADS \
		|| !BR2_USE_WCHAR || BR2_TOOLCHAIN_USES_UCLIBC

config BR2_PACKAGE_ERLANG
	bool "erlang"
	depends on BR2_USE_MMU # fork()
	depends on BR2_USE_WCHAR
	depends on !BR2_STATIC_LIBS
	depends on BR2_TOOLCHAIN_HAS_THREADS
	depends on !BR2_TOOLCHAIN_USES_UCLIBC
	depends on BR2_PACKAGE_ERLANG_ARCH_SUPPORTS
	select BR2_PACKAGE_ZLIB
	help
	  Erlang is a programming language used to build massively
	  scalable soft real-time systems with requirements on high
	  availability. Some of its uses are in telecoms, banking,
	  e-commerce, computer telephony and instant messaging.
	  Erlang's runtime system has built-in support for
	  concurrency, distribution and fault tolerance.

	  http://www.erlang.org

if BR2_PACKAGE_ERLANG

config BR2_PACKAGE_ERLANG_MEGACO
	bool "install megaco application"
	help
	  The Megaco application is a framework for building
	  applications on top of the Megaco/H.248 protocol. It is
	  approximately 14MB in size so if you do not need it then
	  it is recommended not to enable it.

endif # BR2_PACKAGE_ERLANG
```

## package/esp-hosted/Config.in
```kconfig
comment "esp-hosted needs a Linux kernel to be built"
	depends on !BR2_s390x
	depends on !BR2_LINUX_KERNEL

config BR2_PACKAGE_ESP_HOSTED
	bool "esp-hosted"
	depends on !BR2_s390x
	depends on BR2_LINUX_KERNEL
	help
	  This package builds and installs the Linux kernel driver for
	  the Esp32-* Linux Wi-Fi driver. It supports both SDIO and SPI
	  busses that is selectable. It is compatible with recent Linux
	  kernels (>= 5.4).

if BR2_PACKAGE_ESP_HOSTED

choice
	prompt "HW interface"
	default BR2_PACKAGE_ESP_HOSTED_SDIO
	help
	  Select which bus type esp is attached to

config BR2_PACKAGE_ESP_HOSTED_SDIO
	bool "SDIO"

config BR2_PACKAGE_ESP_HOSTED_SPI
	bool "SPI"

endchoice

choice
	prompt "Target"
	default BR2_PACKAGE_ESP_HOSTED_TARGET_ESP32
	help
	  Select which SoC Target driver is used for

config BR2_PACKAGE_ESP_HOSTED_TARGET_ESP32
	bool "ESP32"

config BR2_PACKAGE_ESP_HOSTED_TARGET_ESP32C6
	bool "ESP32C6"

endchoice

endif
```

## package/evasion-sdk/Config.in
```kconfig
config BR2_PACKAGE_EVASION_SDK
    bool "evasion-sdk"
    depends on BR2_mipsel
    select BR2_PACKAGE_HAS_NEXUS
    select BR2_PACKAGE_HAS_LIBEGL
    select BR2_PACKAGE_HAS_LIBGLES
    help
      Pre-compiled binaries for a platform

if BR2_PACKAGE_EVASION_SDK

config BR2_PACKAGE_PROVIDES_NEXUS
    default "evasion-sdk"

config BR2_PACKAGE_PROVIDES_LIBEGL
    default "evasion-sdk"

config BR2_PACKAGE_PROVIDES_LIBGLES
    default "evasion-sdk"

config BR2_PACKAGE_SDK_INSTALL
    string 
    default "evasion-sdk"

endif
```

## package/evilwm/Config.in
```kconfig
config BR2_PACKAGE_EVILWM
	bool "evilwm"
	depends on BR2_PACKAGE_XORG7
	depends on BR2_USE_MMU # fork()
	select BR2_PACKAGE_XLIB_LIBX11
	select BR2_PACKAGE_XLIB_LIBXRANDR
	help
	  A minimalist window manager for the X Window System

	  https://www.6809.org.uk/evilwm/
```

## package/expat/Config.in
```kconfig
config BR2_PACKAGE_EXPAT
	bool "expat"
	help
	  The Expat XML Parser.

	  https://libexpat.github.io/
```

## package/explora-sdk/Config.in
```kconfig
config BR2_PACKAGE_EXPLORA_SDK
	bool "explora-sdk"
	depends on BR2_arm
	select BR2_PACKAGE_HAS_NEXUS_SAGE
	select BR2_PACKAGE_HAS_NEXUS
	select BR2_PACKAGE_HAS_LIBEGL
	select BR2_PACKAGE_HAS_LIBGLES
	select BR2_PACKAGE_HAS_PLAYREADY
	select BR2_PACKAGE_HAS_WIDEVINE
	help
	  Pre-compiled binaries for a platform

if BR2_PACKAGE_EXPLORA_SDK

config BR2_PACKAGE_PROVIDES_NEXUS
	default "explora-sdk"

config BR2_PACKAGE_PROVIDES_LIBEGL
	default "explora-sdk"

config BR2_PACKAGE_PROVIDES_LIBGLES
	default "explora-sdk"

config BR2_PACKAGE_SDK_INSTALL
        string 
	default "explora-sdk"

endif
```

## package/eza/Config.in
```kconfig
config BR2_PACKAGE_EZA
	bool "eza"
	depends on BR2_PACKAGE_HOST_RUSTC_TARGET_ARCH_SUPPORTS
	select BR2_PACKAGE_HOST_RUSTC
	help
	  eza is a modern, maintained replacement for ls, built on exa.

	  https://github.com/eza-community/eza.git
```

## package/falcosecurity-libs/Config.in
```kconfig
config BR2_PACKAGE_FALCOSECURITY_LIBS
	bool
	depends on BR2_PACKAGE_LIBABSEIL_CPP_ARCH_SUPPORTS # grpc
	depends on BR2_PACKAGE_PROTOBUF_ARCH_SUPPORTS # protobuf
	depends on BR2_LINUX_KERNEL
	depends on BR2_INSTALL_LIBSTDCPP # jsoncpp, protobuf, tbb
	depends on BR2_TOOLCHAIN_GCC_AT_LEAST_8 # grpc -> libabseil-cpp
	depends on BR2_TOOLCHAIN_HAS_THREADS # jq, protobuf, tbb
	depends on !BR2_STATIC_LIBS # protobuf, tbb
	depends on BR2_TOOLCHAIN_HAS_SYNC_4 || BR2_TOOLCHAIN_HAS_ATOMIC # grpc
	depends on BR2_TOOLCHAIN_USES_GLIBC # tbb
	depends on BR2_PACKAGE_LUAINTERPRETER_ABI_VERSION_5_1
	select BR2_PACKAGE_C_ARES
	select BR2_PACKAGE_ELFUTILS
	select BR2_PACKAGE_GRPC
	select BR2_PACKAGE_GTEST
	select BR2_PACKAGE_HOST_GRPC
	select BR2_PACKAGE_HOST_PROTOBUF
	select BR2_PACKAGE_JQ
	select BR2_PACKAGE_JSONCPP
	select BR2_PACKAGE_LIBB64
	select BR2_PACKAGE_LIBCURL
	select BR2_PACKAGE_OPENSSL
	select BR2_PACKAGE_PROTOBUF
	select BR2_PACKAGE_TBB
	select BR2_PACKAGE_VALIJSON
	select BR2_PACKAGE_ZLIB
	help
	  falcosecurity/libs provides libsinsp, libscap, the kernel
	  module driver and the eBPF driver sources.

	  https://github.com/falcosecurity/libs
```

## package/farmhash/Config.in
```kconfig
config BR2_PACKAGE_FARMHASH
	bool "farmhash"
	depends on BR2_INSTALL_LIBSTDCPP
	depends on BR2_TOOLCHAIN_GCC_AT_LEAST_4_8 # C++11
	help
	  FarmHash, a family of hash functions.

	  https://github.com/google/farmhash

comment "farmhash needs a toolchain w/ C++11"
	depends on !BR2_INSTALL_LIBSTDCPP || \
		!BR2_TOOLCHAIN_GCC_AT_LEAST_4_8
```

## package/fbv/Config.in
```kconfig
config BR2_PACKAGE_FBV
	bool "fbv"
	help
	  fbv is a very simple graphic file viewer for the framebuffer
	  console, capable of displaying JPEG, PNG and BMP files
	  using libjpeg and libpng.

	  https://github.com/amadvance/fbv

if BR2_PACKAGE_FBV

config BR2_PACKAGE_FBV_PNG
	bool "PNG support"
	default y
	select BR2_PACKAGE_LIBPNG
	help
	  Enable support for PNG using libpng.

config BR2_PACKAGE_FBV_JPEG
	bool "JPEG support"
	default y
	select BR2_PACKAGE_JPEG
	help
	  Enable support for JPEG using IJG's libjpeg.

endif # BR2_PACKAGE_FBV
```

## package/fcft/Config.in
```kconfig
config BR2_PACKAGE_FCFT
	bool "fcft"
	depends on BR2_TOOLCHAIN_USES_GLIBC || BR2_TOOLCHAIN_USES_MUSL # C11 threads
	select BR2_PACKAGE_FONTCONFIG
	select BR2_PACKAGE_FREETYPE
	select BR2_PACKAGE_PIXMAN
	select BR2_PACKAGE_TLLIST
	help
	  A simple library for font loading and glyph rasterization
	  using FontConfig, FreeType and pixman.

	  https://codeberg.org/dnkl/fcft

if BR2_PACKAGE_FCFT

config BR2_PACKAGE_FCFT_GRAPHEME_SHAPING
	bool "grapheme-shaping"
	depends on BR2_INSTALL_LIBSTDCPP # harfbuzz
	depends on BR2_TOOLCHAIN_HAS_SYNC_4 # harfbuzz
	depends on BR2_TOOLCHAIN_GCC_AT_LEAST_4_9 # harfbuzz
	select BR2_PACKAGE_HARFBUZZ
	help
	  Enables shaping of individual grapheme clusters

comment "grapheme-shaping needs a toolchain w/ C++, gcc >= 4.9"
	depends on BR2_TOOLCHAIN_HAS_SYNC_4
	depends on !BR2_INSTALL_LIBSTDCPP || !BR2_TOOLCHAIN_GCC_AT_LEAST_4_9

config BR2_PACKAGE_FCFT_RUN_SHAPING
	bool "run-shaping"
	depends on BR2_INSTALL_LIBSTDCPP # harfbuzz
	depends on BR2_TOOLCHAIN_HAS_SYNC_4 # harfbuzz
	depends on BR2_TOOLCHAIN_GCC_AT_LEAST_4_9 # harfbuzz
	select BR2_PACKAGE_HARFBUZZ
	select BR2_PACKAGE_UTF8PROC
	help
	  Enables shaping of whole text runs.

comment "run-shaping needs a toolchain w/ C++, gcc >= 4.9"
	depends on BR2_TOOLCHAIN_HAS_SYNC_4
	depends on !BR2_INSTALL_LIBSTDCPP || !BR2_TOOLCHAIN_GCC_AT_LEAST_4_9

config BR2_PACKAGE_FCFT_SVG_SUPPORT
	bool "svg support"
	help
	  Enables svg support. This option increases the size of the
	  library by approximately 55KB.

endif # BR2_PACKAGE_FCFT

comment "fcft needs a glibc or musl toolchain"
	depends on !(BR2_TOOLCHAIN_USES_GLIBC || BR2_TOOLCHAIN_USES_MUSL)
```

## package/fd/Config.in
```kconfig
config BR2_PACKAGE_FD
	bool "fd"
	depends on BR2_PACKAGE_HOST_RUSTC_TARGET_ARCH_SUPPORTS
	select BR2_PACKAGE_HOST_RUSTC
	help
	  fd is a program to find entries in your filesystem. It is a
	  simple, fast and user-friendly alternative to find. While it
	  does not aim to support all of find's powerful functionality,
	  it provides sensible (opinionated) defaults for a majority of
	  use cases.

	  https://github.com/sharkdp/fd.git
```

## package/fft-eval/Config.in
```kconfig
config BR2_PACKAGE_FFT_EVAL
	bool "fft-eval"
	help
	  Program to aid open source spectrum analyzer development for
	  Qualcomm/Atheros AR92xx and AR93xx based chipsets.

	  It visualizes the FFT data reported by the chips to help
	  interpreting and understanding the data.

	  Enable sdl2 and sdl2_ttf for the graphic output tool
	  fft_eval_sdl.

	  https://github.com/simonwunderlich/FFT_eval
```

## package/fft2d/Config.in
```kconfig
config BR2_PACKAGE_FFT2D
	bool "fft2d"
	help
	  This is a package to calculate Discrete Fourier/Cosine/Sine
	  Transforms of 2,3-dimensional sequences of length 2^N.

	  http://www.kurims.kyoto-u.ac.jp/~ooura/fft.html
```

## package/ficl/Config.in
```kconfig
config BR2_PACKAGE_FICL
	bool "ficl"
	depends on BR2_TOOLCHAIN_GCC_AT_LEAST_4_6 # C11/static_assert
	help
	  Ficl is a programming language interpreter designed to be
	  embedded into other systems as a command, macro, and
	  development prototyping language.
	  Ficl is an acronym for "Forth Inspired Command Language".

	  https://ficl.sourceforge.net/

comment "ficl needs a gcc >= 4.6"
	depends on !BR2_TOOLCHAIN_GCC_AT_LEAST_4_6
```

## package/file/Config.in
```kconfig
config BR2_PACKAGE_FILE
	bool "file"
	help
	  Program to identify a file's format by scanning binary data
	  for known patterns.

	  https://www.darwinsys.com/file/
```

## package/fio/Config.in
```kconfig
config BR2_PACKAGE_FIO
	bool "fio"
	depends on BR2_USE_MMU # fork()
	depends on !BR2_STATIC_LIBS
	depends on BR2_TOOLCHAIN_GCC_AT_LEAST_4_9 # C11/stdatomic.h
	depends on BR2_TOOLCHAIN_HAS_SYNC_4
	depends on BR2_TOOLCHAIN_HAS_THREADS
	depends on BR2_TOOLCHAIN_HEADERS_AT_LEAST_4_5 # nvme_ioctl.h
	help
	  fio is an I/O tool meant to be used both for benchmark
	  and stress/hardware verification.

	  https://git.kernel.dk/cgit/fio/

comment "fio needs a toolchain w/ dynamic library, threads, gcc >= 4.9, headers >= 4.5"
	depends on !BR2_TOOLCHAIN_HAS_THREADS || BR2_STATIC_LIBS || \
		!BR2_TOOLCHAIN_GCC_AT_LEAST_4_9 || \
		!BR2_TOOLCHAIN_HEADERS_AT_LEAST_4_5
	depends on BR2_TOOLCHAIN_HAS_SYNC_4
	depends on BR2_USE_MMU
```

## package/firewalld/Config.in
```kconfig
config BR2_PACKAGE_FIREWALLD
	bool "firewalld"
	depends on BR2_USE_MMU # gobject-introspection, python3, python-gobject
	depends on BR2_PACKAGE_GOBJECT_INTROSPECTION_ARCH_SUPPORTS
	depends on BR2_USE_WCHAR # glib2, dbus-python, nftables, python3
	depends on BR2_TOOLCHAIN_GCC_AT_LEAST_4_9 # gobject-introspection
	depends on BR2_TOOLCHAIN_HAS_THREADS # dbus-python, python3
	depends on BR2_TOOLCHAIN_HEADERS_AT_LEAST_3_12
	depends on BR2_TOOLCHAIN_USES_GLIBC # gobject-introspection
	depends on BR2_HOST_GCC_AT_LEAST_8 # gobject-introspection
	depends on !BR2_STATIC_LIBS # python3
	select BR2_PACKAGE_DBUS # dbus-python
	select BR2_PACKAGE_DBUS_PYTHON
	select BR2_PACKAGE_GOBJECT_INTROSPECTION
	select BR2_PACKAGE_JANSSON # Uses the nftables json interface
	select BR2_PACKAGE_NFTABLES
	select BR2_PACKAGE_PYTHON3
	select BR2_PACKAGE_PYTHON_GOBJECT
	help
	  Firewalld provides a dynamically managed firewall with
	  support for network or firewall zones to define the trust
	  level of network connections or interfaces. It has support
	  for IPv4, IPv6 firewall settings and for ethernet bridges and
	  a separation of runtime and permanent configuration options.
	  It also provides an interface for services or applications to
	  add ip*tables and ebtables rules directly.

	  Note: Firewalld uses nftables as the backend and requires
	  kernel version >= 5.3.

	  https://github.com/firewalld/firewalld

comment "firewalld needs a glibc toolchain w/ wchar, dynamic library, headers >= 3.12, gcc >= 4.9, host gcc >= 8"
	depends on BR2_USE_MMU
	depends on BR2_PACKAGE_GOBJECT_INTROSPECTION_ARCH_SUPPORTS
	depends on !BR2_TOOLCHAIN_USES_GLIBC || \
		!BR2_TOOLCHAIN_HEADERS_AT_LEAST_3_12 || \
		!BR2_USE_WCHAR || BR2_STATIC_LIBS || \
		!BR2_TOOLCHAIN_GCC_AT_LEAST_4_9 || \
		!BR2_HOST_GCC_AT_LEAST_8 || BR2_STATIC_LIBS
```
