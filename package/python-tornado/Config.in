## package/python-tornado/Config.in
```kconfig
config BR2_PACKAGE_PYTHON_TORNADO
	bool "python-tornado"
	select BR2_PACKAGE_PYTHON3_ZLIB
	select BR2_PACKAGE_PYTHON3_SSL
	help
	  Tornado is a Python web framework and asynchronous networking
	  library, originally developed at FriendFeed.

	  http://www.tornadoweb.org
```

## package/python-tortoise-orm/Config.in
```kconfig
config BR2_PACKAGE_PYTHON_TORTOISE_ORM
	bool "python-tortoise-orm"
	select BR2_PACKAGE_PYTHON_AIOSQLITE # runtime
	select BR2_PACKAGE_PYTHON_ISO8601 # runtime
	select BR2_PACKAGE_PYTHON_PYPIKA_TORTOISE # runtime
	select BR2_PACKAGE_PYTHON_PYTZ # runtime
	help
	  Easy async ORM for python, built with relations in mind.

	  https://github.com/tortoise/tortoise-orm
```

## package/python-tpm2-pytss/Config.in
```kconfig
config BR2_PACKAGE_PYTHON_TPM2_PYTSS
	bool "python-tpm2-pytss"
	depends on !BR2_STATIC_LIBS # tpm2-tss
	depends on BR2_PACKAGE_HOST_RUSTC_TARGET_ARCH_SUPPORTS # python-cryptography
	select BR2_PACKAGE_PYTHON_ASN1CRYPTO # runtime
	select BR2_PACKAGE_PYTHON_CFFI # runtime
	select BR2_PACKAGE_PYTHON_CRYPTOGRAPHY # runtime
	select BR2_PACKAGE_PYTHON_PACKAGING # runtime
	select BR2_PACKAGE_PYTHON_PYYAML # runtime
	select BR2_PACKAGE_TPM2_TSS
	help
	  TPM 2.0 TSS Bindings for Python.

	  https://github.com/tpm2-software/tpm2-pytss

comment "python-tpm2-pytss needs a toolchain w/ dynamic library"
	depends on BR2_PACKAGE_HOST_RUSTC_TARGET_ARCH_SUPPORTS
	depends on BR2_STATIC_LIBS
```

## package/python-trafaret/Config.in
```kconfig
config BR2_PACKAGE_PYTHON_TRAFARET
	bool "python-trafaret"
	help
	  Ultimate transformation library that supports validation,
	  contexts and aiohttp.

	  https://github.com/Deepwalker/trafaret/
```

## package/python-traitlets/Config.in
```kconfig
config BR2_PACKAGE_PYTHON_TRAITLETS
	bool "python-traitlets"
	help
	  A configuration system for Python applications.

	  https://pypi.python.org/pypi/traitlets
```

## package/python-transitions/Config.in
```kconfig
config BR2_PACKAGE_PYTHON_TRANSITIONS
	bool "python-transitions"
	select BR2_PACKAGE_PYTHON_SIX # runtime
	help
	  Lightweight finite state machine implementation in Python.

	  https://github.com/pytransitions/transitions
```

## package/python-treq/Config.in
```kconfig
config BR2_PACKAGE_PYTHON_TREQ
	bool "python-treq"
	# twisted TLS -> python-{pyopenssl,service-identity}
	depends on BR2_PACKAGE_HOST_RUSTC_TARGET_ARCH_SUPPORTS
	select BR2_PACKAGE_PYTHON_ATTRS # runtime
	select BR2_PACKAGE_PYTHON_HYPERLINK # runtime
	select BR2_PACKAGE_PYTHON_INCREMENTAL # runtime
	select BR2_PACKAGE_PYTHON_REQUESTS # runtime
	select BR2_PACKAGE_PYTHON_TWISTED # runtime
	select BR2_PACKAGE_PYTHON_TWISTED_TLS # runtime
	help
	  treq is an HTTP library inspired by requests but written on
	  top of Twisted's Agents. It provides a simple, higher level
	  API for making HTTP requests when using Twisted.

	  https://github.com/twisted/treq
```

## package/python-trio-websocket/Config.in
```kconfig
config BR2_PACKAGE_PYTHON_TRIO_WEBSOCKET
	bool "python-trio-websocket"
	select BR2_PACKAGE_PYTHON_ASYNC_GENERATOR # runtime
	select BR2_PACKAGE_PYTHON_TRIO # runtime
	select BR2_PACKAGE_PYTHON_WSPROTO # runtime
	help
	  WebSocket library for Trio.

	  https://github.com/HyperionGray/trio-websocket
```

## package/python-trio/Config.in
```kconfig
config BR2_PACKAGE_PYTHON_TRIO
	bool "python-trio"
	select BR2_PACKAGE_PYTHON_ATTRS # runtime
	select BR2_PACKAGE_PYTHON_IDNA # runtime
	select BR2_PACKAGE_PYTHON_OUTCOME # runtime
	select BR2_PACKAGE_PYTHON_SNIFFIO # runtime
	select BR2_PACKAGE_PYTHON_SORTEDCONTAINERS # runtime
	help
	  A friendly Python library for async concurrency and I/O.

	  https://github.com/python-trio/trio
```

## package/python-twisted/Config.in
```kconfig
config BR2_PACKAGE_PYTHON_TWISTED
	bool "python-twisted"
	select BR2_PACKAGE_PYTHON_INCREMENTAL
	select BR2_PACKAGE_PYTHON_ATTRS # runtime
	select BR2_PACKAGE_PYTHON_AUTOMAT # runtime
	select BR2_PACKAGE_PYTHON_CONSTANTLY # runtime
	select BR2_PACKAGE_PYTHON_HYPERLINK # runtime
	select BR2_PACKAGE_PYTHON_ZOPE_INTERFACE # runtime
	select BR2_PACKAGE_PYTHON_TYPING_EXTENSIONS # runtime
	select BR2_PACKAGE_PYTHON3_PYEXPAT # runtime
	select BR2_PACKAGE_PYTHON3_ZLIB # runtime
	help
	  Twisted is an event-driven networking engine written in
	  Python.

	  https://twistedmatrix.com/trac/

if BR2_PACKAGE_PYTHON_TWISTED

config BR2_PACKAGE_PYTHON_TWISTED_HTTP2
	bool "HTTP2 support"
	select BR2_PACKAGE_PYTHON_H2 # runtime
	select BR2_PACKAGE_PYTHON_PRIORITY # runtime

config BR2_PACKAGE_PYTHON_TWISTED_TLS
	bool "TLS support"
	# python-{pyopenssl,service-identity}
	depends on BR2_PACKAGE_HOST_RUSTC_TARGET_ARCH_SUPPORTS
	select BR2_PACKAGE_PYTHON_IDNA # runtime
	select BR2_PACKAGE_PYTHON_PYOPENSSL # runtime
	select BR2_PACKAGE_PYTHON_SERVICE_IDENTITY # runtime

config BR2_PACKAGE_PYTHON_TWISTED_CONCH
	bool "Conch support"
	depends on BR2_PACKAGE_HOST_RUSTC_TARGET_ARCH_SUPPORTS # python-cryptography, python-bcrypt
	select BR2_PACKAGE_PYTHON_APPDIRS # runtime
	select BR2_PACKAGE_PYTHON_BCRYPT # runtime
	select BR2_PACKAGE_PYTHON_CRYPTOGRAPHY # runtime

config BR2_PACKAGE_PYTHON_TWISTED_SERIAL
	bool "Serial support"
	select BR2_PACKAGE_PYTHON_SERIAL # runtime

endif
```

## package/python-txaio/Config.in
```kconfig
config BR2_PACKAGE_PYTHON_TXAIO
	bool "python-txaio"
	help
	  Compatibility API between asyncio/Twisted/Trollius.

	  https://pypi.python.org/pypi/txaio
```

## package/python-txdbus/Config.in
```kconfig
config BR2_PACKAGE_PYTHON_TXDBUS
	bool "python-txdbus"
	# python-twisted -> python-cryptography
	depends on BR2_PACKAGE_HOST_RUSTC_TARGET_ARCH_SUPPORTS
	# python-twisted -> python-cryptography
	select BR2_PACKAGE_PYTHON_TWISTED # runtime
	select BR2_PACKAGE_PYTHON_SIX # runtime
	help
	  A native Python implementation of the DBus protocol for
	  Twisted applications.

	  https://github.com/cocagne/txdbus
```

## package/python-txtorcon/Config.in
```kconfig
config BR2_PACKAGE_PYTHON_TXTORCON
	bool "python-txtorcon"
	depends on BR2_PACKAGE_HOST_RUSTC_TARGET_ARCH_SUPPORTS # python-cryptography
	select BR2_PACKAGE_PYTHON_AUTOMAT # runtime
	select BR2_PACKAGE_PYTHON_CRYPTOGRAPHY # runtime
	select BR2_PACKAGE_PYTHON_TWISTED # runtime
	select BR2_PACKAGE_PYTHON_TWISTED_TLS # runtime
	select BR2_PACKAGE_PYTHON_ZOPE_INTERFACE # runtime
	help
	  Twisted-based Tor controller client, with state-tracking and
	  configuration abstractions.

	  https://github.com/meejah/txtorcon
```

## package/python-typeguard/Config.in
```kconfig
config BR2_PACKAGE_PYTHON_TYPEGUARD
	bool "python-typeguard"
	select BR2_PACKAGE_PYTHON_TYPING_EXTENSIONS # runtime
	help
	  Run-time type checker for Python.

	  https://github.com/agronholm/typeguard
```

## package/python-typepy/Config.in
```kconfig
config BR2_PACKAGE_PYTHON_TYPEPY
	bool "python-typepy"
	select BR2_PACKAGE_PYTHON_MBSTRDECODER # runtime
	help
	  A Python library for variable type
	  checker/validator/converter at a run time.

	  https://github.com/thombashi/typepy
```

## package/python-types-python-dateutil/Config.in
```kconfig
config BR2_PACKAGE_PYTHON_TYPES_PYTHON_DATEUTIL
	bool "python-types-python-dateutil"
	help
	  Typing stubs for python-dateutil.

	  https://github.com/python/typeshed
```

## package/python-typing-extensions/Config.in
```kconfig
config BR2_PACKAGE_PYTHON_TYPING_EXTENSIONS
	bool "python-typing-extensions"
	help
	  Backported and experimental type hints for Python.

	  https://github.com/python/typing_extensions
```

## package/python-typing-inspect/Config.in
```kconfig
config BR2_PACKAGE_PYTHON_TYPING_INSPECT
	bool "python-typing-inspect"
	select BR2_PACKAGE_PYTHON_MYPY_EXTENSIONS # runtime
	help
	  Runtime inspection utilities for typing module.

	  https://github.com/ilevkivskyi/typing_inspect
```

## package/python-typing-inspection/Config.in
```kconfig
config BR2_PACKAGE_PYTHON_TYPING_INSPECTION
	bool "python-typing-inspection"
	select BR2_PACKAGE_PYTHON_TYPING_EXTENSIONS # runtime
	help
	  Runtime typing introspection tools.

	  https://github.com/pydantic/typing-inspection
```

## package/python-tzlocal/Config.in
```kconfig
config BR2_PACKAGE_PYTHON_TZLOCAL
	bool "python-tzlocal"
	help
	  A Python module that tries to figure out what your
	  local timezone is.
```

## package/python-uhid/Config.in
```kconfig
config BR2_PACKAGE_PYTHON_UHID
	bool "python-uhid"
	help
	  Pure Python typed UHID wrapper.

	  https://github.com/FFY00/python-uhid
```

## package/python-ujson/Config.in
```kconfig
config BR2_PACKAGE_PYTHON_UJSON
	bool "python-ujson"
	depends on BR2_INSTALL_LIBSTDCPP
	help
	  UltraJSON is an ultra fast JSON encoder and decoder written
	  in pure C with bindings for Python 3.

	  https://pypi.python.org/pypi/ujson

comment "python-ujson needs a toolchain w/ C++"
	depends on !BR2_INSTALL_LIBSTDCPP
```

## package/python-unittest-xml-reporting/Config.in
```kconfig
config BR2_PACKAGE_PYTHON_UNITTEST_XML_REPORTING
	bool "python-unittest-xml-reporting"
	select BR2_PACKAGE_PYTHON3_PYEXPAT
	help
	  unittest-based test runner with Ant/JUnit like XML
	  reporting.

	  http://github.com/xmlrunner/unittest-xml-reporting/
```

## package/python-urllib3/Config.in
```kconfig
config BR2_PACKAGE_PYTHON_URLLIB3
	bool "python-urllib3"
	select BR2_PACKAGE_PYTHON3_ZLIB # runtime
	help
	  Python HTTP library with thread-safe connection pooling, file
	  post support, sanity friendly, and more.

	  http://urllib3.readthedocs.org/
```

## package/python-urwid-readline/Config.in
```kconfig
config BR2_PACKAGE_PYTHON_URWID_READLINE
	bool "python-urwid-readline"
	select BR2_PACKAGE_PYTHON_URWID # runtime
	help
	  A textbox edit widget for urwid that supports readline
	  shortcuts.

	  https://github.com/rr-/urwid_readline
```
