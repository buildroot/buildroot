## package/python-flask-smorest/Config.in
```kconfig
config BR2_PACKAGE_PYTHON_FLASK_SMOREST
	bool "python-flask-smorest"
	select BR2_PACKAGE_PYTHON_APISPEC # runtime
	select BR2_PACKAGE_PYTHON_FLASK # runtime
	select BR2_PACKAGE_PYTHON_MARSHMALLOW # runtime
	select BR2_PACKAGE_PYTHON_WEBARGS # runtime
	select BR2_PACKAGE_PYTHON_WERKZEUG # runtime
	help
	  Flask/Marshmallow-based REST API framework.

	  https://github.com/marshmallow-code/flask-smorest
```

## package/python-flask-wtf/Config.in
```kconfig
config BR2_PACKAGE_PYTHON_FLASK_WTF
	bool "python-flask-wtf"
	select BR2_PACKAGE_PYTHON_FLASK # runtime
	select BR2_PACKAGE_PYTHON_ITSDANGEROUS # runtime
	select BR2_PACKAGE_PYTHON_WTFORMS # runtime
	help
	  Simple integration of Flask and WTForms.

	  https://github.com/wtforms/flask-wtf
```

## package/python-flask/Config.in
```kconfig
config BR2_PACKAGE_PYTHON_FLASK
	bool "python-flask"
	select BR2_PACKAGE_PYTHON_BLINKER # runtime
	select BR2_PACKAGE_PYTHON_CLICK # runtime
	select BR2_PACKAGE_PYTHON_JINJA2 # runtime
	select BR2_PACKAGE_PYTHON_WERKZEUG # runtime
	select BR2_PACKAGE_PYTHON_ITSDANGEROUS # runtime
	select BR2_PACKAGE_PYTHON_SETUPTOOLS # runtime
	select BR2_PACKAGE_PYTHON3_SSL
	select BR2_PACKAGE_PYTHON3_ZLIB
	help
	  Flask is a microframework for Python based on Werkzeug,
	  Jinja 2 and good intentions.

	  https://palletsprojects.com/p/flask
```

## package/python-flup/Config.in
```kconfig
config BR2_PACKAGE_PYTHON_FLUP
	bool "python-flup"
	help
	  flup provides of a collection of WSGI modules for Python.
	  It allows a webserver to use scgi-mod and fastcgi-mod
	  with python.

	  https://pypi.python.org/pypi/flup
```

## package/python-fonttools/Config.in
```kconfig
config BR2_PACKAGE_PYTHON_FONTTOOLS
	bool "python-fonttools"
	help
	  Tools to manipulate font files.

	  https://github.com/fonttools/fonttools
```

## package/python-frozenlist/Config.in
```kconfig
config BR2_PACKAGE_PYTHON_FROZENLIST
	bool "python-frozenlist"
	help
	  A list-like structure which implements
	  collections.abc.MutableSequence.

	  https://github.com/aio-libs/frozenlist
```

## package/python-git/Config.in
```kconfig
config BR2_PACKAGE_PYTHON_GIT
	bool "python-git"
	depends on BR2_USE_MMU # git
	select BR2_PACKAGE_GIT # runtime
	select BR2_PACKAGE_PYTHON_GITDB2 # runtime
	select BR2_PACKAGE_PYTHON_TYPING_EXTENSIONS # runtime
	help
	  GitPython is a python library used to interact with git
	  repositories, high-level like git-porcelain, or low-level
	  like git-plumbing.

	  https://github.com/gitpython-developers/GitPython
```

## package/python-gitdb2/Config.in
```kconfig
config BR2_PACKAGE_PYTHON_GITDB2
	bool "python-gitdb2"
	depends on BR2_PACKAGE_PYTHON3
	select BR2_PACKAGE_PYTHON_SMMAP2 # runtime
	select BR2_PACKAGE_PYTHON3_ZLIB
	help
	  GitDB allows you to access bare git repositories for reading
	  and writing. It aims at allowing full access to loose objects
	  as well as packs with performance and scalability in mind. It
	  operates exclusively on streams, allowing to handle large
	  objects with a small memory footprint.

	  https://github.com/gitpython-developers/gitdb
```

## package/python-gnupg/Config.in
```kconfig
config BR2_PACKAGE_PYTHON_GNUPG
	bool "python-gnupg"
	select BR2_PACKAGE_GNUPG2 if BR2_PACKAGE_GNUPG2_DEPENDS && !BR2_PACKAGE_GNUPG # runtime
	select BR2_PACKAGE_GNUPG if !BR2_PACKAGE_GNUPG2_DEPENDS # runtime
	help
	  A wrapper for the Gnu Privacy Guard (GPG or GnuPG).

	  The gnupg module allows Python programs to make use of the
	  functionality provided by the GNU Privacy Guard (abbreviated
	  GPG or GnuPG). Using this module, Python programs can
	  encrypt and decrypt data, digitally sign documents and
	  verify digital signatures, manage (generate, list and
	  delete) encryption keys, using Public Key Infrastructure
	  (PKI) encryption technology based on OpenPGP.

	  https://docs.red-dove.com/python-gnupg/
```

## package/python-gobject/Config.in
```kconfig
config BR2_PACKAGE_PYTHON_GOBJECT
	bool "python-gobject"
	depends on BR2_USE_MMU # libglib2, gobject-introspection
	depends on BR2_PACKAGE_GOBJECT_INTROSPECTION_ARCH_SUPPORTS # gobject-introspection
	depends on BR2_TOOLCHAIN_GCC_AT_LEAST_4_9 # gobject-introspection
	depends on BR2_HOST_GCC_AT_LEAST_8 # gobject-introspection -> host-qemu
	depends on BR2_TOOLCHAIN_USES_GLIBC # gobject-introspection
	depends on BR2_PACKAGE_PYTHON3 # gobject-introspection
	select BR2_PACKAGE_GOBJECT_INTROSPECTION
	select BR2_PACKAGE_LIBGLIB2
	help
	  Python bindings for the GLib/GObject library

	  https://wiki.gnome.org/action/show/Projects/PyGObject

comment "python-gobject needs a glibc toolchain, gcc >= 4.9, host gcc >= 8"
	depends on BR2_USE_MMU
	depends on BR2_PACKAGE_GOBJECT_INTROSPECTION_ARCH_SUPPORTS
	depends on !BR2_TOOLCHAIN_USES_GLIBC || \
		!BR2_TOOLCHAIN_GCC_AT_LEAST_4_9 || \
		!BR2_HOST_GCC_AT_LEAST_8
```

## package/python-google-api-core/Config.in
```kconfig
config BR2_PACKAGE_PYTHON_GOOGLE_API_CORE
	bool "python-google-api-core"
	depends on BR2_PACKAGE_HOST_PROTOBUF_ARCH_SUPPORTS # python-proto-plus
	select BR2_PACKAGE_PYTHON_GOOGLE_AUTH # runtime
	select BR2_PACKAGE_PYTHON_GOOGLEAPIS_COMMON_PROTOS # runtime
	select BR2_PACKAGE_PYTHON_PROTO_PLUS # runtime
	select BR2_PACKAGE_PYTHON_PROTOBUF # runtime
	select BR2_PACKAGE_PYTHON_REQUESTS # runtime
	help
	  Google API client core library.

	  https://github.com/googleapis/python-api-core
```

## package/python-google-auth/Config.in
```kconfig
config BR2_PACKAGE_PYTHON_GOOGLE_AUTH
	bool "python-google-auth"
	depends on BR2_PACKAGE_HOST_RUSTC_TARGET_ARCH_SUPPORTS # python-cryptography
	select BR2_PACKAGE_PYTHON_CRYPTOGRAPHY # runtime
	select BR2_PACKAGE_PYTHON_PYASN1_MODULES # runtime
	help
	  Google Authentication Library.

	  https://github.com/googleapis/google-auth-library-python
```

## package/python-gpiod/Config.in
```kconfig
config BR2_PACKAGE_PYTHON_GPIOD
	bool "python-gpiod"
	depends on BR2_TOOLCHAIN_HEADERS_AT_LEAST_5_10 # libgpiod2
	depends on !BR2_PACKAGE_LIBGPIOD # libgpiod2
	select BR2_PACKAGE_LIBGPIOD2
	help
	  Python bindings for libgpiod (v2+).

	  https://git.kernel.org/pub/scm/libs/libgpiod/libgpiod.git/tree/bindings/python/

comment "python-gpiod needs kernel headers >= 5.10"
	depends on !BR2_TOOLCHAIN_HEADERS_AT_LEAST_5_10

comment "python-gpiod is incompatible with libgpiod"
	depends on BR2_PACKAGE_LIBGPIOD
```

## package/python-greenlet/Config.in
```kconfig
config BR2_PACKAGE_PYTHON_GREENLET
	bool "python-greenlet"
	help
	  python-greenlet is a Python library to  provide lightweight in-process concurrent programming

 	  https://github.com/python-greenlet/greenlet
```

## package/python-greenlet/Config.in.host
```kconfig
config BR2_PACKAGE_HOST_PYTHON_GREENLET
	bool "host python-greenlet"
	help
	  Greenlets are lightweight coroutines for in-process concurrent
	  programming.

	  https://greenlet.readthedocs.io/
```

## package/python-grpc-requests/Config.in
```kconfig
config BR2_PACKAGE_PYTHON_GRPC_REQUESTS
	bool "python-grpc-requests"
	depends on BR2_PACKAGE_HOST_RUSTC_TARGET_ARCH_SUPPORTS # python-cryptography
	depends on BR2_PACKAGE_PYTHON_GRPCIO_ARCH_SUPPORTS # python-grpcio
	depends on BR2_INSTALL_LIBSTDCPP # python-grpcio
	select BR2_PACKAGE_PYTHON_CRYPTOGRAPHY # runtime
	select BR2_PACKAGE_PYTHON_GOOGLE_API_CORE # runtime
	select BR2_PACKAGE_PYTHON_GRPCIO # runtime
	select BR2_PACKAGE_PYTHON_GRPCIO_REFLECTION # runtime
	help
	  grpc for Humans. grpc reflection support client.

	  https://github.com/wesky93/grpc_requests

comment "python-grpcio-requests needs a toolchain w/ C++"
	depends on BR2_PACKAGE_HOST_RUSTC_TARGET_ARCH_SUPPORTS
	depends on BR2_PACKAGE_PYTHON_GRPCIO_ARCH_SUPPORTS
	depends on !BR2_INSTALL_LIBSTDCPP
```

## package/python-grpcio-reflection/Config.in
```kconfig
config BR2_PACKAGE_PYTHON_GRPCIO_REFLECTION
	bool "python-grpcio-reflection"
	depends on BR2_PACKAGE_PYTHON_GRPCIO_ARCH_SUPPORTS # python-grpcio
	depends on BR2_INSTALL_LIBSTDCPP # python-grpcio
	select BR2_PACKAGE_PYTHON_GRPCIO # runtime
	select BR2_PACKAGE_PYTHON_PROTOBUF # runtime
	help
	  Standard Protobuf Reflection Service for gRPC.

	  https://grpc.io

comment "python-grpcio-reflection needs a toolchain w/ C++"
	depends on BR2_PACKAGE_PYTHON_GRPCIO_ARCH_SUPPORTS
	depends on !BR2_INSTALL_LIBSTDCPP
```

## package/python-grpclib/Config.in
```kconfig
config BR2_PACKAGE_PYTHON_GRPCLIB
	bool "python-grpclib"
	select BR2_PACKAGE_PYTHON_H2 # runtime
	select BR2_PACKAGE_PYTHON_MULTIDICT # runtime
	help
	  Pure-Python gRPC implementation for asyncio.

	  https://github.com/vmagamedov/grpclib
```

## package/python-gunicorn/Config.in
```kconfig
config BR2_PACKAGE_PYTHON_GUNICORN
	bool "python-gunicorn"
	select BR2_PACKAGE_PYTHON_PACKAGING # runtime
	select BR2_PACKAGE_PYTHON3_SSL # runtime
	help
	  Gunicorn 'Green Unicorn' is a Python WSGI HTTP Server for
	  UNIX. It's a pre-fork worker model ported from Ruby's
	  Unicorn project. The Gunicorn server is broadly compatible
	  with various web frameworks, simply implemented, light on
	  server resource usage, and fairly speedy.

	  http://gunicorn.org/
```

## package/python-gymnasium/Config.in
```kconfig
config BR2_PACKAGE_PYTHON_GYMNASIUM
	bool "python-gymnasium"
	depends on BR2_PACKAGE_PYTHON_NUMPY_ARCH_SUPPORTS # python-numpy
	depends on BR2_INSTALL_LIBSTDCPP # python-numpy
	depends on BR2_TOOLCHAIN_USES_GLIBC || BR2_TOOLCHAIN_USES_MUSL # python-numpy
	depends on BR2_TOOLCHAIN_GCC_AT_LEAST_9 # python-numpy
	select BR2_PACKAGE_PYTHON_CLOUDPICKLE # runtime
	select BR2_PACKAGE_PYTHON_FARAMA_NOTIFICATIONS # runtime
	select BR2_PACKAGE_PYTHON_NUMPY # runtime
	select BR2_PACKAGE_PYTHON_TYPING_EXTENSIONS # runtime
	help
	  A standard API for reinforcement learning and a diverse set
	  of reference environments (formerly Gym).

	  https://farama.org

comment "python-gymnasium needs a glibc or musl toolchain w/ C++, gcc >= 9"
	depends on BR2_PACKAGE_PYTHON_NUMPY_ARCH_SUPPORTS
	depends on !BR2_INSTALL_LIBSTDCPP || \
		!BR2_TOOLCHAIN_GCC_AT_LEAST_9 || \
		!(BR2_TOOLCHAIN_USES_GLIBC || BR2_TOOLCHAIN_USES_MUSL)
```

## package/python-h11/Config.in
```kconfig
config BR2_PACKAGE_PYTHON_H11
	bool "python-h11"
	help
	  A pure-Python, bring-your-own-I/O implementation of
	  HTTP/1.1.

	  https://github.com/python-hyper/h11
```

## package/python-h2/Config.in
```kconfig
config BR2_PACKAGE_PYTHON_H2
	bool "python-h2"
	select BR2_PACKAGE_PYTHON_HPACK # runtime
	select BR2_PACKAGE_PYTHON_HYPERFRAME # runtime
	help
	  HTTP/2 State-Machine based protocol implementation.

	  https://github.com/python-hyper/h2
```

## package/python-hiredis/Config.in
```kconfig
config BR2_PACKAGE_PYTHON_HIREDIS
	bool "python-hiredis"
	depends on BR2_PACKAGE_PYTHON3
	help
	  Python wrapper for hiredis.

	  https://github.com/redis/hiredis-py
```

## package/python-hkdf/Config.in
```kconfig
config BR2_PACKAGE_PYTHON_HKDF
	bool "python-hkdf"
	help
	  HMAC-based Extract-and-Expand Key Derivation Function
	  (HKDF).

	  https://github.com/casebeer/python-hkdf
```

## package/python-hpack/Config.in
```kconfig
config BR2_PACKAGE_PYTHON_HPACK
	bool "python-hpack"
	help
	  Pure-Python HPACK header compression.

	  https://github.com/python-hyper/hpack
```
