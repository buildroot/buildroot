## package/python-servestatic/Config.in
```kconfig
config BR2_PACKAGE_PYTHON_SERVESTATIC
	bool "python-servestatic"
	select BR2_PACKAGE_PYTHON_ASGIREF # runtime dependency
	select BR2_PACKAGE_PYTHON3_ZLIB # runtime dependency for cli / servestatic.storage usage
	help
	  Production-grade static file server for Python WSGI and ASGI.

	  ServeStatic runs standalone or as middleware for an existing
	  WSGI, ASGI, or Django application.

	  https://github.com/Archmonger/ServeStatic
```

## package/python-shellingham/Config.in
```kconfig
config BR2_PACKAGE_PYTHON_SHELLINGHAM
	bool "python-shellingham"
	help
	  Tool to detect the shell you are using.

	  https://github.com/sarugaku/shellingham
```

## package/python-snappy/Config.in
```kconfig
config BR2_PACKAGE_PYTHON_SNAPPY
	bool "python-snappy"
	depends on BR2_PACKAGE_HOST_RUSTC_TARGET_ARCH_SUPPORTS # python-cramjam
	select BR2_PACKAGE_PYTHON_CRAMJAM # runtime
	help
	  Python library for the snappy compression library from
	  Google.

	  http://github.com/andrix/python-snappy
```

## package/python-telnetlib3/Config.in
```kconfig
config BR2_PACKAGE_PYTHON_TELNETLIB3
	bool "python-telnetlib3"
	select BR2_PACKAGE_PYTHON_WCWIDTH # runtime
	help
	  Python 3 asyncio Telnet server and client Protocol library.

	  http://telnetlib3.rtfd.org/
```

## package/python-truststore/Config.in
```kconfig
config BR2_PACKAGE_PYTHON_TRUSTSTORE
	bool "python-truststore"
	select BR2_PACKAGE_CA_CERTIFICATES # runtime
	select BR2_PACKAGE_PYTHON3_SSL # runtime
	help
	  Verify certificates using native system trust stores.

	  https://github.com/sethmlarson/truststore
```

## package/python-typer-slim/Config.in
```kconfig
config BR2_PACKAGE_PYTHON_TYPER_SLIM
	bool "python-typer-slim"
	select BR2_PACKAGE_PYTHON_TYPER # runtime
	help
	  Compatibility package that depends on Typer.

	  https://github.com/fastapi/typer
```

## package/python-typer/Config.in
```kconfig
config BR2_PACKAGE_PYTHON_TYPER
	bool "python-typer"
	select BR2_PACKAGE_PYTHON_ANNOTATED_DOC # runtime
	select BR2_PACKAGE_PYTHON_RICH # runtime
	select BR2_PACKAGE_PYTHON_SHELLINGHAM # runtime
	help
	  Build command-line interfaces using Python type hints.

	  https://github.com/fastapi/typer
```

## package/qemu-xen/Config.in
```kconfig
config BR2_PACKAGE_QEMU_XEN
	bool "qemu-xen"
	help
	  The qemu-xen source tree, a QEMU fork maintained by the Xen
	  project for use as the device model in Xen tool stacks.
	  Starting with Xen 4.20, this is no longer bundled in the Xen
	  release tarball.

	  https://xenbits.xen.org/gitweb/?p=qemu-xen.git
```

## package/qrtr/Config.in
```kconfig
config BR2_PACKAGE_QRTR
	bool "qrtr"
	depends on BR2_TOOLCHAIN_HEADERS_AT_LEAST_4_15 # linux/qrtr.h control packets
	help
	  Userspace for the Qualcomm IPC Router (QRTR), the transport
	  used to talk to the remote processors (modem, ADSP, ...) of
	  Qualcomm SoCs: the libqrtr library and the qrtr-cfg and
	  qrtr-lookup tools.

	  The QRTR name service runs in the kernel since Linux 5.7,
	  so the userspace qrtr-ns daemon is not installed.

	  https://github.com/linux-msm/qrtr

comment "qrtr needs a toolchain w/ headers >= 4.15"
	depends on !BR2_TOOLCHAIN_HEADERS_AT_LEAST_4_15
```

## package/qt6/qt6coap/Config.in
```kconfig
config BR2_PACKAGE_QT6COAP
	bool "qt6coap"
	select BR2_PACKAGE_QT6BASE_NETWORK
	help
	  Qt is a cross-platform application and UI framework for
	  developers using C++.

	  This package corresponds to the qt6coap module.

	  https://doc.qt.io/qt-6/qtcoap-index.html
```

## package/qwt/Config.in
```kconfig
config BR2_PACKAGE_QWT
	bool "qwt"
	depends on BR2_PACKAGE_QT5 || BR2_PACKAGE_QT6
	select BR2_PACKAGE_QT5BASE_GUI if BR2_PACKAGE_QT5
	select BR2_PACKAGE_QT5BASE_WIDGETS if BR2_PACKAGE_QT5 # printsupport
	select BR2_PACKAGE_QT5BASE_CONCURRENT if BR2_PACKAGE_QT5
	select BR2_PACKAGE_QT6BASE_GUI if BR2_PACKAGE_QT6
	select BR2_PACKAGE_QT6BASE_WIDGETS if BR2_PACKAGE_QT6
	select BR2_PACKAGE_QT6BASE_PRINTSUPPORT if BR2_PACKAGE_QT6
	select BR2_PACKAGE_QT6BASE_CONCURRENT if BR2_PACKAGE_QT6
	help
	  Qwt is a graphics extension to the Qt GUI application
	  framework. It provides a 2D plotting widget and more.

	  http://qwt.sourceforge.net/

if BR2_PACKAGE_QWT

config BR2_PACKAGE_QWT_SVG
	bool "SVG support"
	select BR2_PACKAGE_QT5SVG if BR2_PACKAGE_QT5
	select BR2_PACKAGE_QT6SVG if BR2_PACKAGE_QT6

config BR2_PACKAGE_QWT_MATHML
	bool "MathML support"

config BR2_PACKAGE_QWT_OPENGL
	bool "OpenGL support"
	depends on BR2_PACKAGE_QT5_GL_AVAILABLE || BR2_PACKAGE_QT6_GL_SUPPORTS
	select BR2_PACKAGE_QT5BASE_OPENGL if BR2_PACKAGE_QT5
	select BR2_PACKAGE_QT5BASE_OPENGL_LIB if BR2_PACKAGE_QT5
	select BR2_PACKAGE_QT6BASE_OPENGL if BR2_PACKAGE_QT6

endif
```

## package/raw2rgbpnm/Config.in
```kconfig
config BR2_PACKAGE_RAW2RGBPNM
	bool "raw2rgbpnm"
	help
	  Convert raw bayer images to RGB PNM for easier viewing

	  https://gitlab.freedesktop.org/camera/raw2rgbpnm
```

## package/rmtfs/Config.in
```kconfig
config BR2_PACKAGE_RMTFS
	bool "rmtfs"
	depends on BR2_PACKAGE_HAS_UDEV
	depends on BR2_TOOLCHAIN_HAS_THREADS
	depends on BR2_TOOLCHAIN_HEADERS_AT_LEAST_4_15 # qrtr
	select BR2_PACKAGE_QRTR
	help
	  Remote file system service for the modem of Qualcomm SoCs:
	  serves the modem's EFS partitions (modemst1, modemst2, fsg,
	  fsc) over QRTR and the rmtfs shared memory. Without it the
	  modem firmware stalls at boot.

	  https://github.com/linux-msm/rmtfs

comment "rmtfs needs udev /dev management and a toolchain w/ threads, headers >= 4.15"
	depends on !BR2_PACKAGE_HAS_UDEV || !BR2_TOOLCHAIN_HAS_THREADS || \
		!BR2_TOOLCHAIN_HEADERS_AT_LEAST_4_15
```

## package/sdl3/Config.in
```kconfig
config BR2_PACKAGE_SDL3
	bool "sdl3"
	depends on !BR2_STATIC_LIBS
	depends on BR2_USE_WCHAR
	depends on BR2_TOOLCHAIN_HAS_THREADS
	help
	  Simple DirectMedia Layer 3 - SDL3 is a library that allows
	  programs portable low level access to a video framebuffer,
	  audio output, mouse, and keyboard. It is not compatible with
	  SDL2.

	  http://www.libsdl.org/

if BR2_PACKAGE_SDL3

config BR2_PACKAGE_SDL3_X11
	bool "X11 video driver"
	depends on BR2_PACKAGE_XORG7
	depends on BR2_USE_MMU # fork()
	select BR2_PACKAGE_XLIB_LIBX11
	select BR2_PACKAGE_XLIB_LIBXEXT

comment "X11 video driver needs X.org"
	depends on !BR2_PACKAGE_XORG7
	depends on BR2_USE_MMU

config BR2_PACKAGE_SDL3_KMSDRM
	bool "KMS/DRM video driver"
	depends on BR2_TOOLCHAIN_HAS_THREADS  # libdrm
	depends on BR2_PACKAGE_HAS_LIBGBM
	depends on BR2_PACKAGE_HAS_LIBEGL
	depends on BR2_PACKAGE_SDL3_OPENGL || BR2_PACKAGE_SDL3_OPENGLES
	select BR2_PACKAGE_LIBDRM

comment "KMS/DRM video driver needs a toolchain w/ threads"
	depends on !BR2_TOOLCHAIN_HAS_THREADS

comment "KMS/DRM video driver needs a GBM provider, and OpenGL or OpenGLES+EGL"
	depends on !BR2_PACKAGE_HAS_LIBGBM || \
		!BR2_PACKAGE_HAS_LIBEGL || \
		!(BR2_PACKAGE_SDL3_OPENGL || BR2_PACKAGE_SDL3_OPENGLES)

config BR2_PACKAGE_SDL3_WAYLAND
	bool "Wayland video driver"
	depends on BR2_TOOLCHAIN_HAS_THREADS # wayland
	depends on BR2_PACKAGE_WAYLAND
	depends on BR2_PACKAGE_HAS_LIBEGL
	depends on BR2_PACKAGE_SDL3_OPENGLES
	select BR2_PACKAGE_LIBXKBCOMMON
	select BR2_PACKAGE_WAYLAND_PROTOCOLS

comment "Wayland video driver needs a toolchain w/ threads"
	depends on !BR2_TOOLCHAIN_HAS_THREADS

comment "Wayland video driver needs wayland with an OpenGLES+EGL backend"
	depends on !BR2_PACKAGE_WAYLAND || \
		!BR2_PACKAGE_HAS_LIBEGL || \
		!BR2_PACKAGE_SDL3_OPENGLES

config BR2_PACKAGE_SDL3_OPENGL
	bool "OpenGL (GLX)"
	depends on BR2_PACKAGE_HAS_LIBGL
	depends on BR2_PACKAGE_XORG7
	depends on BR2_USE_MMU # X11 video driver
	select BR2_PACKAGE_SDL3_X11

comment "OpenGL support needs X11 and an OpenGL provider"
	depends on BR2_USE_MMU
	depends on !BR2_PACKAGE_HAS_LIBGL || !BR2_PACKAGE_XORG7

config BR2_PACKAGE_SDL3_OPENGLES
	bool "OpenGL ES"
	depends on BR2_PACKAGE_HAS_LIBGLES

comment "OpenGL ES support needs an OpenGL ES provider"
	depends on !BR2_PACKAGE_HAS_LIBGLES

endif

comment "sdl3 needs a toolchain w/ dynamic library, threads, wchar"
	depends on BR2_STATIC_LIBS || !BR2_TOOLCHAIN_HAS_THREADS || !BR2_USE_WCHAR
```

## package/sdl3_gfx/Config.in
```kconfig
config BR2_PACKAGE_SDL3_GFX
	bool "sdl3_gfx"
	depends on BR2_PACKAGE_SDL3
	help
	  The SDL3_gfx library is an extension to the SDL3 library
	  which provides basic antialiased drawing routines such as
	  lines, circles or polygons, an interpolating rotozoomer for
	  SDL surfaces, framerate control and MMX image filters.

	  https://github.com/sabdul-khabir/SDL3_gfx
```

## package/sdl3_image/Config.in
```kconfig
config BR2_PACKAGE_SDL3_IMAGE
	bool "sdl3_image"
	depends on BR2_PACKAGE_SDL3
	help
	  SDL3_image is an image file loading library. It loads images
	  as SDL surfaces, and supports the following formats: AVIF,
	  BMP, GIF, JPEG, JXL, LBM, PCX, PNG, PNM, QOI, SVG, TGA, TIFF,
	  WEBP, XCF, XPM, XV.

	  The formats needing a helper library are built according to
	  the image libraries enabled in the configuration (jpeg,
	  libpng, tiff, webp, libjxl, libavif); the rest are decoded by
	  SDL3_image itself and are always available.

	  http://www.libsdl.org/projects/SDL_image/
```

## package/sdl3_net/Config.in
```kconfig
config BR2_PACKAGE_SDL3_NET
	bool "sdl3_net"
	depends on BR2_PACKAGE_SDL3
	help
	  SDL3_net is a small cross-platform networking library for
	  SDL3, providing TCP and UDP sockets and hostname
	  resolution.

	  https://github.com/libsdl-org/SDL_net
```

## package/sdl3_ttf/Config.in
```kconfig
config BR2_PACKAGE_SDL3_TTF
	bool "sdl3_ttf"
	depends on BR2_PACKAGE_SDL3
	select BR2_PACKAGE_FREETYPE
	help
	  SDL3_ttf is a sample TrueType font library. It allows you to
	  use TrueType fonts in your SDL3 applications.

	  http://www.libsdl.org/projects/SDL_ttf/
```

## package/sema-linux/Config.in
```kconfig
config BR2_PACKAGE_SEMA_LINUX
	bool "sema-linux"
	depends on !BR2_s390x
	depends on BR2_LINUX_KERNEL
	select BR2_PACKAGE_UTIL_LINUX
	select BR2_PACKAGE_UTIL_LINUX_LIBUUID
	help
	  SEMA (Smart Embedded Management Agent) is an agent used to
	  manage system health and access the I/O pins through an API.

	  https://github.com/ADLINK/sema-linux

comment "sema-linux needs a toolchain w/ dynamic library, Linux kernel"
	depends on BR2_STATIC_LIBS || !BR2_LINUX_KERNEL
```

## package/ser2net/Config.in
```kconfig
config BR2_PACKAGE_SER2NET
	bool "ser2net"
	depends on BR2_USE_MMU # fork()
	depends on !BR2_STATIC_LIBS # gensio
	depends on BR2_TOOLCHAIN_HAS_ATOMIC # gensio
	select BR2_PACKAGE_GENSIO
	select BR2_PACKAGE_LIBXCRYPT if BR2_TOOLCHAIN_USES_GLIBC
	select BR2_PACKAGE_LIBYAML
	help
	  Ser2net provides a way for a user to connect from a network
	  connection to a serial port.

	  http://ser2net.sourceforge.net

comment "ser2net needs a toolchain w/ dynamic library"
	depends on BR2_USE_MMU
	depends on BR2_TOOLCHAIN_HAS_ATOMIC
	depends on BR2_STATIC_LIBS
```

## package/sscep/Config.in
```kconfig
config BR2_PACKAGE_SSCEP
	bool "sscep"
	select BR2_PACKAGE_LIBOPENSSL_ENABLE_BLOWFISH
	select BR2_PACKAGE_LIBOPENSSL_ENABLE_DES
	select BR2_PACKAGE_OPENSSL
	select BR2_PACKAGE_OPENSSL_FORCE_LIBOPENSSL
	help
	  SSCEP is a client-only implementation of the SCEP
	  (Cisco System's Simple Certificate Enrollment Protocol).

	  https://github.com/certnanny/sscep
```

## package/sunwait/Config.in
```kconfig
config BR2_PACKAGE_SUNWAIT
	bool "sunwait"
	help
	  Sunwait calculates sunrise or sunset times with civil,
	  nautical, astronomical and custom twilights.

	  https://github.com/risacher/sunwait
```

## package/systemd/Config.in.host
```kconfig
config BR2_PACKAGE_HOST_SYSTEMD
	bool "host systemd"
	depends on BR2_HOST_GCC_AT_LEAST_8
	help
	  Select this if you need host systemd tools (e.g. systemctl)

if BR2_PACKAGE_HOST_SYSTEMD

config BR2_PACKAGE_HOST_SYSTEMD_MEASURE
	bool "systemd-measure"
	help
	  Build host-systemd with the systemd-measure tool. The
	  host-systemd package installs ukify, systemd-measure is
	  required if you want ukify to calculate, sign, or show
	  expected PCR values.

endif # BR2_PACKAGE_HOST_SYSTEMD
```

## package/tcpreplay/Config.in
```kconfig
config BR2_PACKAGE_TCPREPLAY
	bool "tcpreplay"
	depends on BR2_USE_MMU # fork()
	depends on BR2_TOOLCHAIN_HAS_THREADS
	select BR2_PACKAGE_LIBPCAP
	select BR2_PACKAGE_MUSL_FTS if !BR2_TOOLCHAIN_USES_GLIBC
	help
	  Tcpreplay is a tool for replaying network traffic from files
	  saved with tcpdump or other tools which write pcap(3) files.

	  http://tcpreplay.appneta.com/

comment "tcpreplay needs a toolchain w/ threads"
	depends on BR2_USE_MMU
	depends on !BR2_TOOLCHAIN_HAS_THREADS
```

## package/tqftpserv/Config.in
```kconfig
config BR2_PACKAGE_TQFTPSERV
	bool "tqftpserv"
	depends on BR2_TOOLCHAIN_HEADERS_AT_LEAST_4_15 # qrtr
	select BR2_PACKAGE_QRTR
	help
	  TFTP server over QRTR for the remote processors of Qualcomm
	  SoCs: hands the modem the files it asks for, e.g. the WLAN
	  firmware, from /lib/firmware. Serves xz or zstd compressed
	  files when xz or zstd is enabled.

	  https://github.com/linux-msm/tqftpserv

comment "tqftpserv needs a toolchain w/ headers >= 4.15"
	depends on !BR2_TOOLCHAIN_HEADERS_AT_LEAST_4_15
```
