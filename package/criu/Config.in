## package/criu/Config.in
```kconfig
# criu only builds on certain architectures
config BR2_PACKAGE_CRIU_ARCH_SUPPORTS
	bool
	default y if BR2_ARM_CPU_ARMV6
	default y if BR2_ARM_CPU_ARMV7A
	default y if BR2_ARM_CPU_ARMV7M
	default y if BR2_ARM_CPU_ARMV8A && !BR2_aarch64_be
	default y if BR2_aarch64
	default y if BR2_x86_64
	default y if BR2_powerpc64le # Only support powerpc64 with LE
	# CRIU has "some" support for s390 but it is not included due to
	# BE/LE endian issues.
	depends on BR2_USE_MMU # libcap
	depends on BR2_PACKAGE_HOST_PROTOBUF_ARCH_SUPPORTS # protobuf-c
	depends on BR2_PACKAGE_PROTOBUF_ARCH_SUPPORTS
	depends on BR2_PACKAGE_LIBBSD_ARCH_SUPPORTS

config BR2_PACKAGE_CRIU
	bool "criu"
	depends on BR2_PACKAGE_CRIU_ARCH_SUPPORTS
	depends on BR2_HOST_GCC_AT_LEAST_7 # protobuf-c
	depends on BR2_TOOLCHAIN_GCC_AT_LEAST_8 # -march=armv7-a+fp, protobuf
	depends on BR2_TOOLCHAIN_HEADERS_AT_LEAST_4_18 # rseq.h
	depends on !BR2_TOOLCHAIN_USES_UCLIBC # no aio.h
	depends on !BR2_STATIC_LIBS # protobuf, libbsd
	depends on BR2_INSTALL_LIBSTDCPP # protobuf
	depends on BR2_TOOLCHAIN_HAS_THREADS # protobuf, libnl
	depends on BR2_USE_WCHAR # libbsd
	select BR2_PACKAGE_HOST_PYTHON3_SSL
	select BR2_PACKAGE_PROTOBUF
	select BR2_PACKAGE_PROTOBUF_C
	select BR2_PACKAGE_LIBAIO
	select BR2_PACKAGE_LIBBSD
	select BR2_PACKAGE_LIBCAP
	select BR2_PACKAGE_LIBNET
	select BR2_PACKAGE_LIBNL
	select BR2_PACKAGE_PYTHON3
	help
	  Checkpoint/Restore In Userspace (CRIU), is a software
	  tool for the Linux operating system to make it possible
	  to freeze a running application and checkpoint it to
	  persistent storage as a collection of files.

	  https://criu.org/Main_Page

comment "criu needs a glibc or musl toolchain w/ threads, host gcc >= 7, gcc >= 8, headers >= 4.18, C++, dynamic library, wchar"
	depends on BR2_PACKAGE_CRIU_ARCH_SUPPORTS
	depends on !BR2_TOOLCHAIN_GCC_AT_LEAST_8 || !BR2_TOOLCHAIN_HAS_THREADS \
		|| !BR2_TOOLCHAIN_HEADERS_AT_LEAST_4_18 \
		|| BR2_TOOLCHAIN_USES_UCLIBC || !BR2_INSTALL_LIBSTDCPP \
		|| BR2_STATIC_LIBS || !BR2_USE_WCHAR \
		|| !BR2_HOST_GCC_AT_LEAST_7
```

## package/crucible/Config.in
```kconfig
config BR2_PACKAGE_CRUCIBLE
	bool "crucible"
	depends on BR2_PACKAGE_HOST_GO_TARGET_ARCH_SUPPORTS
	depends on BR2_TOOLCHAIN_HAS_THREADS_NPTL # pthread_getattr_np()
	select BR2_PACKAGE_HOST_GO
	help
	  Crucible is a One-Time-Programmable (OTP) fusing tool for the
	  i.MX family.

	  https://github.com/usbarmory/crucible

comment "crucible needs a toolchain w/ NPTL"
	depends on BR2_PACKAGE_HOST_GO_TARGET_ARCH_SUPPORTS
	depends on !BR2_TOOLCHAIN_HAS_THREADS_NPTL
```

## package/crudini/Config.in.host
```kconfig
config BR2_PACKAGE_HOST_CRUDINI
	bool "host crudini"
	select BR2_PACKAGE_HOST_PYTHON3
	select BR2_PACKAGE_HOST_PYTHON_INIPARSE # runtime
	help
	  A utility for handling ini files from the command line and
	  shell scripts

	  https://pypi.python.org/pypi/crudini
```

## package/crun/Config.in
```kconfig
config BR2_PACKAGE_CRUN
	bool "crun"
	depends on BR2_USE_MMU # fork()
	depends on BR2_TOOLCHAIN_GCC_AT_LEAST_4_9 # C11/stdatomic.h
	select BR2_PACKAGE_ARGP_STANDALONE if !BR2_TOOLCHAIN_USES_GLIBC
	select BR2_PACKAGE_YAJL # libocispec
	help
	  crun is a fast and low-memory OCI Container Runtime in C.

	  https://github.com/containers/crun

comment "crun needs a glibc or musl toolchain, gcc >= 4.9"
	depends on BR2_USE_MMU
	depends on BR2_TOOLCHAIN_USES_UCLIBC || \
		!BR2_TOOLCHAIN_GCC_AT_LEAST_4_9
```

## package/cryptodev-linux/Config.in
```kconfig
config BR2_PACKAGE_CRYPTODEV_LINUX
	bool "cryptodev-linux"
	depends on !BR2_microblaze
	depends on BR2_LINUX_KERNEL
	help
	  Cryptodev-linux is a device that allows access to Linux kernel
	  cryptographic drivers; thus allowing userspace applications
	  to take advantage of hardware accelerators.

	  http://cryptodev-linux.org/index.html

comment "cryptodev-linux needs a Linux kernel to be built"
	depends on !BR2_microblaze
	depends on !BR2_LINUX_KERNEL
```

## package/cryptopp/Config.in
```kconfig
config BR2_PACKAGE_CRYPTOPP
	bool "cryptopp"
	depends on BR2_INSTALL_LIBSTDCPP
	depends on !BR2_STATIC_LIBS
	depends on BR2_USE_WCHAR
	help
	  A free C++ class library of cryptographic schemes

comment "cryptopp needs a toolchain w/ C++, dynamic library, wchar"
	depends on !BR2_INSTALL_LIBSTDCPP || BR2_STATIC_LIBS || \
		!BR2_USE_WCHAR
```

## package/cukinia/Config.in
```kconfig
config BR2_PACKAGE_CUKINIA
	bool "cukinia"
	select BR2_PACKAGE_GAWK if !BR2_PACKAGE_BUSYBOX
	help
	  Cukinia is designed to help Linux-based embedded firmware
	  developers run system-level validation tests on their product.
	  It provides a simple POSIX shell overlay, and primitives to
	  make sure system integrations and features keep behaving the
	  way they should.

	  By default, cukinia reports colorized test results on stdout,
	  but can also report them as CSV and JUnit-XML for easy
	  integration with CI systems such as Jenkins.

	  https://github.com/savoirfairelinux/cukinia
```

## package/cups-pk-helper/Config.in
```kconfig
config BR2_PACKAGE_CUPS_PK_HELPER
	bool "cups-pk-helper"
	depends on BR2_USE_MMU
	depends on BR2_TOOLCHAIN_GCC_AT_LEAST_7 # polkit -> c++17
	depends on BR2_TOOLCHAIN_HAS_THREADS # libglib2, polkit
	depends on BR2_USE_WCHAR # libglib2
	depends on !BR2_STATIC_LIBS # polkit -> duktape
	depends on BR2_PACKAGE_CUPS
	select BR2_PACKAGE_POLKIT
	help
	  cups-pk-helper is a PolicyKit helper to configure cups with
	  fine-grained privileges.

	  https://wiki.freedesktop.org/www/Software/cups-pk-helper/

comment "cups-pk-helper support needs a toolchain with threads, wchar, dynamic library, gcc >= 7"
	depends on BR2_USE_MMU
	depends on !BR2_USE_WCHAR || !BR2_TOOLCHAIN_GCC_AT_LEAST_7 || \
		!BR2_TOOLCHAIN_HAS_THREADS || BR2_STATIC_LIBS
```

## package/cwiid/Config.in
```kconfig
config BR2_PACKAGE_CWIID
	bool "cwiid"
	depends on !BR2_STATIC_LIBS # bluez5_utils
	depends on BR2_USE_WCHAR # bluez5_utils -> libglib2
	depends on BR2_TOOLCHAIN_HAS_THREADS # bluez5_utils -> dbus, alsa-lib, libglib2
	depends on BR2_USE_MMU # bluez5_utils -> dbus, libglib2
	depends on BR2_TOOLCHAIN_HEADERS_AT_LEAST_3_18 # bluez5_utils hid plugin
	depends on BR2_TOOLCHAIN_HAS_SYNC_4 # bluez5_utils
	select BR2_PACKAGE_BLUEZ5_UTILS
	select BR2_PACKAGE_BLUEZ5_UTILS_PLUGINS_HID # runtime
	help
	  A collection of Linux tools written in C for interfacing to
	  the Nintendo Wiimote.

	  https://github.com/abstrakraft/cwiid

comment "cwiid needs a toolchain w/ dynamic lib, threads, wchar, headers >= 3.18"
	depends on BR2_TOOLCHAIN_HAS_SYNC_4
	depends on BR2_STATIC_LIBS || !BR2_USE_WCHAR || \
		!BR2_TOOLCHAIN_HAS_THREADS || \
		!BR2_TOOLCHAIN_HEADERS_AT_LEAST_3_18
	depends on BR2_USE_MMU
```

## package/cxxopts/Config.in
```kconfig
config BR2_PACKAGE_CXXOPTS
	bool "cxxopts"
	depends on BR2_INSTALL_LIBSTDCPP
	help
	  Lightweight C++ command line option parser

	  https://github.com/jarro2783/cxxopts

comment "cxxopts needs a toolchain w/ C++"
	depends on !BR2_INSTALL_LIBSTDCPP
```

## package/dante/Config.in
```kconfig
config BR2_PACKAGE_DANTE
	bool "dante"
	depends on BR2_USE_MMU # fork()
	select BR2_PACKAGE_LIBXCRYPT if BR2_TOOLCHAIN_USES_GLIBC
	help
	  Dante is a product developed by Inferno Nettverk A/S. It
	  consists of a SOCKS server and a SOCKS client, implementing
	  RFC 1928 and related standards. It is a flexible product
	  that can be used to provide convenient and secure network
	  connectivity.

	  http://www.inet.no/dante/
```

## package/daq3/Config.in
```kconfig
config BR2_PACKAGE_DAQ3
	bool "daq3"
	depends on !BR2_PACKAGE_DAQ
	depends on !BR2_STATIC_LIBS # dlfcn.h
	depends on BR2_TOOLCHAIN_GCC_AT_LEAST_4_9
	help
	  DAQ is a Data Acquisition library for packet I/O from the
	  Snort project.

	  https://www.snort.org

comment "daq3 needs a toolchain w/ dynamic library, gcc >= 4.9"
	depends on !BR2_PACKAGE_DAQ
	depends on BR2_STATIC_LIBS || !BR2_TOOLCHAIN_GCC_AT_LEAST_4_9
```

## package/dash/Config.in
```kconfig
config BR2_PACKAGE_DASH
	bool "dash"
	depends on BR2_USE_MMU # fork()
	depends on BR2_PACKAGE_BUSYBOX_SHOW_OTHERS
	depends on BR2_USE_WCHAR
	help
	  DASH is a POSIX-compliant implementation of /bin/sh that
	  aims to be as small as possible. It does this without
	  sacrificing speed where possible. In fact, it is
	  significantly faster than bash (the GNU Bourne-Again SHell)
	  for most tasks.

	  http://gondor.apana.org.au/~herbert/dash

comment "dash needs a toolchain w/ wchar"
	depends on BR2_USE_MMU
	depends on BR2_PACKAGE_BUSYBOX_SHOW_OTHERS
	depends on !BR2_USE_WCHAR
```

## package/davinci-bootcount/Config.in
```kconfig
config BR2_PACKAGE_DAVINCI_BOOTCOUNT
	bool "davinci-bootcount"
	depends on BR2_arm # only relevant for TI am335x
	help
	  U-Boot implements a boot count scheme that can be used to
	  detect multiple failed attempts to boot Linux. On Davinci
	  platform (TI AM 335x) the `bootcount' is stored in the RTC
	  SCRATCH2 register. This tool allows to read and write this
	  register from userspace.

	  https://github.com/VoltServer/uboot-davinci-bootcount
```

## package/dbus-broker/Config.in
```kconfig
config BR2_PACKAGE_DBUS_BROKER
	bool "dbus-broker"
	depends on BR2_USE_MMU
	depends on BR2_TOOLCHAIN_HAS_THREADS
	depends on BR2_TOOLCHAIN_HEADERS_AT_LEAST_4_17
	depends on BR2_PACKAGE_SYSTEMD
	select BR2_PACKAGE_EXPAT
	select BR2_PACKAGE_LIBCAP_NG if BR2_PACKAGE_AUDIT
	help
	  Linux D-Bus Message Broker.

	  The dbus-broker project is an implementation of a message bus
	  as defined by the D-Bus specification. Its aim is to provide
	  high performance and reliability, while keeping compatibility
	  to the D-Bus reference implementation.

	  It is exclusively written for Linux systems, and makes use of
	  many modern features provided by recent linux kernel releases.

	  https://github.com/bus1/dbus-broker/wiki

comment "dbusbroker needs systemd and a toolchain w/ threads"
	depends on BR2_USE_MMU
	depends on !BR2_TOOLCHAIN_HAS_THREADS || !BR2_PACKAGE_SYSTEMD
```

## package/dbus-cxx/Config.in
```kconfig
config BR2_PACKAGE_DBUS_CXX
	bool "dbus-cxx"
	depends on BR2_USE_MMU # dbus
	depends on BR2_INSTALL_LIBSTDCPP
	depends on BR2_TOOLCHAIN_GCC_AT_LEAST_7 # libsigc
	depends on BR2_TOOLCHAIN_HAS_THREADS
	depends on !BR2_STATIC_LIBS
	select BR2_PACKAGE_DBUS # runtime
	select BR2_PACKAGE_LIBSIGC
	help
	  DBus-cxx is a C++ implementation for DBus. DBus is a
	  Linux-specific RPC (remote procedure call) and
	  IPC (inter-process communications) mechanism.
	  DBus-cxx provides an object-oriented view of all programs
	  on the DBus, and allows an object-oriented way of
	  exporting methods onto the DBus.

	  https://dbus-cxx.github.io/

comment "dbus-cxx needs a toolchain w/ C++, threads, gcc >= 7 and dynamic library support"
	depends on BR2_USE_MMU # dbus
	depends on !BR2_INSTALL_LIBSTDCPP || BR2_STATIC_LIBS || \
		!BR2_TOOLCHAIN_HAS_THREADS || \
		!BR2_TOOLCHAIN_GCC_AT_LEAST_7
```

## package/ddcutil/Config.in
```kconfig
config BR2_PACKAGE_DDCUTIL
  bool "ddcutil"
	select BR2_PACKAGE_UTIL_LINUX
	select BR2_PACKAGE_UTIL_LINUX_LIBBLKID
  select BR2_PACKAGE_EUDEV
  select BR2_PACKAGE_JANSSON
  select BR2_PACKAGE_LIBGLIB2
  select BR2_PACKAGE_KMOD
  select BR2_PACKAGE_UTIL_LINUX_LIBS
  help
  This is the ddcutil library https://www.ddcutil.com/
```

## package/delve/Config.in.host
```kconfig
config BR2_PACKAGE_HOST_DELVE
	bool "host delve"
	depends on BR2_PACKAGE_HOST_GO_HOST_ARCH_SUPPORTS
	depends on BR2_PACKAGE_HOST_GO_HOST_CGO_LINKING_SUPPORTS
	select BR2_PACKAGE_HOST_GO
	help
	  Delve is a debugger for the Go programming language.

	  https://github.com/go-delve/delve
```

## package/depot-tools/Config.in.host
```kconfig
config BR2_PACKAGE_HOST_DEPOT_TOOLS
	bool "host depot-tools"
	select BR2_PACKAGE_HOST_PYTHON3
	select BR2_PACKAGE_HOST_PYTHON3_SSL
	select BR2_PACKAGE_HOST_PYTHON_SIX
	help
	  Chromium and Chromium OS use a package of scripts called
	  depot_tools to manage checkouts and code reviews.

	  https://www.chromium.org/developers/how-tos/install-depot-tools/
```

## package/dfu-programmer/Config.in
```kconfig
config BR2_PACKAGE_DFU_PROGRAMMER
	bool "dfu-programmer"
	depends on BR2_TOOLCHAIN_HAS_THREADS # libusb
	depends on BR2_TOOLCHAIN_GCC_AT_LEAST_4_9 # libusb
	select BR2_PACKAGE_LIBUSB
	help
	  Dfu-programmer is a multi-platform command-line programmer
	  for Atmel (8051, AVR, XMEGA & AVR32) chips with a USB
	  bootloader supporting ISP. Most Atmel devices having a USB
	  port come pre-programmed with the bootloader, and this is a
	  lightweight alternative to Atmel's own FLIP/BatchISP program.

	  http://dfu-programmer.github.io/

comment "dfu-programmer needs a toolchain w/ threads, gcc >= 4.9"
	depends on !BR2_TOOLCHAIN_HAS_THREADS || \
		!BR2_TOOLCHAIN_GCC_AT_LEAST_4_9
```

## package/dhcpcd/Config.in
```kconfig
comment "dhcpcd needs a toolchain w/ headers >= 3.1"
	depends on !BR2_TOOLCHAIN_HEADERS_AT_LEAST_3_1

config BR2_PACKAGE_DHCPCD
	bool "dhcpcd"
	depends on BR2_TOOLCHAIN_HEADERS_AT_LEAST_3_1 # sa_family_t in linux/socket.h
	help
	  An RFC2131 compliant DHCP client

	  http://roy.marples.name/projects/dhcpcd/

if BR2_PACKAGE_DHCPCD

config BR2_PACKAGE_DHCPCD_ENABLE_PRIVSEP
	bool
	default y
	depends on BR2_USE_MMU
	# Audit headers were only added in recent kernels for some arches
	depends on !(BR2_arceb || BR2_arcle) || \
		BR2_TOOLCHAIN_HEADERS_AT_LEAST_5_2
	depends on !(BR2_microblazeel || BR2_microblazebe) || \
		BR2_TOOLCHAIN_HEADERS_AT_LEAST_3_18
	depends on !BR2_nios2 || BR2_TOOLCHAIN_HEADERS_AT_LEAST_5_2
	depends on !BR2_or1k || BR2_TOOLCHAIN_HEADERS_AT_LEAST_3_7
	depends on !BR2_sh || BR2_TOOLCHAIN_HEADERS_AT_LEAST_3_7
	depends on !BR2_xtensa || BR2_TOOLCHAIN_HEADERS_AT_LEAST_5_0

endif
```

## package/dht/Config.in
```kconfig
config BR2_PACKAGE_DHT
	bool "dht"
	help
	  BitTorrent DHT library

	  https://www.irif.fr/~jch/software/bittorrent
```

## package/directfb-examples/Config.in
```kconfig
config BR2_PACKAGE_DIRECTFB_EXAMPLES
	bool "directfb examples"
	depends on BR2_PACKAGE_DIRECTFB
	help
	  The DirectFB-examples package contains a set of simple
	  DirectFB applications that can be used to test and demonstrate
	  various DirectFB features. As of 4 October 2015, DirectFB's
	  website http://www.directfb.org/ is down. See alternative site
	  listed below.

	  http://elinux.org/DirectFB
```

## package/distribution-registry/Config.in
```kconfig
config BR2_PACKAGE_DISTRIBUTION_REGISTRY
	bool "distribution-registry"
	depends on BR2_PACKAGE_HOST_GO_TARGET_ARCH_SUPPORTS
	depends on BR2_PACKAGE_HOST_GO_TARGET_CGO_LINKING_SUPPORTS
	help
	  The toolkit to pack, ship, store, and deliver container
	  content.

	  The goal of this project is to provide a simple, secure, and
	  scalable base for building a large scale registry solution or
	  running a simple private registry. It is a core library for
	  many registry operators including Docker Hub, GitHub Container
	  Registry, GitLab Container Registry and DigitalOcean Container
	  Registry, as well as the CNCF Harbor Project, and VMware
	  Harbor Registry.

	  https://github.com/distribution/distribution
```

## package/dlib/Config.in
```kconfig
config BR2_PACKAGE_DLIB
	bool "dlib"
	depends on BR2_INSTALL_LIBSTDCPP
	depends on BR2_TOOLCHAIN_HAS_THREADS
	depends on BR2_USE_WCHAR
	help
	  Dlib is a modern C++ toolkit containing machine learning
	  algorithms and tools for creating complex software in C++ to
	  solve real world problems.

	  https://dlib.net
	  https://github.com/davisking/dlib

comment "dlib needs a toolchain w/ C++, threads, wchar"
	depends on !BR2_INSTALL_LIBSTDCPP || \
		!BR2_TOOLCHAIN_HAS_THREADS || \
		!BR2_USE_WCHAR
```
