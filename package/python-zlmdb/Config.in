## package/qoriq-mc-utils/Config.in
```kconfig
config BR2_PACKAGE_QORIQ_MC_UTILS
	bool "qoriq-mc-utils"
	select BR2_PACKAGE_HOST_DTC
	help
	  The Management Complex (MC) is a key component of the
	  networking subsystem named DPAA2 (Data Path Acceleration
	  Architecture, second version) in some NXP Layerscape SoCs.

	  The MC firmware is configured through two distinct files
	  named DPL and DPC, which are customizable by the end user.
	  Example configuration files for NXP reference boards are
	  distributed through this package, and are frequently patched
	  to produce the configuration required in other scenarios.

	  https://github.com/nxp-qoriq/mc-utils
	  # sign in required
	  https://www.nxp.com/webapp/Download?colCode=DPAA2UM

if BR2_PACKAGE_QORIQ_MC_UTILS

config BR2_PACKAGE_QORIQ_MC_UTILS_DPC_CUSTOM_PATH
	string "Data Path Configuration (DPC) custom file paths"
	help
	  The DPC file contains the settings defining the behavior
	  of the MC firmware. Its structure follows the device
	  tree syntax and is compiled to a device tree blob.

	  This option defines a space-separated list of device
	  tree source (DTS) file names, specified without
	  the trailing .dts. It should be used when the NXP
	  qoriq-mc-utils repository does not contain an adequate
	  DPC for the platform, and is preferable to patching
	  the package.

config BR2_PACKAGE_QORIQ_MC_UTILS_DPC_INTREE
	string "Data Path Configuration (DPC) in-tree files"
	help
	  This option defines a space-separated list of device
	  tree source (DTS) files relative to the "config/"
	  folder of the qoriq-mc-utils repository, specified
	  without the trailing .dts. It should be used when NXP
	  provides an adequate DPC for the platform.

config BR2_PACKAGE_QORIQ_MC_UTILS_DPL_CUSTOM_PATH
	string "Data Path Layout (DPL) custom file paths"
	help
	  The DPL file contains a description of the initial
	  networking objects created by the MC firmware when it
	  boots. Its structure follows the device tree syntax
	  and is compiled to a device tree blob.

	  This option defines a space-separated list of device
	  tree source (DTS) files, specified without the
	  trailing .dts. It should be used when the NXP
	  qoriq-mc-utils repository does not contain an
	  adequate DPL for the platform, and is preferable to
	  patching the package.

config BR2_PACKAGE_QORIQ_MC_UTILS_DPL_INTREE
	string "Data Path Layout (DPL) in-tree files"
	help
	  This option defines a space-separated list of device
	  tree source (DTS) files relative to the "config/"
	  folder of the qoriq-mc-utils repository, specified
	  without the trailing .dts. It should be used when NXP
	  provides an adequate DPL for the platform.

config BR2_PACKAGE_QORIQ_MC_UTILS_TARGET_INSTALL_PATH
	string "Path on target to install DPL and DPC files"
	help
	  The DPL and DPC files can optionally be deployed to
	  the target at the path specified here. This is useful
	  if the mcinitcmd U-Boot environment variable is
	  configured to apply the DPL and DPC from the filesystem.

endif
```

## package/qoriq-rcw/Config.in.host
```kconfig
config BR2_PACKAGE_HOST_QORIQ_RCW
	bool "host qoriq-rcw"
	help
	  This package provides an reset configuration word(RCW)
	  compiler to build NXP QoriQ/LS PBL/RCW binary(s).

	  The package installs example configurations and scripts
	  for each devkit supported in the current release see
	  $(HOST_DIR)/share/rcw. Either a SDK or post scripts can
	  then use this toolset and examples.

	  https://github.com/nxp-qoriq/rcw

if BR2_PACKAGE_HOST_QORIQ_RCW

config BR2_PACKAGE_HOST_QORIQ_RCW_CUSTOM_PATH
	string "RCW Source file paths"
	help
	  Space-separated list of .rcw and .rcwi files, that will be
	  used to generate a RCW binary. The entire list of .rcwi files
	  used by the .rcw file must be specified. There must be a
	  single .rcw file in the list.

	  This is optional. If left empty, the rcw package will be
	  included for use in the SDK or with post scripts but no
	  RCW binary will not be generated.

config BR2_PACKAGE_HOST_QORIQ_RCW_INTREE
	string "In-tree RCW name"
	depends on !BR2_PACKAGE_HOST_QORIQ_RCW_CUSTOM_PATH
	help
	  This option is used to specify the RCW binary file for board.
	  which is composed as platform/serdes_value/rcw_file: platform
	  is the platform name, serdes_value is the setting of the
	  Serdes, and rcw_file is the file name of RCW. For example:
	  "ls1028ardb/R_SQPP_0x85bb/rcw_1300_sdboot.bin"

	  If this option is empty, no rcw file is used.

endif
```

## package/qoriq-restool/Config.in
```kconfig
config BR2_PACKAGE_QORIQ_RESTOOL
	bool "qoriq-restool"
	depends on BR2_aarch64 || BR2_aarch64_be
	help
	  The DPAA2 architecture in Layerscape SoCs consists of
	  networking resources that can be assembled into various
	  nuggets of functionality, called "objects" (DPMAC, DPNI,
	  DPDMUX, DPSW etc), by the Management Complex (MC) firmware.

	  The MC firmware reads a file called Data Path Layout (DPL)
	  which describes the set of networking objects it should
	  create statically, at boot time.

	  The restool program is able to talk to the Management
	  Complex at runtime and permits the dynamic reconfiguration
	  of networking objects, as well as saving the current
	  configuration into a new DPL file. Without the restool
	  program, the only possible networking configuration is
	  that specified in the boot-time DPL file.

	  https://github.com/nxp-qoriq/restool
```

## package/qpdf/Config.in
```kconfig
config BR2_PACKAGE_QPDF
	bool "qpdf"
	depends on BR2_INSTALL_LIBSTDCPP
	depends on BR2_TOOLCHAIN_GCC_AT_LEAST_5 # C++14
	depends on BR2_TOOLCHAIN_HAS_ATOMIC
	select BR2_PACKAGE_ZLIB
	select BR2_PACKAGE_JPEG
	select BR2_PACKAGE_LIBOPENSSL_ENABLE_RC4 if BR2_PACKAGE_LIBOPENSSL
	help
	  QPDF is a command-line program that does structural,
	  content- preserving transformations on PDF files. It could
	  have been called something like pdf-to-pdf. It also provides
	  many useful capabilities to developers of PDF-producing
	  software or for people who just want to look at the innards
	  of a PDF file to learn more about how they work.

	  http://qpdf.sourceforge.net/

comment "qpdf needs a toolchain w/ C++, gcc >= 5"
	depends on BR2_TOOLCHAIN_HAS_ATOMIC
	depends on !BR2_INSTALL_LIBSTDCPP || \
		!BR2_TOOLCHAIN_GCC_AT_LEAST_5
```

## package/qpid-proton/Config.in
```kconfig
config BR2_PACKAGE_QPID_PROTON
	bool "qpid-proton"
	depends on BR2_INSTALL_LIBSTDCPP
	depends on !BR2_STATIC_LIBS # build a shared library
	depends on BR2_TOOLCHAIN_HAS_THREADS
	select BR2_PACKAGE_UTIL_LINUX
	select BR2_PACKAGE_UTIL_LINUX_LIBUUID
	help
	  The AMQP messaging toolkit

	  Qpid Proton is a high-performance, lightweight messaging
	  library. It can be used in the widest range of messaging
	  applications, including brokers, client libraries, routers,
	  bridges, proxies, and more.

	  https://qpid.apache.org/proton/

comment "qpid-proton needs a toolchain w/ C++, dynamic library, threads"
	depends on !BR2_INSTALL_LIBSTDCPP || BR2_STATIC_LIBS || \
		!BR2_TOOLCHAIN_HAS_THREADS
```

## package/qt5/qt5doc/Config.in
```kconfig
config BR2_PACKAGE_QT5DOC
	bool "qt5doc (includes quick demos)"
	depends on BR2_PACKAGE_QT5_JSCORE_AVAILABLE # qt5declarative
	select BR2_PACKAGE_QT5BASE_EXAMPLES
	select BR2_PACKAGE_QT5DECLARATIVE
	select BR2_PACKAGE_QT5DECLARATIVE_QUICK
	help
	  Qt is a cross-platform application and UI framework for
	  developers using C++.

	  Qtdoc contains the main Qt Reference Documentation, which
	  includes overviews, Qt topics, and examples not specific to
	  any Qt module. The configuration files are located in
	  qtdoc/doc/config and the articles in qtdoc/doc/src. Note that
	  QDoc itself is located in qtbase.

	  https://doc.qt.io/qt-5/overviews.html
```

## package/qt5/qt5multimedia/Config.in
```kconfig
config BR2_PACKAGE_QT5MULTIMEDIA
	bool "qt5multimedia"
	select BR2_PACKAGE_QT5BASE_GUI
	select BR2_PACKAGE_QT5BASE_NETWORK
	select BR2_PACKAGE_QT5BASE_OPENGL_LIB if BR2_PACKAGE_QT5BASE_OPENGL
	select BR2_PACKAGE_GSTREAMER1
	select BR2_PACKAGE_GST1_PLUGINS_BASE
	help
	  Qt is a cross-platform application and UI framework for
	  developers using C++.

	  The Qt Multimedia module provides a rich feature set that
	  enables you to easily take advantage of a platform's
	  multimedia capabilities such as media playback and the use
	  of camera and radio devices.

	  http://doc.qt.io/qt-5/multimediaoverview.html
```

## package/qt5/qt5opcua/Config.in
```kconfig
config BR2_PACKAGE_QT5OPCUA
	bool "qt5opcua"
	depends on BR2_PACKAGE_QT5
	help
	  Qt is a cross-platform application and UI framework for
	  developers using C++.

	  The Qt OPC UA module implements a Qt API to interact with
	  OPC UA on top of a 3rd party OPC UA stack.
```

## package/qt5/qt5quickdesigner/Config.in
```kconfig
config BR2_PACKAGE_QT5QUICKDESIGNER
	bool "qt5quickdesigner"
	depends on BR2_PACKAGE_QT5_JSCORE_AVAILABLE # qt5declarative
	select BR2_PACKAGE_QT5DECLARATIVE
	select BR2_PACKAGE_QT5DECLARATIVE_QUICK
	help
	  The Qt Quick Studio Components module provides sets of 
	  components and effects enhanced for creating animated UIs

	  https://doc.qt.io/qtdesignstudio/qtquickdesigner-components-overview.html
```

## package/qt5/qt5speech/Config.in
```kconfig
config BR2_PACKAGE_QT5SPEECH
	bool "qt5speech"
	help
	  Qt is a cross-platform application and UI framework for
	  developers using C++.

	  Qt Speech enables support for accessibility features such as
	  text-to-speech.

	  For output optional enable flite or speechd.

	  https://doc.qt.io/qt-5/qtspeech-index.html
```

## package/qt5/qt5webengine-chromium-catapult/Config.in
```kconfig
# Not user-selectable, it is only needed to be copied
# into the chromium source tree.
config BR2_PACKAGE_QT5WEBENGINE_CHROMIUM_CATAPULT
	bool
```

## package/qt5/qt5webengine-chromium/Config.in
```kconfig
# Not user-selectable, it is only needed to be copied
# into the qt5webengine source tree.
config BR2_PACKAGE_QT5WEBENGINE_CHROMIUM
	bool
	select BR2_PACKAGE_QT5WEBENGINE_CHROMIUM_CATAPULT
```

## package/qt5/qt5webkit/Config.in
```kconfig
config BR2_PACKAGE_QT5WEBKIT
	bool "qt5webkit"
	depends on !BR2_STATIC_LIBS
	depends on BR2_PACKAGE_QT5_JSCORE_AVAILABLE
	depends on BR2_INSTALL_LIBSTDCPP # leveldb
	depends on BR2_HOST_GCC_AT_LEAST_4_9 # icu, host-ruby
	depends on BR2_TOOLCHAIN_GCC_AT_LEAST_4_9 # icu
	depends on BR2_TOOLCHAIN_HAS_THREADS # leveldb
	depends on !BR2_BINFMT_FLAT # icu
	# assumes a FPU is available on MIPS
	depends on !BR2_MIPS_SOFT_FLOAT
	select BR2_PACKAGE_GSTREAMER1
	select BR2_PACKAGE_GST1_PLUGINS_BASE
	select BR2_PACKAGE_ICU
	select BR2_PACKAGE_JPEG
	select BR2_PACKAGE_LEVELDB
	select BR2_PACKAGE_LIBPNG
	select BR2_PACKAGE_QT5BASE_ICU
	select BR2_PACKAGE_QT5BASE_GUI
	select BR2_PACKAGE_QT5LOCATION
	select BR2_PACKAGE_QT5SENSORS
	select BR2_PACKAGE_QT5WEBCHANNEL
	select BR2_PACKAGE_LIBXML2
	select BR2_PACKAGE_LIBXSLT
	select BR2_PACKAGE_SQLITE
	select BR2_PACKAGE_WEBP
	select BR2_PACKAGE_WEBP_DEMUX
	select BR2_PACKAGE_WOFF2
	select BR2_PACKAGE_XLIB_LIBXCOMPOSITE if BR2_PACKAGE_QT5BASE_XCB
	select BR2_PACKAGE_XLIB_LIBXEXT if BR2_PACKAGE_QT5BASE_XCB
	select BR2_PACKAGE_XLIB_LIBXRENDER if BR2_PACKAGE_QT5BASE_XCB
	help
	  Qt is a cross-platform application and UI framework for
	  developers using C++.

	  The Qt WebKit module provides the WebView API, which
	  allows QML applications to render regions of dynamic
	  web content.

	  This package has been removed from the official release
	  packages since Qt5.6.0, but it is still available for users
	  to build it from source. This is useful for platforms
	  without GPU since the successor (QtWebEngine) requires
	  OpenGL support.

	  https://doc.qt.io/archives/qt-5.5/qtwebkit-index.html

comment "qt5webkit needs a toolchain w/ dynamic library, gcc >= 4.9, host gcc >= 4.9"
	depends on BR2_STATIC_LIBS || !BR2_TOOLCHAIN_GCC_AT_LEAST_4_9 || \
		!BR2_HOST_GCC_AT_LEAST_4_9
	depends on BR2_PACKAGE_QT5_JSCORE_AVAILABLE
	depends on !BR2_BINFMT_FLAT
	depends on !BR2_MIPS_SOFT_FLOAT
```

## package/qt6/Config.in
```kconfig
# based on src/corelib/global/qprocessordetection.h
config BR2_PACKAGE_QT6_ARCH_SUPPORTS
	bool
	# no support for ARMv4
	default y if BR2_ARM_CPU_ARMV5 || BR2_ARM_CPU_ARMV6 || BR2_ARM_CPU_ARMV7A || BR2_ARM_CPU_ARMV8A
	default y if BR2_i386
	default y if BR2_x86_64
	default y if BR2_mips || BR2_mipsel || BR2_mips64 || BR2_mips64el
	default y if BR2_powerpc || BR2_powerpc64 || BR2_powerpc64le
	# sparc 32-bit is supposedly supported, but has issues due to
	# the need of libatomic
	default y if BR2_sparc64
	depends on BR2_USE_MMU

config BR2_PACKAGE_QT6_GL_SUPPORTS
	bool
	default y
	depends on BR2_PACKAGE_HAS_LIBGL || BR2_PACKAGE_HAS_LIBGLES

comment "qt6 needs a toolchain w/ C++, threads, wchar, dynamic library, gcc >= 8, host gcc >= 8"
	depends on !BR2_PACKAGE_QT5
	depends on BR2_PACKAGE_QT6_ARCH_SUPPORTS
	depends on !BR2_INSTALL_LIBSTDCPP || !BR2_TOOLCHAIN_GCC_AT_LEAST_8 || \
		!BR2_HOST_GCC_AT_LEAST_8 || !BR2_TOOLCHAIN_HAS_THREADS || \
		BR2_STATIC_LIBS || !BR2_USE_WCHAR

menuconfig BR2_PACKAGE_QT6
	bool "Qt6"
	depends on BR2_INSTALL_LIBSTDCPP
	depends on BR2_TOOLCHAIN_GCC_AT_LEAST_8
	depends on BR2_HOST_GCC_AT_LEAST_8
	depends on BR2_PACKAGE_QT6_ARCH_SUPPORTS
	depends on BR2_TOOLCHAIN_HAS_THREADS
	depends on !BR2_STATIC_LIBS
	depends on BR2_USE_WCHAR
	depends on !BR2_PACKAGE_QT5
	select BR2_PACKAGE_QT6BASE
	help
	  This option enables the Qt6 framework. Sub-options allow to
	  select which modules should be built.

	  http://qt.io

if BR2_PACKAGE_QT6

source "package/qt6/qt6base/Config.in"
source "package/qt6/qt6core5compat/Config.in"
source "package/qt6/qt6serialbus/Config.in"
source "package/qt6/qt6serialport/Config.in"
source "package/qt6/qt6svg/Config.in"

endif
```

## package/qt6/Config.in.host
```kconfig
if BR2_PACKAGE_QT6

source "package/qt6/qt6base/Config.in.host"
source "package/qt6/qt6tools/Config.in.host"

endif
```
