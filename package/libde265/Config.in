## package/libde265/Config.in
```kconfig
config BR2_PACKAGE_LIBDE265
	bool "libde265"
	depends on BR2_INSTALL_LIBSTDCPP
	depends on BR2_TOOLCHAIN_HAS_THREADS
	help
	  libde265 is an open source implementation of the h.265 video
	  codec.

	  https://github.com/strukturag/libde265

comment "libde265 needs a toolchain w/ threads, C++"
	depends on !BR2_TOOLCHAIN_HAS_THREADS || !BR2_INSTALL_LIBSTDCPP
```

## package/libdecor/Config.in
```kconfig
config BR2_PACKAGE_LIBDECOR
	bool "libdecor"
	depends on !BR2_STATIC_LIBS # wayland
	depends on BR2_USE_MMU # pango
	depends on BR2_USE_WCHAR # pango
	depends on BR2_TOOLCHAIN_HAS_SYNC_4 # pango
	depends on BR2_TOOLCHAIN_GCC_AT_LEAST_4_9 # pango
	depends on BR2_INSTALL_LIBSTDCPP # pango
	depends on BR2_TOOLCHAIN_HAS_THREADS # pango, wayland
	select BR2_PACKAGE_CAIRO
	select BR2_PACKAGE_PANGO
	select BR2_PACKAGE_WAYLAND
	select BR2_PACKAGE_WAYLAND_PROTOCOLS
	help
	  libdecor is a library that can help Wayland clients draw
	  window decorations for them. It aims to provide multiple
	  backends that implements the decoration drawing.

	  https://gitlab.freedesktop.org/libdecor/libdecor

comment "libdecor needs a toolchain w/ wchar, threads, C++, gcc >= 4.9"
	depends on BR2_USE_MMU
	depends on BR2_TOOLCHAIN_HAS_SYNC_4
	depends on !BR2_INSTALL_LIBSTDCPP || !BR2_TOOLCHAIN_HAS_THREADS || \
		!BR2_USE_WCHAR || !BR2_TOOLCHAIN_GCC_AT_LEAST_4_9
```

## package/libdex/Config.in
```kconfig
config BR2_PACKAGE_LIBDEX
	bool "libdex"
	depends on BR2_USE_MMU # libglib2
	depends on BR2_USE_WCHAR # libglib2, gettext
	depends on BR2_TOOLCHAIN_HAS_THREADS # libglib2
	depends on !BR2_STATIC_LIBS
	depends on BR2_TOOLCHAIN_HAS_UCONTEXT || \
		BR2_PACKAGE_LIBUCONTEXT_ARCH_SUPPORTS
	select BR2_PACKAGE_LIBGLIB2
	select BR2_PACKAGE_LIBUCONTEXT if \
		BR2_PACKAGE_LIBUCONTEXT_ARCH_SUPPORTS && !BR2_TOOLCHAIN_HAS_UCONTEXT
	help
	  Dex provides Future-based programming for GLib-based
	  applications. It both integrates with and brings new
	  features for application and library authors who want
	  to structure concurrent code in an easy to manage way.

	  https://gitlab.gnome.org/GNOME/libdex

comment "libdex needs a toolchain w/ wchar, threads, dynamic library, ucontext"
	depends on BR2_USE_MMU
	depends on !BR2_USE_WCHAR || !BR2_TOOLCHAIN_HAS_THREADS || \
		BR2_STATIC_LIBS || \
		!(BR2_TOOLCHAIN_HAS_UCONTEXT || \
			BR2_PACKAGE_LIBUCONTEXT_ARCH_SUPPORTS)
```

## package/libdill/Config.in
```kconfig
config BR2_PACKAGE_LIBDILL
	bool "libdill"
	help
	  Libdill is a C library that makes writing structured
	  concurrent programs easy.

	  http://libdill.org
```

## package/libdisplay-info/Config.in
```kconfig
config BR2_PACKAGE_LIBDISPLAY_INFO
	bool "libdisplay-info"
	select BR2_PACKAGE_HWDATA
	select BR2_PACKAGE_HWDATA_PNP_IDS
	help
	  EDID and DisplayID library.

	  https://gitlab.freedesktop.org/emersion/libdisplay-info
```

## package/libdnet/Config.in
```kconfig
config BR2_PACKAGE_LIBDNET
	bool "libdnet"
	help
	  libdnet - simplified interface to low-level networking
	  routines.

	  http://libdnet.sourceforge.net/
```

## package/libdrm-examples/Config.in
```kconfig
config BR2_PACKAGE_LIBDRM_EXAMPLES
    bool "libdrm-examples"
    depends on BR2_PACKAGE_MESA3D_GBM
    depends on BR2_PACKAGE_LIBDRM
    depends on BR2_PACKAGE_HAS_LIBEGL
    depends on BR2_PACKAGE_HAS_LIBGLES
    help
        Various (libdrm) test examples

config BR2_PACKAGE_LIBDRM_EXAMPLES_QUIRKS
    bool "quirks"
    depends on BR2_PACKAGE_LIBDRM_EXAMPLES
    default n

comment "libdrm-examples requires libdrm, Mesa's GBM , EGL and OpenGLES V2"
   depends on !BR2_PACKAGE_MESA3D_GBM || !BR2_PACKAGE_LIBDRM || !BR2_PACKAGE_HAS_LIBEGL || !BR2_PACKAGE_HAS_LIBGLES
```

## package/libebml/Config.in
```kconfig
config BR2_PACKAGE_LIBEBML
	bool "libebml"
	depends on BR2_INSTALL_LIBSTDCPP
	depends on BR2_USE_WCHAR
	depends on BR2_TOOLCHAIN_GCC_AT_LEAST_4_9 # C++14
	help
	  Access library for the EBML (Extensible Binary Meta
	  Language, a binary derivative of XML) format.

	  http://matroska.org

comment "libebml needs a toolchain w/ C++, wchar, gcc >= 4.9"
	depends on !BR2_INSTALL_LIBSTDCPP || !BR2_USE_WCHAR || \
		!BR2_TOOLCHAIN_GCC_AT_LEAST_4_9
```

## package/libecoli/Config.in
```kconfig
config BR2_PACKAGE_LIBECOLI
	bool "libecoli"
	depends on BR2_USE_MMU # libedit
	depends on BR2_USE_WCHAR # libedit
	depends on !BR2_STATIC_LIBS
	select BR2_PACKAGE_LIBEDIT
	help
	  libecoli stands for Extensible COmmand LIne library.

	  This library provides helpers to build interactive command
	  line interfaces.

	  https://github.com/rjarry/libecoli/

comment "libecoli needs a toolchain w/ dynamic library, wchar"
	depends on BR2_USE_MMU
	depends on BR2_STATIC_LIBS || !BR2_USE_WCHAR
```

## package/libenca/Config.in
```kconfig
config BR2_PACKAGE_LIBENCA
	bool "libenca"
	help
	  Extremely Naive Charset Analyser

	  https://github.com/Project-OSS-Revival/enca
```

## package/libesmtp/Config.in
```kconfig
config BR2_PACKAGE_LIBESMTP
	bool "libesmtp"
	depends on !BR2_STATIC_LIBS
	select BR2_PACKAGE_LIBOPENSSL_ENABLE_DES if BR2_PACKAGE_LIBOPENSSL
	select BR2_PACKAGE_LIBOPENSSL_ENABLE_MD4 if BR2_PACKAGE_LIBOPENSSL
	help
	  Library for sending emails through SMTP.

	  https://libesmtp.github.io

comment "libesmtp needs a toolchain w/ dynamic library"
	depends on BR2_STATIC_LIBS
```

## package/libest/Config.in
```kconfig
comment "libest needs a toolchain w/ dynamic library"
	depends on BR2_STATIC_LIBS

config BR2_PACKAGE_LIBEST
	bool "libest"
	depends on !BR2_STATIC_LIBS # libexecinfo or glibc
	select BR2_PACKAGE_LIBEXECINFO if !BR2_TOOLCHAIN_USES_GLIBC
	select BR2_PACKAGE_OPENSSL
	select BR2_PACKAGE_OPENSSL_FORCE_LIBOPENSSL
	help
	  libest is a C implementation of RFC 7030 (Enrollment over
	  Secure Transport).

	  It can be used to provision public key certificates from
	  a certificate authority (CA) or registration authority (RA)
	  to end-user devices and network infrastructure devices.

	  https://github.com/cisco/libest

if BR2_PACKAGE_LIBEST

config BR2_PACKAGE_LIBEST_BRSKI
	bool "BRSKI support"

config BR2_PACKAGE_LIBEST_MODE_CLIENT_ONLY
	bool "client-only mode"
	# The client-only mode fails to build with OpenJDK/JNI
	# bindings
	depends on !BR2_PACKAGE_OPENJDK

endif # BR2_PACKAGE_LIBEST
```

## package/libexecinfo/Config.in
```kconfig
config BR2_PACKAGE_LIBEXECINFO
	bool "libexecinfo"
	depends on !BR2_STATIC_LIBS # dlfcn.h
	depends on !BR2_TOOLCHAIN_USES_GLIBC
	help
	  Library for inspecting program's backtrace

	  https://github.com/mikroskeem/libexecinfo

comment "libexecinfo needs a musl or uclibc toolchain w/ dynamic library"
	depends on BR2_TOOLCHAIN_USES_GLIBC || BR2_STATIC_LIBS
```

## package/libfm/Config.in
```kconfig
config BR2_PACKAGE_LIBFM
	bool "libfm"
	depends on BR2_PACKAGE_HOST_RUSTC_ARCH_SUPPORTS # libgtk3
	depends on BR2_USE_WCHAR # libgtk3, libglib2
	depends on BR2_TOOLCHAIN_HAS_THREADS # libgtk3, libglib2
	depends on BR2_USE_MMU # libgtk3, libglib2
	depends on BR2_INSTALL_LIBSTDCPP # libgtk3
	depends on BR2_TOOLCHAIN_HAS_SYNC_4 # libgtk3
	depends on BR2_TOOLCHAIN_GCC_AT_LEAST_4_9 # libgtk3
	depends on BR2_PACKAGE_HAS_LIBEGL || BR2_PACKAGE_HAS_LIBGL # libgtk3
	depends on BR2_PACKAGE_XORG7 # libgtk3-x11
	depends on BR2_PACKAGE_HAS_LIBGL # libgtk3-x11
	select BR2_PACKAGE_CAIRO
	select BR2_PACKAGE_LIBGLIB2
	select BR2_PACKAGE_LIBGTK3
	select BR2_PACKAGE_LIBGTK3_X11
	select BR2_PACKAGE_MENU_CACHE
	help
	  A glib/gio-based library providing some file management
	  utilities and related-widgets missing in gtk+/glib. This is
	  the core of PCManFM.  The library is desktop independent
	  (not LXDE specific) and has clean API. It can be used to
	  develop other applications requiring file management
	  functionality. For example, you can create your own file
	  manager with facilities provided by libfm.

	  http://wiki.lxde.org/en/Libfm

comment "libfm a toolchain w/ wchar, threads, C++, gcc >= 4.9"
	depends on BR2_PACKAGE_HOST_RUSTC_ARCH_SUPPORTS
	depends on BR2_USE_MMU
	depends on BR2_TOOLCHAIN_HAS_SYNC_4
	depends on !BR2_USE_WCHAR || !BR2_TOOLCHAIN_HAS_THREADS || \
		!BR2_INSTALL_LIBSTDCPP || !BR2_TOOLCHAIN_GCC_AT_LEAST_4_9

comment "libfm needs X.org with an OpenGL backend"
	depends on BR2_PACKAGE_HOST_RUSTC_ARCH_SUPPORTS
	depends on BR2_USE_MMU
	depends on BR2_TOOLCHAIN_HAS_SYNC_4
	depends on !BR2_PACKAGE_XORG7 || BR2_PACKAGE_HAS_LIBGL
```

## package/libfprint/Config.in
```kconfig
config BR2_PACKAGE_LIBFPRINT
	bool "libfprint"
	select BR2_PACKAGE_LIBUSB
	select BR2_PACKAGE_LIBNSS
	select BR2_PACKAGE_GDK_PIXBUF
	help
	  Library for fingerprint readers

	  http://www.freedesktop.org/wiki/Software/fprint/libfprint
```

## package/libfutils/Config.in
```kconfig
config BR2_PACKAGE_LIBFUTILS
	bool "libfutils"
	depends on BR2_TOOLCHAIN_HAS_ATOMIC
	depends on BR2_INSTALL_LIBSTDCPP # ulog
	depends on BR2_TOOLCHAIN_HAS_THREADS # ulog
	select BR2_PACKAGE_ULOG
	help
	  This library contains some common useful functions (list,
	  hash, time)

	  https://github.com/Parrot-Developers/libfutils

comment "libfutils needs a toolchain w/ C++, threads"
	depends on !BR2_INSTALL_LIBSTDCPP || !BR2_TOOLCHAIN_HAS_THREADS
	depends on BR2_TOOLCHAIN_HAS_ATOMIC
```

## package/libgee/Config.in
```kconfig
config BR2_PACKAGE_LIBGEE
	bool "libgee"
	depends on BR2_USE_WCHAR
	depends on BR2_TOOLCHAIN_HAS_THREADS
	depends on BR2_USE_MMU # fork()
	depends on BR2_TOOLCHAIN_GCC_AT_LEAST_4_9
	select BR2_PACKAGE_LIBGLIB2
	help
	  Libgee is an utility library providing GObject-based
	  interfaces and classes for commonly used data structures.

	  https://wiki.gnome.org/Projects/Libgee

comment "libgee needs a toolchain w/ wchar, threads, gcc >= 4.9"
	depends on BR2_USE_MMU
	depends on !BR2_USE_WCHAR || !BR2_TOOLCHAIN_HAS_THREADS || \
		!BR2_TOOLCHAIN_GCC_AT_LEAST_4_9
```

## package/libgeos/Config.in
```kconfig
config BR2_PACKAGE_LIBGEOS
	bool "libgeos"
	depends on BR2_INSTALL_LIBSTDCPP
	depends on BR2_USE_WCHAR
	depends on BR2_TOOLCHAIN_HAS_THREADS
	depends on BR2_TOOLCHAIN_GCC_AT_LEAST_4_9 # C++14
	help
	  GEOS (Geometry Engine - Open Source) is a C++ port of the
	  JTS Topology Suite (JTS). It aims to contain the complete
	  functionality of JTS in C++. This includes all the OpenGIS
	  Simple Features for SQL spatial predicate functions and
	  spatial operators, as well as specific JTS enhanced functions.

	  https://trac.osgeo.org/geos

comment "libgeos needs a toolchain w/ C++, wchar, gcc >= 4.9, threads"
	depends on !BR2_INSTALL_LIBSTDCPP || !BR2_USE_WCHAR || \
		   !BR2_TOOLCHAIN_HAS_THREADS || \
		   !BR2_TOOLCHAIN_GCC_AT_LEAST_4_9
```

## package/libglade/Config.in
```kconfig
config BR2_PACKAGE_LIBGLADE
	bool "libglade"
	depends on BR2_PACKAGE_LIBGTK2
	depends on BR2_USE_WCHAR # glib2
	depends on BR2_TOOLCHAIN_HAS_THREADS # glib2
	depends on BR2_USE_MMU # glib2
	depends on !BR2_STATIC_LIBS # at-spi2-core
	select BR2_PACKAGE_LIBGLIB2
	select BR2_PACKAGE_AT_SPI2_CORE
	select BR2_PACKAGE_LIBXML2
	help
	  Libglade allows you to load glade interface files in a program
	  at runtime. It doesn't require GLADE to be used, but GLADE is
	  by far the easiest way to create the interface files.

	  https://download.gnome.org/sources/libglade/

comment "libglade needs a toolchain w/ wchar, threads, dynamic library"
	depends on BR2_USE_MMU
	depends on BR2_PACKAGE_LIBGTK2
	depends on !BR2_USE_WCHAR || !BR2_TOOLCHAIN_HAS_THREADS || BR2_STATIC_LIBS
```

## package/libglfw/Config.in
```kconfig
config BR2_PACKAGE_LIBGLFW
	bool "libglfw"
	depends on BR2_PACKAGE_XORG7 || BR2_PACKAGE_WAYLAND
	depends on BR2_PACKAGE_HAS_LIBGL || BR2_PACKAGE_HAS_LIBGLES
	select BR2_PACKAGE_LIBXKBCOMMON if BR2_PACKAGE_WAYLAND
	select BR2_PACKAGE_WAYLAND_PROTOCOLS if BR2_PACKAGE_WAYLAND
	select BR2_PACKAGE_XLIB_LIBXCURSOR if BR2_PACKAGE_XORG7
	select BR2_PACKAGE_XLIB_LIBXEXT if BR2_PACKAGE_XORG7
	select BR2_PACKAGE_XLIB_LIBXI if BR2_PACKAGE_XORG7
	select BR2_PACKAGE_XLIB_LIBXINERAMA if BR2_PACKAGE_XORG7
	select BR2_PACKAGE_XLIB_LIBXRANDR if BR2_PACKAGE_XORG7
	help
	  GLFW is an Open Source, multi-platform library for creating
	  windows with OpenGL contexts and receiving input and events.

	  http://www.glfw.org

comment "libglfw depends on X.org or Wayland and an OpenGL or GLES backend"
	depends on !(BR2_PACKAGE_XORG7 || BR2_PACKAGE_WAYLAND)
	depends on !(BR2_PACKAGE_HAS_LIBGL || BR2_PACKAGE_HAS_LIBGLES)
```

## package/libglib2/Config.in
```kconfig
config BR2_PACKAGE_LIBGLIB2
	bool "libglib2"
	depends on BR2_USE_WCHAR # gettext
	depends on BR2_TOOLCHAIN_HAS_THREADS
	depends on BR2_USE_MMU # fork()
	select BR2_PACKAGE_HOST_QEMU if BR2_PACKAGE_GOBJECT_INTROSPECTION
	select BR2_PACKAGE_HOST_QEMU_LINUX_USER_MODE if BR2_PACKAGE_GOBJECT_INTROSPECTION
	select BR2_PACKAGE_LIBICONV if !BR2_ENABLE_LOCALE
	select BR2_PACKAGE_LIBFFI
	select BR2_PACKAGE_PCRE2
	select BR2_PACKAGE_ZLIB
	help
	  Low-level core library that forms the basis of GTK+ and GNOME.

	  http://www.gtk.org/

comment "libglib2 needs a toolchain w/ wchar, threads"
	depends on BR2_USE_MMU
	depends on !BR2_USE_WCHAR || !BR2_TOOLCHAIN_HAS_THREADS

source "package/libglib2/libglib2-bootstrap/Config.in"
```

## package/libglib2/libglib2-bootstrap/Config.in
```kconfig
config BR2_PACKAGE_LIBGLIB2_BOOTSTRAP
	bool
	depends on BR2_USE_WCHAR # gettext
	depends on BR2_TOOLCHAIN_HAS_THREADS
	depends on BR2_USE_MMU # fork()
	select BR2_PACKAGE_LIBICONV if !BR2_ENABLE_LOCALE
	select BR2_PACKAGE_LIBFFI
	select BR2_PACKAGE_PCRE2
	select BR2_PACKAGE_ZLIB
```

## package/libglvnd/Config.in
```kconfig
config BR2_PACKAGE_LIBGLVND
	bool "libglvnd"
	depends on BR2_TOOLCHAIN_HAS_SYNC_4 # __sync_*_4 intrisics
	depends on !BR2_STATIC_LIBS # dlfcn.h
	depends on BR2_TOOLCHAIN_HAS_THREADS
	help
	  The GL Vendor-Neutral Dispatch library

	  libglvnd is a vendor-neutral dispatch layer for arbitrating
	  OpenGL API calls between multiple vendors. It allows multiple
	  drivers from different vendors to coexist on the same
	  filesystem, and determines which vendor to dispatch each API
	  call to at runtime.

	  Both GLX and EGL are supported, in any combination with OpenGL
	  and OpenGL ES.

if BR2_PACKAGE_LIBGLVND

# The following symbols should be selected by the libglvnd-aware
# GL/EGL/GLES providers.
config BR2_PACKAGE_LIBGLVND_DISPATCH_GL
	bool
	depends on BR2_PACKAGE_XORG7 # libx11, libXext, xorgproto
	select BR2_PACKAGE_XLIB_LIBX11
	select BR2_PACKAGE_XLIB_LIBXEXT
	select BR2_PACKAGE_XORGPROTO
	select BR2_PACKAGE_HAS_LIBGL

config BR2_PACKAGE_LIBGLVND_DISPATCH_EGL
	bool
	select BR2_PACKAGE_HAS_LIBEGL

config BR2_PACKAGE_LIBGLVND_DISPATCH_GLES
	bool
	select BR2_PACKAGE_HAS_LIBGLES

config BR2_PACKAGE_PROVIDES_LIBGL
	default "libglvnd" if BR2_PACKAGE_LIBGLVND_DISPATCH_GL

config BR2_PACKAGE_PROVIDES_LIBEGL
	default "libglvnd" if BR2_PACKAGE_LIBGLVND_DISPATCH_EGL

config BR2_PACKAGE_PROVIDES_LIBGLES
	default "libglvnd" if BR2_PACKAGE_LIBGLVND_DISPATCH_GLES

endif

comment "libglvnd needs a toolchain w/ dynamic library, threads"
	depends on BR2_TOOLCHAIN_HAS_SYNC_4
	depends on BR2_STATIC_LIBS || !BR2_TOOLCHAIN_HAS_THREADS
```

## package/libgphoto2/Config.in
```kconfig
config BR2_PACKAGE_LIBGPHOTO2
	bool "libgphoto2"
	default n
	select BR2_PACKAGE_LIBUSB
	select BR2_PACKAGE_GETTEXT
	select BR2_PACKAGE_LIBEXIF
	select BR2_PACKAGE_LIBTOOL
	select BR2_PACKAGE_LIBXML2
	depends on !BR2_COMPILER_PARANOID_UNSAFE_PATH
	help
	  libgphoto2 is a library that can be used by applications to access various digital cameras. 
	  
comment "libgphoto2 requires the paranoid check to be disabled. (Build options -> Advanced)"
	depends on BR2_COMPILER_PARANOID_UNSAFE_PATH 
```
