## package/lua-ansicolors/Config.in
```kconfig
config BR2_PACKAGE_LUA_ANSICOLORS
	bool "lua-ansicolors"
	help
	  Library for color Manipulation.

	  https://github.com/kikito/ansicolors.lua
```

## package/lua-argon2/Config.in
```kconfig
config BR2_PACKAGE_LUA_ARGON2
	bool "lua-argon2"
	depends on !BR2_STATIC_LIBS
	depends on BR2_USE_MMU # libargon2
	select BR2_PACKAGE_LIBARGON2
	help
	  Lua C binding for the Argon2 password hashing algorithm.

	  https://github.com/thibaultcha/lua-argon2

comment "lua-argon2 needs a toolchain w/ dynamic library"
	depends on BR2_USE_MMU
	depends on BR2_STATIC_LIBS
```

## package/lua-argparse/Config.in
```kconfig
config BR2_PACKAGE_LUA_ARGPARSE
	bool "lua-argparse"
	help
	  A feature-rich command-line argument parser.

	  https://github.com/luarocks/argparse
```

## package/lua-augeas/Config.in
```kconfig
config BR2_PACKAGE_LUA_AUGEAS
	bool "lua-augeas"
	depends on !BR2_arc # augeas
	depends on BR2_USE_WCHAR # augeas
	select BR2_PACKAGE_AUGEAS
	help
	  Lua binding for augeas library

	  https://github.com/ncopa/lua-augeas

comment "lua-augeas needs a toolchain w/ wchar"
	depends on !BR2_arc
	depends on !BR2_USE_WCHAR
```

## package/lua-cffi/Config.in
```kconfig
config BR2_PACKAGE_LUA_CFFI
	bool "lua-cffi"
	depends on !BR2_PACKAGE_LUAJIT
	depends on BR2_TOOLCHAIN_HAS_THREADS # libffi
	depends on BR2_TOOLCHAIN_GCC_AT_LEAST_4_8
	depends on BR2_INSTALL_LIBSTDCPP
	select BR2_PACKAGE_LIBFFI
	help
	  This is a portable C FFI for Lua, based on libffi and aiming
	  to be mostly compatible with LuaJIT FFI, but written from
	  scratch.

	  https://github.com/q66/cffi-lua

comment "lua-cffi needs a toolchain w/ C++, gcc >= 4.8, threads"
	depends on !BR2_PACKAGE_LUAJIT
	depends on !BR2_INSTALL_LIBSTDCPP || \
		!BR2_TOOLCHAIN_GCC_AT_LEAST_4_8 || \
		!BR2_TOOLCHAIN_HAS_THREADS
```

## package/lua-conciseserialization/Config.in
```kconfig
config BR2_PACKAGE_LUA_CONCISESERIALIZATION
	bool "lua-conciseserialization"
	help
	  a pure Lua implementation of CBOR / RFC8949.

	  https://fperrad.frama.io/lua-ConciseSerialization/
```

## package/lua-cqueues/Config.in
```kconfig
config BR2_PACKAGE_LUA_CQUEUES
	bool "lua-cqueues"
	depends on BR2_TOOLCHAIN_HAS_THREADS
	depends on !BR2_PACKAGE_LUA_5_4
	select BR2_PACKAGE_OPENSSL
	help
	  Continuation Queues: Embeddable asynchronous networking,
	  threading, and notification framework for Lua on Unix.

	  http://25thandclement.com/~william/projects/cqueues.html

comment "lua-cqueues needs a toolchain w/ threads, Lua <= 5.3"
	depends on !BR2_TOOLCHAIN_HAS_THREADS || BR2_PACKAGE_LUA_5_4
```

## package/lua-dkjson/Config.in
```kconfig
config BR2_PACKAGE_LUA_DKJSON
	bool "lua-dkjson"
	help
	  David Kolf's JSON module for Lua.

	  dkjson is written in Lua without any dependencies, but
	  when LPeg is available dkjson can use it to speed up decoding.

	  http://dkolf.de/dkjson-lua/
```

## package/lua-inotify/Config.in
```kconfig
config BR2_PACKAGE_LUA_INOTIFY
	bool "lua-inotify"
	help
	  Inotify bindings for Lua.

	  http://hoelz.ro/projects/linotify
```

## package/lua-lgdbm/Config.in
```kconfig
config BR2_PACKAGE_LUA_LGDBM
	bool "lua-lgdbm"
	depends on BR2_USE_MMU  # gdbm
	depends on BR2_USE_WCHAR  #gdbm
	depends on BR2_PACKAGE_LUA_5_3 || BR2_PACKAGE_LUA_5_4
	select BR2_PACKAGE_GDBM
	help
	  A database library for Lua using GDBM.

	  http://www.tecgraf.puc-rio.br/~lhf/ftp/lua/#lgdbm

comment "lua-lgdbm needs needs a toolchain with wchar, Lua >= 5.3"
	depends on !BR2_USE_MMU
	depends on !(BR2_PACKAGE_LUA_5_3 || BR2_PACKAGE_LUA_5_4) \
		|| !BR2_USE_WCHAR
```

## package/lua-lightningmdb/Config.in
```kconfig
config BR2_PACKAGE_LUA_LIGHTNINGMDB
	bool "lua-lightningmdb"
	depends on !BR2_PACKAGE_LUAJIT
	depends on BR2_TOOLCHAIN_HAS_THREADS # lmdb
	select BR2_PACKAGE_LMDB
	help
	  A thin wrapper around OpenLDAP Lightning Memory-Mapped
	  Database (LMDB).

	  https://github.com/shmul/lightningmdb

comment "lua-lightningmdb needs a toolchain w/ threads"
	depends on !BR2_TOOLCHAIN_HAS_THREADS
```

## package/lua-livr/Config.in
```kconfig
config BR2_PACKAGE_LUA_LIVR
	bool "lua-livr"
	select BR2_PACKAGE_LUA_COMPAT53 if BR2_PACKAGE_LUAINTERPRETER_ABI_VERSION_5_1 # runtime
	help
	  Lightweight validator supporting Language Independent
	  Validation Rules Specification (LIVR).

	  https://fperrad.frama.io/lua-LIVR
```

## package/lua-lrexlib-pcre2/Config.in
```kconfig
config BR2_PACKAGE_LUA_LREXLIB_PCRE2
	bool "lua-lrexlib-pcre2"
	select BR2_PACKAGE_PCRE2
	help
	  Regular expression library binding (PCRE2 flavour).

	  https://github.com/rrthomas/lrexlib
```

## package/lua-lsdbus/Config.in
```kconfig
config BR2_PACKAGE_LUA_LSDBUS
	bool "lua-lsdbus"
	depends on BR2_PACKAGE_SYSTEMD
	select BR2_PACKAGE_MXML
	select BR2_PACKAGE_LUA_COMPAT53 if BR2_PACKAGE_LUAINTERPRETER_ABI_VERSION_5_1
	help
	  Lua D-Bus bindings based on sd-bus and sd-event

	  https://github.com/kmarkus/lsdbus

comment "lua-lsdbus needs systemd"
	depends on !BR2_PACKAGE_SYSTEMD
```

## package/lua-lunix/Config.in
```kconfig
config BR2_PACKAGE_LUA_LUNIX
	bool "lua-lunix"
	help
	  lunix is a bindings library module to common Unix system APIs.

	  http://25thandclement.com/~william/projects/lunix.html
```

## package/lua-mqtt/Config.in
```kconfig
config BR2_PACKAGE_LUA_MQTT
	bool "lua-mqtt"
	depends on BR2_PACKAGE_LUA_5_3 || BR2_PACKAGE_LUA_5_4
	help
	  client library for MQTT 3.1.1 & 5.

	  https://fperrad.frama.io/lua-mqtt

comment "lua-mqtt needs a Lua >= 5.3"
	depends on !BR2_PACKAGE_LUA_5_3
	depends on !BR2_PACKAGE_LUA_5_4
```

## package/lua-ubjson/Config.in
```kconfig
config BR2_PACKAGE_LUA_UBJSON
	bool "lua-ubjson"
	select BR2_PACKAGE_LUA_COMPAT53 if BR2_PACKAGE_LUAINTERPRETER_ABI_VERSION_5_1 # runtime
	help
	  a pure Lua implementation of UBJSON.

	  https://fperrad.frama.io/lua-ubjson/
```

## package/lua-uuid/Config.in
```kconfig
config BR2_PACKAGE_LUA_UUID
	bool "lua-uuid"
	help
	  Generates uuids in pure Lua.

	  https://github.com/Tieske/uuid
```

## package/lua-zlib/Config.in
```kconfig
config BR2_PACKAGE_LUA_ZLIB
	bool "lua-zlib"
	select BR2_PACKAGE_ZLIB
	help
	  Simple streaming interface to zlib for Lua.
	  Consists of two functions: inflate and deflate.
	  Both functions return "stream functions" (takes a buffer
	  of input and returns a buffer of output).

	  https://github.com/brimworks/lua-zlib
```

## package/lualdap/Config.in
```kconfig
config BR2_PACKAGE_LUALDAP
	bool "lualdap"
	depends on !BR2_STATIC_LIBS
	depends on BR2_USE_WCHAR # openldap
	depends on BR2_USE_MMU # openldap
	select BR2_PACKAGE_OPENLDAP
	help
	  LuaLDAP is a simple interface from Lua to an LDAP client,
	  in fact it is a bind to OpenLDAP client.

	  https://lualdap.github.io/lualdap/

comment "lualdap needs a toolchain w/ wchar, dynamic library"
	depends on BR2_USE_MMU
	depends on !BR2_USE_WCHAR || BR2_STATIC_LIBS
```

## package/luv/Config.in
```kconfig
config BR2_PACKAGE_LUV
	bool "luv"
	depends on BR2_TOOLCHAIN_HAS_THREADS_NPTL # libuv
	depends on BR2_USE_MMU # libuv
	depends on !BR2_STATIC_LIBS # libuv
	depends on BR2_TOOLCHAIN_HAS_SYNC_4 # libuv
	depends on BR2_TOOLCHAIN_GCC_AT_LEAST_4_9 # libuv
	select BR2_PACKAGE_LIBUV
	help
	  libuv bindings for LuaJIT and Lua.

	  https://github.com/luvit/luv

comment "luv needs a toolchain w/ NPTL, dynamic library, gcc >= 4.9"
	depends on !BR2_TOOLCHAIN_HAS_THREADS_NPTL || BR2_STATIC_LIBS \
		|| !BR2_TOOLCHAIN_GCC_AT_LEAST_4_9
	depends on BR2_USE_MMU
	depends on BR2_TOOLCHAIN_HAS_SYNC_4
```

## package/lv2/Config.in
```kconfig
config BR2_PACKAGE_LV2
	bool "lv2"
	help
	  LV2 is a plugin standard for audio systems. It defines
	  a minimal yet extensible C API for plugin code and a
	  format for plugin "bundles".

	  https://lv2plug.in/
```

## package/lvgl/Config.in
```kconfig
config BR2_PACKAGE_LVGL
	bool "lvgl on linux framebuffer"
	depends on BR2_arm
	depends on BR2_INSTALL_LIBSTDCPP
	depends on BR2_TOOLCHAIN_HAS_THREADS
	depends on !BR2_STATIC_LIBS
	help
	  LVGL provides everything you need to create embedded GUI with easy-to-use graphical elements, beautiful visual effects and low memory footprint. 

	  LVGL configured to work with /dev/fb0 on Linux.

	  https://github.com/lvgl/lvgl/



comment "lvgl needs a toolchain w/ C++, threads, dynamic library"
	depends on BR2_arm
	depends on !BR2_INSTALL_LIBSTDCPP || !BR2_TOOLCHAIN_HAS_THREADS || \
		BR2_STATIC_LIBS
```

## package/lvgl_drm_demo/Config.in
```kconfig
config BR2_PACKAGE_LVGL_DRM_DEMO
	bool "lvgl on linux drm"
	depends on BR2_INSTALL_LIBSTDCPP
	depends on BR2_TOOLCHAIN_HAS_THREADS
	depends on !BR2_STATIC_LIBS
	select BR2_PACKAGE_LIBINPUT
	help
	  LVGL provides everything you need to create embedded GUI with easy-to-use graphical elements, beautiful visual effects and low memory footprint. 

	  LVGL configured to work with /dev/fb0 on Linux.

	  https://github.com/lvgl/lvgl/



comment "lvgl needs a toolchain w/ C++, threads, dynamic library"
	depends on BR2_arm
	depends on !BR2_INSTALL_LIBSTDCPP || !BR2_TOOLCHAIN_HAS_THREADS || \
		BR2_STATIC_LIBS
```

## package/lynis/Config.in
```kconfig
config BR2_PACKAGE_LYNIS
	bool "lynis"
	depends on BR2_USE_WCHAR # gzip
	select BR2_PACKAGE_BUSYBOX_SHOW_OTHERS
	select BR2_PACKAGE_GZIP  # runtime (zgrep /proc/config.gz)
	help
	  Lynis is an auditing tool which tests and gathers (security)
	  information from Unix based systems.
	  Written in shell and running on system itself.

	  https://cisofy.com/lynis/
```
