## package/bfscripts/Config.in
```kconfig
config BR2_PACKAGE_BFSCRIPTS
	bool "bfscripts"
	depends on BR2_USE_MMU # bash
	select BR2_PACKAGE_BUSYBOX_SHOW_OTHERS # bash
	select BR2_PACKAGE_BASH # runtime
	help
	  Collection of scripts that are used for Mellanox/NVIDIA
	  Bluefield SoC management.

	  Currently, it installs: bfcfg, bfrshlog and bfup.

	  https://github.com/Mellanox/bfscripts
```

## package/blake3/Config.in
```kconfig
config BR2_PACKAGE_BLAKE3
	bool "blake3"
	depends on BR2_INSTALL_LIBSTDCPP
	depends on BR2_TOOLCHAIN_GCC_AT_LEAST_8  # C++20
	help
	  BLAKE3 is a cryptographic hash function.

	  https://github.com/BLAKE3-team/BLAKE3
```

## package/bmap-tools/Config.in
```kconfig
# Historically, the package was named bmap-tools, and that's the name
# under which it was introduced in Buildroot. Since then, it has moved
# to a new home, and got renamed to bmaptool. To avoid useless churn,
# we keep the old symbols, and just refer to bmaptool in the prompt.
config BR2_PACKAGE_BMAP_TOOLS
	bool "bmaptool (formerly bmap-tools)"
	depends on BR2_PACKAGE_PYTHON3
	select BR2_PACKAGE_PYTHON3_PYEXPAT # runtime
	select BR2_PACKAGE_PYTHON_SETUPTOOLS # runtime, pkg_resources
	help
	  Tool to flash image files to block devices using the block map
	  bmaptool is a generic tool for creating the block map (bmap)
	  for a file, and copying files using the block map. The idea is
	  that large file containing unused blocks, like raw system
	  image files, can be copied or flashed a lot faster with
	  bmaptool than with traditional tools like "dd" or "cp".

	  Relevant optional dependencies:

	  - Busybox compiled with CONFIG_BZIP2, or BR2_PACKAGE_BZIP2,
	    to support bz2 compressed images

	  - BR2_PACKAGE_PIGZ for optimized gzip decompression

	  - Busybox compiled with CONFIG_LZOP, or BR2_PACKAGE_LZOP, to
	    support lzo compressed images.

	  - BR2_PACKAGE_ZIP to support zip compressed images

	  - BR2_PACKAGE_LZ4 to support lz4 compressed images

	  - BR2_PACKAGE_ZSTD to support zstd compressed images

	  - Busybox compiled CONFIG_FEATURE_SEAMLESS_* or
	    BR2_PACKAGE_TAR to support tar compressed images

	  - BR2_PACKAGE_OPENSSH to retrieve images over SSH.

	  - BR2_PACKAGE_SSHPASS to retrieve images over SSH if
	    password authentication is used.

	  Image signature verification is not supported as
	  python-gpgme is not available. Optimized bzip2 decompression
	  is not supported as pbzip2 is not available.

	  https://github.com/yoctoproject/bmaptool
```

## package/bmap-tools/Config.in.host
```kconfig
config BR2_PACKAGE_HOST_BMAP_TOOLS
	bool "host bmap-tools"
	select BR2_PACKAGE_HOST_PYTHON_SIX # runtime
	help
	  Tool to flash image files to block devices using the block map
	  bmaptool is a generic tool for creating the block map (bmap)
	  for a file, and copying files using the block map. The idea is
	  that large file containing unused blocks, like raw system
	  image files, can be copied or flashed a lot faster with
	  bmaptool than with traditional tools like "dd" or "cp".

	  https://github.com/intel/bmap-tools
```

## package/bmap-writer/Config.in
```kconfig
config BR2_PACKAGE_BMAP_WRITER
	bool "bmap-writer"
	depends on BR2_INSTALL_LIBSTDCPP
	depends on BR2_USE_WCHAR # libarchive
	select BR2_PACKAGE_LIBARCHIVE
	select BR2_PACKAGE_TINYXML2
	help
	  bmap-writer is a command-line utility designed to
	  efficiently write disk images to storage devices using block
	  mapping (BMAP). It serves as a lightweight alternative to
	  the Yocto BMAP tool, specifically for embedded
	  systems. Unlike the Yocto BMAP tool, bmap-writer is C++
	  based, does not require Python, and focuses solely on
	  writing an image.

	  https://github.com/embetrix/bmap-writer

comment "bmap-writer needs a toolchain w/ C++, wchar"
	depends on !BR2_USE_WCHAR || !BR2_INSTALL_LIBSTDCPP
```

## package/bmap-writer/Config.in.host
```kconfig
config BR2_PACKAGE_HOST_BMAP_WRITER
	bool "host bmap-writer"
	help
	  bmap-writer is a command-line utility designed to
	  efficiently write disk images to storage devices using block
	  mapping (BMAP). It serves as a lightweight alternative to
	  the Yocto BMAP tool, specifically for embedded
	  systems. Unlike the Yocto BMAP tool, bmap-writer is C++
	  based, does not require Python, and focuses solely on
	  writing an image.

	  https://github.com/embetrix/bmap-writer
```

## package/bmx7/Config.in
```kconfig
config BR2_PACKAGE_BMX7
	bool "bmx7"
	depends on !BR2_STATIC_LIBS # dlopen()
	select BR2_PACKAGE_ZLIB
	select BR2_PACKAGE_MBEDTLS
	select BR2_PACKAGE_WIRELESS_TOOLS
	select BR2_PACKAGE_WIRELESS_TOOLS_LIB
	help
	  BMX7 is a mesh routing protocol for Linux based
	  operating systems.

	  https://github.com/bmx-routing/bmx7

comment "bmx7 needs a toolchain with dynamic library support"
	depends on BR2_STATIC_LIBS
```

## package/bootgen/Config.in.host
```kconfig
config BR2_PACKAGE_HOST_BOOTGEN
	bool "host bootgen"
	depends on BR2_HOST_GCC_AT_LEAST_5 # C++14
	help
	  bootgen is a tool to generate a boot.bin firmware
	  for Xilinx versal, zynqmp and zynq product families.

	  Additional secure boot features are supported beyond
	  what is included with u-boot mkimage.

	  https://github.com/Xilinx/bootgen
```

## package/botan/Config.in
```kconfig
config BR2_PACKAGE_BOTAN_ARCH_SUPPORTS
	bool
	default y if BR2_aarch64 || BR2_aarch64_be
	default y if BR2_arm || BR2_armeb
	default y if BR2_i386 || BR2_x86_64
	default y if BR2_m68k
	default y if BR2_mips || BR2_mipsel || BR2_mips64 || BR2_mips64el
	default y if BR2_powerpc || BR2_powerpc64 || BR2_powerpc64le
	default y if BR2_riscv
	default y if BR2_sparc || BR2_sparc64
	default y if BR2_s390x
	default y if BR2_sh

config BR2_PACKAGE_BOTAN
	bool "botan"
	depends on BR2_INSTALL_LIBSTDCPP
	depends on BR2_TOOLCHAIN_GCC_AT_LEAST_10 # C++20
	depends on BR2_PACKAGE_BOTAN_ARCH_SUPPORTS
	select BR2_PACKAGE_BOOST_FILESYSTEM if BR2_PACKAGE_BOOST && BR2_TOOLCHAIN_SUPPORTS_ALWAYS_LOCKFREE_ATOMIC_INTS
	select BR2_PACKAGE_BOOST_SYSTEM if BR2_PACKAGE_BOOST && BR2_TOOLCHAIN_SUPPORTS_ALWAYS_LOCKFREE_ATOMIC_INTS
	help
	  Botan is a crypto library for C++

	  http://botan.randombit.net

comment "botan needs a toolchain w/ C++, gcc >= 10"
	depends on !BR2_INSTALL_LIBSTDCPP \
		|| !BR2_TOOLCHAIN_GCC_AT_LEAST_10
	depends on BR2_PACKAGE_BOTAN_ARCH_SUPPORTS
```

## package/bpftool/Config.in
```kconfig
config BR2_PACKAGE_BPFTOOL_ARCH_SUPPORTS
	bool
	# see libbpf/src/bpf.c
	default y if BR2_arc
	default y if BR2_aarch64 || BR2_aarch64_be
	default y if BR2_i386 || BR2_x86_64
	default y if BR2_sparc || BR2_sparc64
	default y if BR2_s390x

config BR2_PACKAGE_BPFTOOL
	bool "bpftool"
	depends on BR2_PACKAGE_BPFTOOL_ARCH_SUPPORTS
	depends on BR2_TOOLCHAIN_HAS_SYNC_4
	depends on !BR2_nios2 # binutils
	depends on BR2_USE_WCHAR # binutils, elfutils
	depends on !BR2_STATIC_LIBS # elfutils
	depends on BR2_TOOLCHAIN_HAS_THREADS # elfutils
	depends on BR2_TOOLCHAIN_USES_UCLIBC || BR2_TOOLCHAIN_USES_GLIBC # elfutils
	depends on BR2_TOOLCHAIN_HEADERS_AT_LEAST_4_12
	select BR2_PACKAGE_BINUTILS
	select BR2_PACKAGE_ELFUTILS
	help
	  bpftool is a tool for for inspection and simple manipulation
	  of eBPF programs and maps.

comment "bpftool needs a uClibc or glibc toolchain w/ wchar, dynamic library, threads, headers >= 4.12"
	depends on BR2_PACKAGE_BPFTOOL_ARCH_SUPPORTS
	depends on BR2_TOOLCHAIN_HAS_SYNC_4
	depends on !BR2_nios2
	depends on !BR2_USE_WCHAR || BR2_STATIC_LIBS \
		|| !BR2_TOOLCHAIN_HAS_THREADS \
		|| !(BR2_TOOLCHAIN_USES_UCLIBC || BR2_TOOLCHAIN_USES_GLIBC) \
		|| !BR2_TOOLCHAIN_HEADERS_AT_LEAST_4_12
```

## package/bpftrace/Config.in
```kconfig
config BR2_PACKAGE_BPFTRACE_ARCH_SUPPORTS
	bool
	default y if BR2_aarch64 || BR2_aarch64_be
	default y if BR2_x86_64
	depends on BR2_PACKAGE_LLVM_ARCH_SUPPORTS

config BR2_PACKAGE_BPFTRACE
	bool "bpftrace"
	depends on BR2_PACKAGE_BPFTRACE_ARCH_SUPPORTS
	depends on BR2_USE_MMU # bcc -> python3
	depends on BR2_TOOLCHAIN_HAS_SYNC_4 # libbpf
	depends on BR2_PACKAGE_LLVM_ARCH_SUPPORTS # bcc
	depends on BR2_TOOLCHAIN_USES_GLIBC # bcc
	depends on BR2_TOOLCHAIN_GCC_AT_LEAST_7 # bcc -> clang
	depends on BR2_INSTALL_LIBSTDCPP # bcc -> clang
	depends on BR2_HOST_GCC_AT_LEAST_7 # bcc -> clang
	depends on BR2_TOOLCHAIN_HEADERS_AT_LEAST_4_13 # libbpf
	depends on BR2_USE_WCHAR # bcc -> clang, bcc -> python3, libbpf
	depends on BR2_TOOLCHAIN_HAS_THREADS # bcc -> clang, bcc -> python3, libbpf
	depends on !BR2_STATIC_LIBS # bcc -> clang, bcc -> python3, libbpf
	select BR2_PACKAGE_BCC
	select BR2_PACKAGE_BZIP2
	select BR2_PACKAGE_CEREAL
	select BR2_PACKAGE_ELFUTILS
	select BR2_PACKAGE_LIBBPF
	select BR2_PACKAGE_LLVM
	# LLVM RTTI mendatory: https://github.com/iovisor/bpftrace/issues/1156
	select BR2_PACKAGE_LLVM_RTTI
	select BR2_PACKAGE_XZ
	help
	  bpftrace is a high-level tracing language for Linux enhanced
	  Berkeley Packet Filter (eBPF) available in recent Linux
	  kernels (4.x).

	  bpftrace uses LLVM as a backend to compile scripts to
	  BPF-bytecode and makes use of BCC for interacting with the
	  Linux BPF system, as well as existing Linux tracing
	  capabilities: kernel dynamic tracing (kprobes), user-level
	  dynamic tracing (uprobes), and tracepoints. The bpftrace
	  language is inspired by awk and C, and predecessor tracers
	  such as DTrace and SystemTap.

	  It's highly recommended to NOT strip bpftrace binary.
	  To do so, add "bpftrace" to BR2_STRIP_EXCLUDE_FILES.
	  See:
	    https://bugzilla.redhat.com/show_bug.cgi?id=1865787

	  https://www.github.com/iovisor/bpftrace

comment "bpftrace needs a glibc toolchain w/ C++, gcc >= 7, host gcc >= 7, kernel headers >= 4.13"
	depends on BR2_PACKAGE_BPFTRACE_ARCH_SUPPORTS
	depends on BR2_USE_MMU
	depends on BR2_TOOLCHAIN_HAS_SYNC_4
	depends on !BR2_TOOLCHAIN_USES_GLIBC || !BR2_INSTALL_LIBSTDCPP \
		|| !BR2_TOOLCHAIN_GCC_AT_LEAST_7 || !BR2_HOST_GCC_AT_LEAST_7 \
		|| !BR2_TOOLCHAIN_HEADERS_AT_LEAST_4_13
```

## package/brcmfmac_sdio-firmware-rpi/Config.in
```kconfig
config BR2_PACKAGE_BRCMFMAC_SDIO_FIRMWARE_RPI
	bool "brcmfmac-sdio-firmware-rpi"
	depends on BR2_arm || BR2_aarch64
	help
	  Raspberry Broadcom Bluetooth and Wifi firmware.

	  https://github.com/LibreELEC/brcmfmac_sdio-firmware-rpi

if BR2_PACKAGE_BRCMFMAC_SDIO_FIRMWARE_RPI

config BR2_PACKAGE_BRCMFMAC_SDIO_FIRMWARE_RPI_BT
	bool "brcmfmac-sdio-firmware-rpi-bt"
	help
	  Raspberry Pi 3 and Zero W Broadcom BCM43438 Bluetooth module
	  firmware. Raspberry Pi 3 Model B+ Broadcom BCM4345C0
	  Bluetooth module firmware.

config BR2_PACKAGE_BRCMFMAC_SDIO_FIRMWARE_RPI_WIFI
	bool "brcmfmac-sdio-firmware-rpi-wifi"
	depends on !BR2_PACKAGE_LINUX_FIRMWARE_BRCM_BCM43XXX
	help
	  Raspberry Pi 3 and Zero W Broadcom BCM43430 wifi module
	  NVRAM data. Raspberry Pi 3 Model B+ Broadcom BCM43455
	  wifi module NVRAM data.

comment "brcmfmac-sdio-firmware-rpi-wifi conflicts with linux-firmware Broadcom BRCM bcm43xx"
	depends on BR2_PACKAGE_LINUX_FIRMWARE_BRCM_BCM43XXX

endif
```

## package/breakpad/Config.in
```kconfig
config BR2_PACKAGE_BREAKPAD
	bool "breakpad"
	select BR2_PACKAGE_GYP
	select BR2_PACKAGE_GTEST
	select BR2_PACKAGE_PROTOBUF
	select BR2_PACKAGE_LSS
	help
	  Breakpad is a library and tool suite that allows you to distribute
	  an application to users with compiler-provided debuuging information
	  removed, record crashes in compact \"minidump\" files, send them back
	  to your server, and produce C and C++ stack traces from these minidumps.
	  https://bugs.chromium.org/p/google-breakpad
```

## package/bridge-utils/Config.in
```kconfig
config BR2_PACKAGE_BRIDGE_UTILS
	bool "bridge-utils"
	help
	  Manage ethernet bridging; a way to connect networks together
	  to form a larger network.

	  https://git.kernel.org/cgit/linux/kernel/git/shemminger/bridge-utils.git/

if BR2_PACKAGE_BRIDGE_UTILS

config BR2_PACKAGE_BRIDGE_UTILS_HELPER_SCRIPTS
	bool "Debian's helper scripts for package/ifupdown-scripts"
	default n
	help
	  Installs scripts in /lib/bridge-utils and symlinks in
	  /etc/network/{if-post-down.d,if-pre-up.d}

endif
```

## package/bridge/Config.in
```kconfig
# Bridge Tools/Generators
source "package/bridge/bridge-tools/Config.in"

# Bridge framework
source "package/bridge/bridge/Config.in"

# Bridge Contracts
source "package/bridge/bridge-contracts/Config.in"
```

## package/bridge/bridge-clients/Config.in
```kconfig
config BR2_PACKAGE_BRIDGE_CLIENTS
        bool 

config BR2_PACKAGE_BRIDGE_VIRTUALINPUT
        bool "VirtualInput"
        select BR2_PACKAGE_BRIDGE_CLIENTS
        help
          If the dynamic uinput system can not be used for security reasons, this
          allows for relaying keys to plugins

 config BR2_PACKAGE_BRIDGE_COMPOSITORCLIENT
        bool "CompositorClient"
        select BR2_PACKAGE_BRIDGE_CLIENTS
        help
          This is the Compositor Backend abastrcation layer, client part.

config BR2_PACKAGE_BRIDGE_PROVISIONPROXY
        bool "ProvisionProxy"
        select BR2_PACKAGE_LIBPROVISION
        select BR2_PACKAGE_BRIDGE_CLIENTS
        help
          Allows provisioning of modules from the cloud.

config BR2_PACKAGE_BRIDGE_OPENCDM
        bool "OpenCDM"
        select BR2_PACKAGE_BRIDGE_CLIENTS
        help
          Creates a ocdm compatible library to be used as a plugin to the OpenCDMServer in the bridge.
```

## package/bridge/bridge-contracts/Config.in
```kconfig
config BR2_PACKAGE_BRIDGE_CONTRACTS
	bool "bridge-contracts"
	help
	  Contract that are used by the plugins
```
