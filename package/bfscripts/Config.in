## package/bridge/bridge-devtools/Config.in
```kconfig
menu "development tools"

choice
        prompt "build type"
        default BR2_PACKAGE_BRIDGE_DEBUG
        help
          Select the type of build used for the bridge components build.

        config BR2_PACKAGE_BRIDGE_DEBUG
                bool "debug"

        config BR2_PACKAGE_BRIDGE_RELEASE
                bool "release"

        config BR2_PACKAGE_BRIDGE_PRODUCTION
                bool "production"

endchoice

config BR2_PACKAGE_BRIDGE_DISABLE_INITD
	bool "Disable init.d"
	help
		If enabled the init.d script will NOT be installed.

config BR2_PACKAGE_BRIDGE_WARNING_REPORTING
    bool "DefensiveWarnings"
    default n
    help
      Add a defensive warning system to the Thunder. It increases the footprint
      of the Thunder application but it allows for profiling and early warning
      on misbahving plugins. This feature should be used at least once before
      creating a production build to get a feeling on the behaviour of new
      plugins. They should not raise any warnings here !!!

config BR2_PACKAGE_BRIDGE_EXCEPTION_CATCHING
    bool "ExceptionCatching"
    default n
    help
      Some plugins are developed with Exception handling turned on. If an exception
      is not caught in the plugin it ends up in the framework. This feature tries
      to recover from these uncaught execptions. If it happens on a workerpool thread
      the framework will catch it, report it and continue. If the exception is thrown
      from a thread not under control of the framework it reports and shutsdown the
      framework. There is no possibility to recover from it.
		
menu "test applications"

config BR2_PACKAGE_BRIDGE_TEST_CYCLICINSPECTOR
	bool "CyclicBuffer inspector"
	help
		CyclicInspector is a small tool that allows you to inspect the
		contents of the memory mapped file used by the CyclicBuffer.
		This can be helpful during a post-mortem of a crashed program or
		when tracing failed.


config BR2_PACKAGE_BRIDGE_TEST_LOADER
	bool "Test loader"
	help
		TestLoader is a verification and analyze tool for 
		WPEFramework software and plugins.

config BR2_PACKAGE_BRIDGE_TEST_RPCLINK
	bool "RPC link test"
	help
		RPCLINK test tests the usage of RPC calls to out of process plugins.

config BR2_PACKAGE_TEST_LINUXONEWIRE
	bool "OneWire"
	help
		Test the netlink implementation for the OneWire Bus, implemented in the base framework.

config BR2_PACKAGE_TEST_LINUXI2C
	bool "I2C"
	help
		Test the I2C C++ wrapper for the I2C Bus, implemented in the base framework.

config BR2_PACKAGE_TEST_LINUXSPI
	bool "SPI"
	help
		Test the SPI C++ wrapper for the SPI Bus, implemented in the base framework.

config BR2_PACKAGE_TEST_RASPIO
	bool "GPIO"
	help
		Test the GPIO C++ wrapper for the IO pins, implemented in the base framework.


endmenu

endmenu
```

## package/bridge/bridge-tools/Config.in
```kconfig
config BR2_PACKAGE_BRIDGE_TOOLS
	bool "bridge-tools"
	help
	  Tooling required by the bridge (Code generators)
```

## package/bridge/bridge-ui/Config.in
```kconfig
config BR2_PACKAGE_BRIDGE_UI
	bool "UI"
	default y

	help
	   Bridge User Interface for development and testing
```

## package/bridge/bridge/Config.in
```kconfig
config BR2_PACKAGE_BRIDGE
	bool "bridge"
	help
	  Framework to build the functionality to realize a plugin structure for 
          rapid and easy development of REST-full API modules that realize simple
          interconnection between JavScript world and the Embedded platform.

if BR2_PACKAGE_BRIDGE

source "package/bridge/bridge-ui/Config.in"

config 	BR2_PACKAGE_BRIDGE_DEVICES
	bool "devices"
	select BR2_PACKAGE_LIBUSB
	help 
          Devices contains several hardware abstractions for IC found out there.

config BR2_PACKAGE_BRIDGE_ZWAVE
	bool "zwave"
	help 
          Implementation of the ZWave protocol over a SerialAPI

config BR2_PACKAGE_BRIDGE_ZIGBEE
	bool "zigbee"
	help 
          Implementation of the ZigBee(RC,LL,HA) protocol over a SerialAPI
	
menu "Options"

config BR2_PACKAGE_BRIDGE_PORT
	string "port"
	default "80"

config BR2_PACKAGE_BRIDGE_BIND
	string "bind"
	default "0.0.0.0"

config BR2_PACKAGE_BRIDGE_INTERFACE
	string "interface"
	default ""

config BR2_PACKAGE_BRIDGE_IDLE_TIME
	string "idle-time"
	default "180"

config BR2_PACKAGE_BRIDGE_PERSISTENT_PATH
	string "persistent path"
	default "/root"

config BR2_PACKAGE_BRIDGE_DATA_PATH
	string "data path"
	default "/usr/share/bridge"

config BR2_PACKAGE_BRIDGE_SYSTEM_PATH
	string "system path"
	default "/usr/lib/bridge/plugins"

config BR2_PACKAGE_BRIDGE_PROXYSTUB_PATH
	string "proxystub path"
	default "/usr/lib/bridge/proxystubs"

config BR2_PACKAGE_BRIDGE_OOM_ADJUST
	string "oom-adjust"
	default ""

source "package/bridge/bridge-devtools/Config.in"

endmenu

menu "Extensions"

source "package/bridge/bridge-clients/Config.in"

endmenu

menu "Plugins"
source "package/bridge/plugin-common/Config.in"
source "package/bridge/plugin-domotica/Config.in"
source "package/bridge/plugin-netflix/Config.in"
source "package/bridge/plugin-provisioning/Config.in"
source "package/bridge/plugin-switchboard/Config.in"
source "package/bridge/plugin-spotify/Config.in"
endmenu

endif
```

## package/bridge/plugin-cdmi/Config.in
```kconfig
source "package/bridge/plugin-cdmi/cdmi-clearkey/Config.in"
source "package/bridge/plugin-cdmi/cdmi-playready/Config.in"
source "package/bridge/plugin-cdmi/cdmi-playready-nexus/Config.in"
source "package/bridge/plugin-cdmi/cdmi-widevine/Config.in"
source "package/bridge/plugin-cdmi/cdmi-nagra/Config.in"
```

## package/bridge/plugin-cdmi/cdmi-clearkey/Config.in
```kconfig
config BR2_PACKAGE_CDMI_CLEARKEY
	bool "clearkey"
	depends on BR2_PACKAGE_PLUGIN_OPENCDMSERVER
	help
	  Clearkey DRM OpenCDM(i) comaptible plugin
```

## package/bridge/plugin-cdmi/cdmi-nagra/Config.in
```kconfig
config BR2_PACKAGE_CDMI_NAGRA
	bool "nagra"
	depends on BR2_PACKAGE_PLUGIN_OPENCDMSERVER
	help
	  Nagra DRM OpenCDM(i) compatible plugin
```

## package/bridge/plugin-cdmi/cdmi-playready-nexus/Config.in
```kconfig
config BR2_PLUGIN_CDMI_PLAYREADY_NEXUS
	bool "playready-nexus"
	depends on BR2_PACKAGE_PLUGIN_OPENCDMSERVER
	depends on BR2_PACKAGE_BCM_REFSW
	help
	  PlayReady (nexus) DRM OpenCDM(i) compatible plugin
```
