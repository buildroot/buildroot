## package/python-httpcore/Config.in
```kconfig
config BR2_PACKAGE_PYTHON_HTTPCORE
	bool "python-httpcore"
	select BR2_PACKAGE_PYTHON_CERTIFI # runtime
	select BR2_PACKAGE_PYTHON_H11 # runtime
	help
	  A minimal low-level HTTP client.

	  https://www.encode.io/httpcore/
```

## package/python-httplib2/Config.in
```kconfig
config BR2_PACKAGE_PYTHON_HTTPLIB2
	bool "python-httplib2"
	select BR2_PACKAGE_PYTHON_PYPARSING # runtime
	select BR2_PACKAGE_PYTHON3_ZLIB
	select BR2_PACKAGE_PYTHON3_SSL
	help
	  httplib2 is a comprehensive HTTP client library, httplib2.py
	  supports many features left out of other HTTP libraries.

	  https://pypi.python.org/pypi/httplib2
```

## package/python-httpx/Config.in
```kconfig
config BR2_PACKAGE_PYTHON_HTTPX
	bool "python-httpx"
	select BR2_PACKAGE_PYTHON_ANYIO # runtime
	select BR2_PACKAGE_PYTHON_CERTIFI # runtime
	select BR2_PACKAGE_PYTHON_HTTPCORE # runtime
	select BR2_PACKAGE_PYTHON_IDNA # runtime
	select BR2_PACKAGE_PYTHON_SNIFFIO # runtime
	help
	  The next generation HTTP client.

	  https://github.com/encode/httpx
```

## package/python-humanfriendly/Config.in
```kconfig
config BR2_PACKAGE_PYTHON_HUMANFRIENDLY
	bool "python-humanfriendly"
	depends on BR2_PACKAGE_PYTHON3
	help
	  Human friendly input/output for text interfaces using Python.

	  https://github.com/xolox/python-humanfriendly/
```

## package/python-humanize/Config.in
```kconfig
config BR2_PACKAGE_PYTHON_HUMANIZE
	bool "python-humanize"
	depends on BR2_PACKAGE_PYTHON3
	help
	  Python humanize package contains various common humanization
	  utilities, like turning a number into a fuzzy human readable
	  duration ('3 minutes ago') or into a human readable size or
	  throughput.

	  http://github.com/jmoiron/humanize
```

## package/python-hwdata/Config.in
```kconfig
config BR2_PACKAGE_PYTHON_HWDATA
	bool "python-hwdata"
	select BR2_PACKAGE_HWDATA # runtime
	select BR2_PACKAGE_HWDATA_PCI_IDS
	select BR2_PACKAGE_HWDATA_PNP_IDS
	select BR2_PACKAGE_HWDATA_USB_IDS
	help
	  Provides python interface to database stored in hwdata
	  package. It allows you to get human readable description of
	  USB and PCI devices.

	  https://github.com/xsuchy/python-hwdata
```

## package/python-hyperframe/Config.in
```kconfig
config BR2_PACKAGE_PYTHON_HYPERFRAME
	bool "python-hyperframe"
	help
	  HTTP/2 framing layer for Python.

	  https://github.com/python-hyper/hyperframe/
```

## package/python-hyperlink/Config.in
```kconfig
config BR2_PACKAGE_PYTHON_HYPERLINK
	bool "python-hyperlink"
	depends on BR2_PACKAGE_PYTHON3 # python-idna
	select BR2_PACKAGE_PYTHON_IDNA # runtime
	help
	  A featureful, correct URL for Python.

	  https://github.com/python-hyper/hyperlink
```

## package/python-immutabledict/Config.in
```kconfig
config BR2_PACKAGE_PYTHON_IMMUTABLEDICT
	bool "python-immutabledict"
	help
	  Immutable wrapper around dictionaries (a fork of
	  frozendict).

	  https://github.com/corenting/immutabledict
```

## package/python-inflect/Config.in
```kconfig
config BR2_PACKAGE_PYTHON_INFLECT
	bool "python-inflect"
	select BR2_PACKAGE_PYTHON_MORE_ITERTOOLS # runtime
	select BR2_PACKAGE_PYTHON_TYPEGUARD # runtime
	help
	  Correctly generate plurals, singular nouns, ordinals,
	  indefinite articles; convert numbers to words.

	  https://github.com/jaraco/inflect
```

## package/python-inflection/Config.in
```kconfig
config BR2_PACKAGE_PYTHON_INFLECTION
	bool "python-inflection"
	depends on BR2_PACKAGE_PYTHON3
	select BR2_PACKAGE_PYTHON3_UNICODEDATA
	help
	  A string transformation library that singularizes and
	  pluralizes English words, and transforms strings from
	  CamelCase to underscored string.

	  Inflection is a port of Ruby on Rails' inflector to Python

	  https://github.com/jpvanhal/inflection
```

## package/python-influxdb/Config.in
```kconfig
config BR2_PACKAGE_PYTHON_INFLUXDB
	bool "python-influxdb"
	depends on BR2_PACKAGE_PYTHON3 # python-requests -> python-idna
	select BR2_PACKAGE_PYTHON_DATEUTIL # runtime
	select BR2_PACKAGE_PYTHON_MSGPACK # runtime
	select BR2_PACKAGE_PYTHON_PYTZ # runtime
	select BR2_PACKAGE_PYTHON_REQUESTS # runtime
	select BR2_PACKAGE_PYTHON_SIX # runtime
	help
	  InfluxDB client.

	  https://github.com/influxdb/influxdb-python
```

## package/python-intelhex/Config.in
```kconfig
config BR2_PACKAGE_PYTHON_INTELHEX
	bool "python-intelhex"
	help
	  Python library for Intel HEX files manipulations.

	  https://pypi.python.org/pypi/IntelHex
```

## package/python-ipdb/Config.in
```kconfig
config BR2_PACKAGE_PYTHON_IPDB
	bool "python-ipdb"
	select BR2_PACKAGE_PYTHON_SETUPTOOLS # runtime
	select BR2_PACKAGE_PYTHON_IPYTHON # runtime
	help
	  IPython-enabled pdb.

	  https://github.com/gotcha/ipdb
```

## package/python-ipython-pygments-lexers/Config.in
```kconfig
config BR2_PACKAGE_PYTHON_IPYTHON_PYGMENTS_LEXERS
	bool "python-ipython-pygments-lexers"
	select BR2_PACKAGE_PYTHON_PYGMENTS # runtime
	help
	  Defines a variety of Pygments lexers for highlighting
	  IPython code.

	  https://pypi.org/project/ipython-pygments-lexers/
```

## package/python-ipython/Config.in
```kconfig
config BR2_PACKAGE_PYTHON_IPYTHON
	bool "python-ipython"
	select BR2_PACKAGE_PYTHON3_SQLITE # runtime
	select BR2_PACKAGE_PYTHON_DECORATOR # runtime
	select BR2_PACKAGE_PYTHON_JEDI # runtime
	select BR2_PACKAGE_PYTHON_MATPLOTLIB_INLINE # runtime
	select BR2_PACKAGE_PYTHON_PROMPT_TOOLKIT # runtime
	select BR2_PACKAGE_PYTHON_PYGMENTS  # runtime
	select BR2_PACKAGE_PYTHON_PEXPECT # runtime
	select BR2_PACKAGE_PYTHON_STACK_DATA # runtime
	select BR2_PACKAGE_PYTHON_TRAITLETS  # runtime
	help
	  IPython is a command shell for interactive computing in
	  multiple programming languages, originally developed for the
	  Python programming language, that offers enhanced
	  introspection, rich media, additional shell syntax, tab
	  completion, and rich history.

	  http://ipython.org/
```

## package/python-isodate/Config.in
```kconfig
config BR2_PACKAGE_PYTHON_ISODATE
	bool "python-isodate"
	help
	  An ISO 8601 date/time/duration parser and formatter for
	  Python. Useful for parsing and formatting ISO 8601 dates,
	  times, and durations.

	  https://github.com/gweis/isodate/
```

## package/python-iterable-io/Config.in
```kconfig
config BR2_PACKAGE_PYTHON_ITERABLE_IO
	bool "python-iterable-io"
	help
	  Adapt generators and other iterables to a file-like
	  interface.

	  https://github.com/pR0Ps/iterable-io
```

## package/python-itsdangerous/Config.in
```kconfig
config BR2_PACKAGE_PYTHON_ITSDANGEROUS
	bool "python-itsdangerous"
	depends on BR2_PACKAGE_PYTHON3
	select BR2_PACKAGE_PYTHON3_ZLIB # runtime
	help
	  Itsdangerous contains various helpers to pass data to
	  untrusted environments and to get it back safe and sound.

	  http://pythonhosted.org/itsdangerous/
```

## package/python-iwlib/Config.in
```kconfig
config BR2_PACKAGE_PYTHON_IWLIB
	bool "python-iwlib"
	depends on BR2_PACKAGE_WIRELESS_TOOLS_LIB
	help
	  python-iwlib is a package for interfacing with iwlib,
	  providing an implementation to the wireless tools in Linux.

	  https://github.com/nhoad/python-iwlib
```

## package/python-janus/Config.in
```kconfig
config BR2_PACKAGE_PYTHON_JANUS
	bool "python-janus"
	help
	  Mixed sync-async queue to interoperate between asyncio
	  tasks and classic threads.

	  https://github.com/aio-libs/janus/
```

## package/python-jaraco-classes/Config.in
```kconfig
config BR2_PACKAGE_PYTHON_JARACO_CLASSES
	bool "python-jaraco-classes"
	select BR2_PACKAGE_PYTHON_MORE_ITERTOOLS # runtime
	help
	  Utility functions for Python class constructs.

	  https://github.com/jaraco/jaraco.classes
```

## package/python-jaraco-collections/Config.in
```kconfig
config BR2_PACKAGE_PYTHON_JARACO_COLLECTIONS
	bool "python-jaraco-collections"
	select BR2_PACKAGE_PYTHON_JARACO_TEXT # runtime
	help
	  Collection objects similar to those in stdlib by jaraco.

	  https://github.com/jaraco/jaraco.collections
```

## package/python-jaraco-context/Config.in
```kconfig
config BR2_PACKAGE_PYTHON_JARACO_CONTEXT
	bool "python-jaraco-context"
	help
	  Context managers by jaraco.

	  https://github.com/jaraco/jaraco.context
```

## package/python-jaraco-functools/Config.in
```kconfig
config BR2_PACKAGE_PYTHON_JARACO_FUNCTOOLS
	bool "python-jaraco-functools"
	select BR2_PACKAGE_PYTHON_MORE_ITERTOOLS # runtime
	help
	  Additional functools in the spirit of stdlib’s
	  functools.

	  https://github.com/jaraco/jaraco.functools
```
