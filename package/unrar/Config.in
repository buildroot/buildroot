## package/volk/Config.in
```kconfig
comment "volk needs a toolchain w/ C++, NPTL, wchar, dynamic library"
	depends on BR2_USE_MMU
	depends on !BR2_INSTALL_LIBSTDCPP || !BR2_TOOLCHAIN_GCC_AT_LEAST_7 || \
		!BR2_TOOLCHAIN_HAS_THREADS_NPTL || BR2_STATIC_LIBS

config BR2_PACKAGE_VOLK
	bool "volk"
	depends on BR2_INSTALL_LIBSTDCPP
	depends on !BR2_STATIC_LIBS
	depends on BR2_TOOLCHAIN_GCC_AT_LEAST_7 # C++17
	depends on BR2_TOOLCHAIN_HAS_THREADS_NPTL
	depends on BR2_USE_MMU # use fork()
	help
	  VOLK is the Vector-Optimized Library of Kernels. It is a
	  library that contains kernels of hand-written SIMD code
	  for different mathematical operations. Since each SIMD
	  architecture can be very different and no compiler has yet
	  come along to handle vectorization properly or highly
	  efficiently, VOLK approaches the problem differently.

	  For each architecture or platform that a developer wishes
	  to vectorize for, a new proto-kernel is added to VOLK. At
	  runtime, VOLK will select the correct proto-kernel. In this
	  way, the users of VOLK call a kernel for performing the
	  operation that is platform/architecture agnostic. This
	  allows us to write portable SIMD code.

	  https://www.libvolk.org/
```

## package/vss-sdk/Config.in
```kconfig
config BR2_PACKAGE_VSS_SDK
	bool "vss-sdk"
	depends on BR2_arm
	select BR2_PACKAGE_HAS_LIBEGL
	select BR2_PACKAGE_HAS_LIBGLES
    select BR2_PACKAGE_HAS_NEXUS
    select BR2_PACKAGE_HAS_PLAYREADY
    select BR2_PACKAGE_HAS_VP9_DECODER
    select BR2_PACKAGE_HAS_NEXUS_SAGE
	help
	  Pre-compiled binaries for a platform

if BR2_PACKAGE_VSS_SDK

config BR2_PACKAGE_VSS_SDK_MOVE_GSTREAMER
	bool "move g-streamer"
	help
	  Move g-streamer to a other location
	  
config BR2_PACKAGE_VSS_SDK_INSTALL_INITD
	bool "initd scripts"
	help
	  Install initd scripts for nexus kernelmodules and nxserver

config BR2_PACKAGE_NEXUS_SAGE_PATH
    string "SAGE Path"
    default "/usr/bin/"
    help
        Sage binaries path

config BR2_PACKAGE_VSS_SDK_NXSERVER_ARGS
    string "nxserver arguments"
    default "-ir b -sd off -ms12 -audio_description -hdcp2x_keys /tmp/BCH2 -hdcp1x_keys /proc/device-tree/chosen/cisco,stbplatform/cisco,stbkey/cisco,hdcpbcmcert"
    help
        Arguments for the nxserver

config BR2_PACKAGE_SDK_INSTALL
    string 
	default "vss-sdk"

config BR2_PACKAGE_PROVIDES_LIBEGL
	default "vss-sdk"

config BR2_PACKAGE_PROVIDES_LIBGLES
	default "vss-sdk"

config BR2_PACKAGE_PROVIDES_NEXUS
	default "vss-sdk"

config BR2_PACKAGE_PROVIDES_PLAYREADY
	default "vss-sdk"

config BR2_PACKAGE_PROVIDES_VP9_DECODER
	default "vss-sdk"

config BR2_PACKAGE_PROVIDES_OPUS_DECODER
	default "vss-sdk"

config BR2_PACKAGE_PROVIDES_NEXUS_SAGE
	default "vss-sdk"

endif
```

## package/vte/Config.in
```kconfig
config BR2_PACKAGE_VTE
	bool "vte"
	depends on BR2_PACKAGE_HOST_RUSTC_ARCH_SUPPORTS # libgtk3 -> host-libgtk3 -> host-librsvg
	depends on BR2_USE_WCHAR
	depends on BR2_TOOLCHAIN_HAS_THREADS
	depends on BR2_USE_MMU
	depends on BR2_INSTALL_LIBSTDCPP
	depends on BR2_TOOLCHAIN_GCC_AT_LEAST_10 # C++20
	depends on BR2_TOOLCHAIN_HAS_SYNC_4
	depends on !BR2_TOOLCHAIN_USES_MUSL
	depends on BR2_PACKAGE_HAS_LIBEGL || \
		BR2_PACKAGE_HAS_LIBGL
	depends on BR2_PACKAGE_XORG7
	select BR2_PACKAGE_LIBGTK3
	select BR2_PACKAGE_PCRE2
	help
	  VTE is a library (libvte) implementing a terminal emulator
	  widget for GTK+, and a minimal sample application (vte)
	  using that. Vte is mainly used in gnome-terminal, but
	  can also be used to embed a console/terminal in games,
	  editors, IDEs, etc.

	  http://github.com/GNOME/vte

comment "vte needs a uClibc or glibc toolchain w/ wchar, threads, C++, gcc >= 10"
	depends on BR2_PACKAGE_HOST_RUSTC_ARCH_SUPPORTS
	depends on BR2_USE_MMU
	depends on BR2_TOOLCHAIN_HAS_SYNC_4
	depends on !BR2_USE_WCHAR || !BR2_INSTALL_LIBSTDCPP || \
		!BR2_TOOLCHAIN_HAS_THREADS || \
		!BR2_TOOLCHAIN_GCC_AT_LEAST_10 || \
		BR2_TOOLCHAIN_USES_MUSL

comment "vte needs an OpenGL or an OpenGL-EGL backend"
	depends on BR2_PACKAGE_HOST_RUSTC_ARCH_SUPPORTS
	depends on BR2_USE_MMU
	depends on BR2_TOOLCHAIN_HAS_SYNC_4
	depends on !BR2_PACKAGE_HAS_LIBEGL && \
		!BR2_PACKAGE_HAS_LIBGL
```

## package/vuejs-router/Config.in
```kconfig
config BR2_PACKAGE_VUEJS_ROUTER
	bool "vuejs-router"
	help
	  The official router for Vue.js.

	  http://router.vuejs.org
```
