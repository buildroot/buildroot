## package/unrar/Config.in
```kconfig
config BR2_PACKAGE_UNRAR
	bool "unrar"
	depends on BR2_INSTALL_LIBSTDCPP
	depends on BR2_TOOLCHAIN_GCC_AT_LEAST_4_8 # C++11
	depends on BR2_TOOLCHAIN_HAS_THREADS
	depends on BR2_USE_WCHAR
	help
	  RAR file uncompressor.

	  http://www.rarlab.com/rar_add.htm

comment "unrar needs a toolchain w/ C++, wchar, threads, gcc >= 4.8"
	depends on !BR2_USE_WCHAR || !BR2_INSTALL_LIBSTDCPP \
		|| !BR2_TOOLCHAIN_GCC_AT_LEAST_4_8 \
		|| !BR2_TOOLCHAIN_HAS_THREADS
```

## package/upx/Config.in.host
```kconfig
config BR2_PACKAGE_HOST_UPX
        bool "host upx"
        help
          UPX is an advanced executable file compressor. UPX will typically
          reduce the file size of programs and DLLs by around 50%-70%, thus
          reducing disk space, network load times, download times etc. The
          current version can compress executables for DOS, Linux/ELF (i386,
          amd64, ppc32) and some other files for different OS.
          Homepage: http://upx.sourceforge.net/
```

## package/uqmi/Config.in
```kconfig
config BR2_PACKAGE_UQMI
	bool "uqmi"
	depends on !BR2_STATIC_LIBS # libubox
	depends on BR2_TOOLCHAIN_HAS_SYNC_4 # json-c
	select BR2_PACKAGE_JSON_C
	select BR2_PACKAGE_LIBUBOX
	help
	  This command line tool originates from the OpenWrt project
	  to configure LTE modem in QMI mode for WAN connection.

	  https://git.openwrt.org/project/uqmi.git

comment "uqmi needs a toolchain w/ dynamic library"
	depends on BR2_TOOLCHAIN_HAS_SYNC_4
	depends on BR2_STATIC_LIBS
```

## package/urandom-scripts/Config.in
```kconfig
config BR2_PACKAGE_URANDOM_SCRIPTS
	bool "urandom-initscripts"
	default y if BR2_PACKAGE_INITSCRIPTS
	depends on BR2_PACKAGE_BUSYBOX
	depends on !BR2_PACKAGE_SYSTEMD
	help
	  Initscript to preserve the random seed between reboots.
```

## package/usbguard/Config.in
```kconfig
config BR2_PACKAGE_USBGUARD
	bool "usbguard"
	depends on BR2_PACKAGE_PROTOBUF_ARCH_SUPPORTS # protobuf
	depends on BR2_INSTALL_LIBSTDCPP # protobuf
	depends on BR2_TOOLCHAIN_HAS_THREADS # libqb, protobuf
	depends on BR2_TOOLCHAIN_GCC_AT_LEAST_8 # protobuf, C++17 filesystem
	depends on !BR2_STATIC_LIBS # libqb, protobuf
	depends on !BR2_TOOLCHAIN_HAS_GCC_BUG_64735 # std::future
	select BR2_PACKAGE_PROTOBUF
	select BR2_PACKAGE_LIBQB
	select BR2_PACKAGE_LIBSODIUM if !BR2_PACKAGE_LIBGCRYPT && !BR2_PACKAGE_LIBOPENSSL
	help
	  The USBGuard software framework

	  Install a custom accept/deny list in /etc/usbguard/rules.conf
	  (e.g. using an overlay). This file can be generated on the
	  target using "usbguard generate-policy".

	  https://usbguard.github.io/

comment "usbguard needs a toolchain w/ C++, threads, dynamic library, gcc >= 8"
	depends on !BR2_INSTALL_LIBSTDCPP || !BR2_TOOLCHAIN_HAS_THREADS \
		|| BR2_STATIC_LIBS || !BR2_TOOLCHAIN_GCC_AT_LEAST_8
	depends on BR2_PACKAGE_PROTOBUF_ARCH_SUPPORTS

comment "usbguard needs a toolchain not affected by GCC bug 64735"
	depends on BR2_PACKAGE_PROTOBUF_ARCH_SUPPORTS
	depends on BR2_TOOLCHAIN_HAS_GCC_BUG_64735
```

## package/usbip/Config.in
```kconfig
config BR2_PACKAGE_USBIP
	bool "usbip"
	depends on BR2_PACKAGE_HAS_UDEV
	help
	  The USB-over-IP suite of tools.

	  Note: you'll have to enable either (or both) of "VHCI hcd"
	  (CONFIG_USBIP_VHCI_HCD) if you want to access a remote USB
	  device, or "Host driver" (CONFIG_USBIP_HOST) if you want
	  to share a USB device, in your kernel configuration. The
	  Buildroot package "hwdata" with the "usb.ids" file is also
	  useful (but not mandatory) to list and identify USB device
	  by name.

	  https://git.kernel.org/pub/scm/linux/kernel/git/stable/linux.git/tree/tools/usb/usbip

comment "usbip needs udev /dev management"
	depends on !BR2_PACKAGE_HAS_UDEV
```

## package/usbredir/Config.in
```kconfig
comment "usbredir needs a toolchain w/ threads, gcc >= 4.9"
	depends on !BR2_TOOLCHAIN_HAS_THREADS || \
		!BR2_TOOLCHAIN_GCC_AT_LEAST_4_9

config BR2_PACKAGE_USBREDIR
	bool "usbredir"
	depends on BR2_TOOLCHAIN_HAS_THREADS # libusb
	depends on BR2_TOOLCHAIN_GCC_AT_LEAST_4_9 # libusb
	select BR2_PACKAGE_LIBUSB
	help
	  usbredir is the name of a network protocol for sending usb
	  device traffic over a network connection. It is also the
	  name of the software package offering a parsing library, a
	  usbredirhost library and several utilities implementing this
	  protocol.

	  Note: only the library is installed, not the utilities. Say
	  'y' below if you want the tools too.

	  http://www.spice-space.org/page/UsbRedir

if BR2_PACKAGE_USBREDIR

config BR2_PACKAGE_USBREDIR_TOOLS
	bool "enable tools"
	depends on BR2_USE_MMU # libglib2
	depends on BR2_USE_WCHAR # libglib2
	select BR2_PACKAGE_LIBGLIB2
	help
	  If you want to serve usbredir requests on your target, say
	  'y' here to have the tools built and installed on the target
	  (including usbredirect binary).

	  Note: the tools are not required to use the library.

comment "tools needs a toolchain w/ wchar"
	depends on BR2_USE_MMU
	depends on !BR2_USE_WCHAR

endif
```

## package/usbutils/Config.in
```kconfig
config BR2_PACKAGE_USBUTILS
	bool "usbutils"
	depends on BR2_TOOLCHAIN_HAS_THREADS # libusb
	depends on BR2_TOOLCHAIN_GCC_AT_LEAST_4_9 # libusb
	depends on BR2_PACKAGE_HAS_LIBUDEV
	select BR2_PACKAGE_HWDATA if BR2_PACKAGE_LIBUDEV_ZERO
	select BR2_PACKAGE_HWDATA_USB_IDS if BR2_PACKAGE_LIBUDEV_ZERO
	select BR2_PACKAGE_LIBICONV if !BR2_ENABLE_LOCALE
	select BR2_PACKAGE_LIBUSB
	help
	  USB enumeration utilities

	  http://linux-usb.sourceforge.net/

comment "usbutils needs libudev and a toolchain w/ threads, wchar, dynamic library, gcc >= 4.9"
	depends on !BR2_TOOLCHAIN_HAS_THREADS || \
		!BR2_PACKAGE_HAS_LIBUDEV || \
		!BR2_TOOLCHAIN_GCC_AT_LEAST_4_9
```

## package/ustream-ssl/Config.in
```kconfig
config BR2_PACKAGE_USTREAM_SSL
	bool "ustream-ssl"
	depends on !BR2_STATIC_LIBS # libubox
	depends on BR2_TOOLCHAIN_HAS_SYNC_4 # libubox -> json-c
	select BR2_PACKAGE_LIBUBOX
	select BR2_PACKAGE_OPENSSL if !BR2_PACKAGE_MBEDTLS
	help
	  ustream SSL wrapper

	  https://git.openwrt.org/?p=project/ustream-ssl.git;a=summary

comment "ustream-ssl needs a toolchain w/ dynamic library"
	depends on BR2_STATIC_LIBS
	depends on BR2_TOOLCHAIN_HAS_SYNC_4
```

## package/ustreamer/Config.in
```kconfig
config BR2_PACKAGE_USTREAMER
	bool "ustreamer"
	depends on BR2_TOOLCHAIN_HEADERS_AT_LEAST_3_16 # V4L2_EVENT_SOURCE_CHANGE
	depends on BR2_TOOLCHAIN_HAS_THREADS # libbsd
	depends on !BR2_STATIC_LIBS # libbsd
	depends on BR2_PACKAGE_LIBBSD_ARCH_SUPPORTS # libbsd
	depends on BR2_USE_WCHAR # libbsd
	select BR2_PACKAGE_JPEG
	select BR2_PACKAGE_LIBBSD
	select BR2_PACKAGE_LIBEVENT
	help
	  Lightweight and fast MJPEG-HTTP streamer

	  https://github.com/pikvm/ustreamer

comment "ustreamer needs a toolchain w/ headers >= 3.16, threads, dynamic library, wchar"
	depends on BR2_PACKAGE_LIBBSD_ARCH_SUPPORTS
	depends on !BR2_TOOLCHAIN_HEADERS_AT_LEAST_3_16 || \
		!BR2_TOOLCHAIN_HAS_THREADS || \
		BR2_STATIC_LIBS || \
		!BR2_USE_WCHAR
```

## package/utfcpp/Config.in
```kconfig
config BR2_PACKAGE_UTFCPP
	bool "utfcpp"
	depends on BR2_INSTALL_LIBSTDCPP
	help
	  UTF-8 with C++ in a Portable Way

	  https://github.com/nemtrif/utfcpp

comment "utfcpp needs a toolchain w/ C++"
	depends on !BR2_INSTALL_LIBSTDCPP
```

## package/utopia/Config.in
```kconfig
config BR2_PACKAGE_UTOPIA
    bool "utopia module"
    select BR2_PACKAGE_TELEMETRY
    default n
    help
       utopia module
```

## package/uuu/Config.in
```kconfig
config BR2_PACKAGE_UUU
	bool "uuu"
	depends on BR2_INSTALL_LIBSTDCPP
	depends on BR2_TOOLCHAIN_GCC_AT_LEAST_4_9 # C++14
	depends on BR2_TOOLCHAIN_HAS_ATOMIC
	depends on BR2_TOOLCHAIN_HAS_THREADS
	depends on BR2_USE_WCHAR # libuuu uses wchar_t
	select BR2_PACKAGE_BZIP2
	select BR2_PACKAGE_LIBUSB
	select BR2_PACKAGE_OPENSSL
	select BR2_PACKAGE_TINYXML2
	select BR2_PACKAGE_ZLIB
	select BR2_PACKAGE_ZSTD
	help
	  UUU (Universal Update Utility) is Freescale/NXP I.MX Chip
	  image deploy tool. UUU is an evolution of MFGTools
	  (aka MFGTools v3).

	  https://github.com/nxp-imx/mfgtools

comment "uuu needs a toolchain w/ C++14, threads, atomic, wchar"
	depends on !BR2_INSTALL_LIBSTDCPP || !BR2_TOOLCHAIN_HAS_ATOMIC \
	        || !BR2_TOOLCHAIN_HAS_THREADS || !BR2_USE_WCHAR
```

## package/uuu/Config.in.host
```kconfig
config BR2_PACKAGE_HOST_UUU
	bool "host uuu"
	depends on BR2_HOST_GCC_AT_LEAST_4_9 # host-libusb
	help
	  UUU (Universal Update Utility) is Freescale/NXP I.MX Chip
	  image deploy tool. UUU is an evolution of MFGTools
	  (aka MFGTools v3).

	  To be able to run uuu without root privileges, execute the
	  following steps:

	    sudo sh -c "uuu -udev >> /etc/udev/rules.d/70-uuu.rules"
	    sudo udevadm control --reload

	  https://github.com/nxp-imx/mfgtools

comment "host uuu needs a toolchain w/ host gcc >= 4.9"
	depends on !BR2_HOST_GCC_AT_LEAST_4_9
```

## package/valijson/Config.in
```kconfig
config BR2_PACKAGE_VALIJSON
	bool "valijson"
	depends on BR2_INSTALL_LIBSTDCPP
	help
	  Valijson is a header-only JSON Schema Validation library for
	  C++. Valijson provides a simple validation API that allows
	  you load JSON Schemas, and validate documents loaded by one
	  of several supported parser libraries like boost, jsoncpp,
	  rapidjson and picoJSON.

	  https://github.com/tristanpenman/valijson

comment "valijson needs a toolchain w/ C++"
	depends on !BR2_INSTALL_LIBSTDCPP
```

## package/versal-firmware/Config.in
```kconfig
config BR2_PACKAGE_VERSAL_FIRMWARE
	bool "versal-firmware"
	depends on BR2_aarch64
	help
	  Pre-built firmware files for Xilinx Versal boards.

	  https://github.com/nealfrager/buildroot-firmware

if BR2_PACKAGE_VERSAL_FIRMWARE

config BR2_PACKAGE_VERSAL_FIRMWARE_VERSION
	string "firmware version"
	default "2022.2_br_1"
	help
	  Release version of Versal firmware.

config BR2_PACKAGE_VERSAL_FIRMWARE_BOARD
	string "board name"
	default "vck190"
	help
	  Name of Versal target board.
	  Used for installing the appropriate firmware.

endif # BR2_PACKAGE_VERSAL_FIRMWARE
```

## package/vftv-sdk/Config.in
```kconfig
config BR2_PACKAGE_VFTV_SDK
    bool "vftv-sdk"
    depends on BR2_arm
    select BR2_PACKAGE_HAS_NEXUS
    select BR2_PACKAGE_HAS_NEXUS_SAGE
    select BR2_PACKAGE_HAS_PLAYREADY
    select BR2_PACKAGE_HAS_WIDEVINE
    select BR2_PACKAGE_HAS_VP9_DECODER
    select BR2_PACKAGE_HAS_OPUS_DECODER
    select BR2_PACKAGE_HAS_LIBEGL
    select BR2_PACKAGE_HAS_LIBGLES
    help
      Pre-compiled binaries for a platform

if BR2_PACKAGE_VFTV_SDK

config BR2_PACKAGE_PROVIDES_NEXUS
    default "vftv-sdk"

config BR2_PACKAGE_PROVIDES_LIBEGL
    default "vftv-sdk"

config BR2_PACKAGE_PROVIDES_LIBGLES
    default "vftv-sdk"
    
config BR2_PACKAGE_PROVIDES_PLAYREADY
	default "vftv-sdk"

config BR2_PACKAGE_PROVIDES_VP9_DECODER
	default "vftv-sdk"

config BR2_PACKAGE_PROVIDES_OPUS_DECODER
	default "vftv-sdk"

config BR2_PACKAGE_PROVIDES_NEXUS_SAGE
	default "vftv-sdk"

config BR2_PACKAGE_SDK_INSTALL
    string 
    default "vftv-sdk"

endif
```

## package/vip-sdk/Config.in
```kconfig
config BR2_PACKAGE_VIP_SDK
	bool "vip-sdk"
	depends on BR2_mipsel
	select BR2_PACKAGE_HAS_NEXUS
	select BR2_PACKAGE_HAS_LIBEGL
	select BR2_PACKAGE_HAS_LIBGLES
	help
	  Pre-compiled binaries for a platform

if BR2_PACKAGE_VIP_SDK

config BR2_PACKAGE_PROVIDES_NEXUS
	default "vip-sdk"

config BR2_PACKAGE_PROVIDES_LIBEGL
	default "vip-sdk"

config BR2_PACKAGE_PROVIDES_LIBGLES
	default "vip-sdk"

endif
```

## package/virglrenderer/Config.in
```kconfig
config BR2_PACKAGE_VIRGLRENDERER
	bool "virglrenderer"
	depends on BR2_TOOLCHAIN_GCC_AT_LEAST_4_9 # needs gcc >= 4.9 for __sync builtins
	depends on BR2_TOOLCHAIN_HAS_THREADS
	depends on BR2_USE_MMU # fork()
	select BR2_PACKAGE_LIBEPOXY
	help
	  A library for accelerated graphics and compute in
	  virtual machines.

	  A backend must be selected to enable guest acceleration.

	  https://qemu.readthedocs.io/en/v10.0.3/system/devices/virtio-gpu.html#virtio-gpu-virglrenderer

if BR2_PACKAGE_VIRGLRENDERER

config BR2_PACKAGE_VIRGLRENDERER_VIRGL
	bool "virgl"
	default y
	depends on (BR2_PACKAGE_HAS_LIBEGL && BR2_PACKAGE_HAS_LIBGBM) \
		|| BR2_PACKAGE_HAS_LIBGL
	select BR2_PACKAGE_VIRGLRENDERER_HAS_BACKEND
	help
	  Enable API-level OpenGL acceleration over virtio-gpu.

	  Requires the host to support OpenGL.

	  https://docs.mesa3d.org/drivers/virgl.html

comment "virgl needs OpenGL or OpenGL EGL and libgbm"
	depends on !((BR2_PACKAGE_HAS_LIBEGL && BR2_PACKAGE_HAS_LIBGBM) \
		|| BR2_PACKAGE_HAS_LIBGL)

config BR2_PACKAGE_VIRGLRENDERER_VENUS
	bool "venus"
	default y if BR2_PACKAGE_MESA3D_VULKAN_DRIVER
	depends on BR2_INSTALL_LIBSTDCPP # vulkan-loader
	depends on !BR2_STATIC_LIBS # vulkan-loader
	depends on BR2_TOOLCHAIN_HAS_THREADS # vulkan-loader
	select BR2_PACKAGE_VIRGLRENDERER_HAS_BACKEND
	select BR2_PACKAGE_VULKAN_HEADERS
	select BR2_PACKAGE_VULKAN_LOADER
	help
	  Enable API-level Vulkan acceleration over virtio-gpu.

	  Requires the host to support Vulkan.

	  https://docs.mesa3d.org/drivers/venus.html

comment "DRM backends"

config BR2_PACKAGE_VIRGLRENDERER_DRM_BACKEND_AMDGPU
	bool "amdgpu"
	default y if BR2_PACKAGE_MESA3D_GALLIUM_DRIVER_RADEONSI
	default y if BR2_PACKAGE_MESA3D_VULKAN_DRIVER_AMD
	select BR2_PACKAGE_VIRGLRENDERER_HAS_BACKEND
	select BR2_PACKAGE_LIBDRM
	select BR2_PACKAGE_LIBDRM_AMDGPU
	help
	  Enable DRM backend for amdgpu, used by Gallium radeonsi
	  and RADV vulkan drivers.

config BR2_PACKAGE_VIRGLRENDERER_DRM_BACKEND_INTEL
	bool "intel"
	default y if BR2_PACKAGE_MESA3D_GALLIUM_DRIVER_I915
	default y if BR2_PACKAGE_MESA3D_GALLIUM_DRIVER_IRIS
	default y if BR2_PACKAGE_MESA3D_VULKAN_DRIVER_INTEL
	select BR2_PACKAGE_VIRGLRENDERER_HAS_BACKEND
	select BR2_PACKAGE_LIBDRM
	help
	  Enable DRM backend for i915, used by Gallium i915/Iris
	  and Intel vulkan drivers.

config BR2_PACKAGE_VIRGLRENDERER_DRM_BACKEND_MSM
	bool "msm"
	default y if BR2_PACKAGE_MESA3D_GALLIUM_DRIVER_FREEDRENO
	depends on !BR2_arm
	select BR2_PACKAGE_VIRGLRENDERER_HAS_BACKEND
	select BR2_PACKAGE_LIBDRM
	help
	  Enable DRM backend for msm, used by Gallium freedreno
	  driver.

config BR2_PACKAGE_VIRGLRENDERER_DRM_BACKEND_PANFROST
	bool "panfrost"
	default y if BR2_PACKAGE_MESA3D_GALLIUM_DRIVER_PANFROST
	default y if BR2_PACKAGE_MESA3D_VULKAN_DRIVER_PANFROST
	select BR2_PACKAGE_VIRGLRENDERER_HAS_BACKEND
	select BR2_PACKAGE_LIBDRM
	help
	  Enable DRM backend for Panfrost, used by the panfrost
	  Gallium/vulkan drivers.

comment "Other options"

comment "vaapi support needs libgbm with dma-buf"
	depends on !BR2_PACKAGE_LIBGBM_HAS_FEATURE_DMA_BUF

config BR2_PACKAGE_VIRGLRENDERER_VAAPI
	bool "vaapi support"
	depends on BR2_PACKAGE_LIBGBM_HAS_FEATURE_DMA_BUF
	select BR2_PACKAGE_LIBDRM
	select BR2_PACKAGE_LIBVA
	help
	  Enable hardware accelerated video encode/decode through
	  libva over virtio-gpu.

endif

comment "virglrenderer needs a toolchain w/ gcc >= 4.9"
	depends on !BR2_TOOLCHAIN_GCC_AT_LEAST_4_9

config BR2_PACKAGE_VIRGLRENDERER_HAS_BACKEND
	bool
```

## package/vis-network/Config.in
```kconfig
config BR2_PACKAGE_VIS_NETWORK
	bool "vis-network"
	help
	  Display dynamic, automatically organised, customizable network
	  views. Network uses HTML canvas for rendering.

	  http://visjs.github.io/vis-network/
```
