## package/python-markdown/Config.in
```kconfig
config BR2_PACKAGE_PYTHON_MARKDOWN
	bool "python-markdown"
	# runtime dependency on Python's xml module
	select BR2_PACKAGE_PYTHON3_PYEXPAT
	help
	  This is a Python implementation of John Gruber's Markdown

	  https://pypi.python.org/pypi/Markdown
```

## package/python-markdown2/Config.in
```kconfig
config BR2_PACKAGE_PYTHON_MARKDOWN2
	bool "python-markdown2"
	depends on BR2_PACKAGE_PYTHON3
	help
	  A fast and complete Python implementation of Markdown.

	  https://github.com/trentm/python-markdown2
```

## package/python-markupsafe/Config.in
```kconfig
config BR2_PACKAGE_PYTHON_MARKUPSAFE
	bool "python-markupsafe"
	depends on BR2_PACKAGE_PYTHON3
	help
	  MarkupSafe implements a XML/HTML/XHTML Markup safe string
	  for Python.

	  https://github.com/mitsuhiko/markupsafe
```

## package/python-marshmallow-sqlalchemy/Config.in
```kconfig
config BR2_PACKAGE_PYTHON_MARSHMALLOW_SQLALCHEMY
	bool "python-marshmallow-sqlalchemy"
	select BR2_PACKAGE_PYTHON_MARSHMALLOW # runtime
	select BR2_PACKAGE_PYTHON_SQLALCHEMY # runtime
	help
	  SQLAlchemy integration with the marshmallow
	  (de)serialization library.

	  https://github.com/marshmallow-code/marshmallow-sqlalchemy
```

## package/python-marshmallow/Config.in
```kconfig
config BR2_PACKAGE_PYTHON_MARSHMALLOW
	bool "python-marshmallow"
	help
	  A lightweight library for converting complex datatypes to
	  and from native Python datatypes.

	  https://github.com/marshmallow-code/marshmallow
```

## package/python-matplotlib-inline/Config.in
```kconfig
config BR2_PACKAGE_PYTHON_MATPLOTLIB_INLINE
	bool "python-matplotlib-inline"
	select BR2_PACKAGE_PYTHON_TRAITLETS # runtime
	help
	  Inline Matplotlib backend for Jupyter.

	  https://github.com/ipython/matplotlib-inline
```

## package/python-mdit-py-plugins/Config.in
```kconfig
config BR2_PACKAGE_PYTHON_MDIT_PY_PLUGINS
	bool "python-mdit-py-plugins"
	select BR2_PACKAGE_PYTHON_MARKDOWN_IT_PY # runtime
	help
	  Collection of plugins for markdown-it-py.

	  https://github.com/executablebooks/mdit-py-plugins
```

## package/python-mdurl/Config.in
```kconfig
config BR2_PACKAGE_PYTHON_MDURL
	bool "python-mdurl"
	help
	  This is a Python port of the JavaScript mdurl package, used by
	  markdown-it-py.

	  https://github.com/executablebooks/mdurl
```

## package/python-memory-profiler/Config.in
```kconfig
config BR2_PACKAGE_PYTHON_MEMORY_PROFILER
	bool "python-memory-profiler"
	select BR2_PACKAGE_PYTHON_PSUTIL # runtime
	help
	  A module for monitoring memory usage of a python program.

	  https://github.com/pythonprofilers/memory_profiler
```

## package/python-memray/Config.in
```kconfig
config BR2_PACKAGE_PYTHON_MEMRAY
	bool "python-memray"
	depends on BR2_USE_WCHAR # elfutils
	depends on !BR2_STATIC_LIBS # elfutils
	depends on BR2_TOOLCHAIN_HAS_THREADS # elfutils
	depends on BR2_TOOLCHAIN_HAS_SYNC_4 # elfutils/libdebuginfod
	depends on BR2_PACKAGE_LIBUNWIND_ARCH_SUPPORTS
	depends on BR2_INSTALL_LIBSTDCPP
	select BR2_PACKAGE_ELFUTILS
	select BR2_PACKAGE_ELFUTILS_LIBDEBUGINFOD
	select BR2_PACKAGE_LIBUNWIND
	select BR2_PACKAGE_LZ4
	select BR2_PACKAGE_PYTHON3_ZLIB
	select BR2_PACKAGE_PYTHON_JINJA2 # runtime
	select BR2_PACKAGE_PYTHON_RICH # runtime
	select BR2_PACKAGE_PYTHON_TEXTUAL # runtime
	help
	  A memory profiler for Python applications.

	  https://github.com/bloomberg/memray

comment "python-memray needs a toolchain w/ C++, dynamic library, threads, wchar"
	depends on BR2_PACKAGE_LIBUNWIND_ARCH_SUPPORTS
	depends on BR2_TOOLCHAIN_HAS_SYNC_4
	depends on !BR2_INSTALL_LIBSTDCPP || BR2_STATIC_LIBS || \
		!BR2_TOOLCHAIN_HAS_THREADS
```

## package/python-midiutil/Config.in
```kconfig
config BR2_PACKAGE_PYTHON_MIDIUTIL
	bool "python-midiutil"
	help
	  A pure python library for creating multi-track MIDI files.

	  https://github.com/MarkCWirt/MIDIUtil
```

## package/python-minimalmodbus/Config.in
```kconfig
config BR2_PACKAGE_PYTHON_MINIMALMODBUS
	bool "python-minimalmodbus"
	select BR2_PACKAGE_PYTHON_SERIAL # runtime
	help
	  Easy-to-use Modbus RTU and Modbus ASCII implementation.

	  https://minimalmodbus.readthedocs.io/
```

## package/python-ml-dtypes/Config.in
```kconfig
config BR2_PACKAGE_PYTHON_ML_DTYPES
	bool "python-ml-dtypes"
	depends on BR2_PACKAGE_PYTHON_NUMPY_ARCH_SUPPORTS
	depends on BR2_INSTALL_LIBSTDCPP # python-numpy
	depends on BR2_TOOLCHAIN_USES_GLIBC || BR2_TOOLCHAIN_USES_MUSL # python-numpy
	depends on BR2_TOOLCHAIN_GCC_AT_LEAST_9 # python-numpy
	depends on BR2_HOST_GCC_AT_LEAST_9 # host-python-numpy
	select BR2_PACKAGE_PYTHON_NUMPY
	help
	  ml_dtypes is a stand-alone implementation of several NumPy
	  dtype extensions used in machine learning libraries.

	  https://github.com/jax-ml/ml_dtypes

comment "python-ml-dtypes needs a glibc or musl toolchain w/ C++, gcc >= 9"
	depends on BR2_PACKAGE_PYTHON_NUMPY_ARCH_SUPPORTS
	depends on !BR2_INSTALL_LIBSTDCPP || \
		!BR2_TOOLCHAIN_GCC_AT_LEAST_9 || \
		!(BR2_TOOLCHAIN_USES_GLIBC || BR2_TOOLCHAIN_USES_MUSL)
```

## package/python-more-itertools/Config.in
```kconfig
config BR2_PACKAGE_PYTHON_MORE_ITERTOOLS
	bool "python-more-itertools"
	help
	  More routines for operating on iterables, beyond itertools.

	  https://github.com/more-itertools/more-itertools
```

## package/python-mpd2/Config.in
```kconfig
config BR2_PACKAGE_PYTHON_MPD2
	bool "python-mpd2"
	help
	  A Python MPD client library.

	  https://github.com/Mic92/python-mpd2
```

## package/python-mpmath/Config.in
```kconfig
config BR2_PACKAGE_PYTHON_MPMATH
	bool "python-mpmath"
	help
	  mpmath is a free (BSD licensed) Python library for real and
	  complex floating-point arithmetic with arbitrary precision.

	  https://mpmath.org/
```

## package/python-multipart/Config.in
```kconfig
config BR2_PACKAGE_PYTHON_MULTIPART
	bool "python-multipart"
	help
	  A streaming multipart parser for Python.

	  https://github.com/andrew-d/python-multipart
```

## package/python-munch/Config.in
```kconfig
config BR2_PACKAGE_PYTHON_MUNCH
	bool "python-munch"
	select BR2_PACKAGE_PYTHON_SETUPTOOLS # runtime
	select BR2_PACKAGE_PYTHON_SIX # runtime
	help
	  Munch is a dictionary that supports attribute-style access,
	  a la JavaScript.

	  https://github.com/Infinidat/munch
```

## package/python-mwclient/Config.in
```kconfig
config BR2_PACKAGE_PYTHON_MWCLIENT
	bool "python-mwclient"
	depends on BR2_PACKAGE_PYTHON3 # python-requests-oauthlib -> python-requests -> python-idna
	select BR2_PACKAGE_PYTHON_REQUESTS_OAUTHLIB # runtime
	select BR2_PACKAGE_PYTHON_SIX # runtime
	help
	  Python client library to interface with the MediaWiki API

	  https://github.com/mwclient/mwclient
```

## package/python-mwscrape/Config.in
```kconfig
config BR2_PACKAGE_PYTHON_MWSCRAPE
	bool "python-mwscrape"
	select BR2_PACKAGE_PYTHON_COUCHDB # runtime
	select BR2_PACKAGE_PYTHON_MWCLIENT # runtime
	select BR2_PACKAGE_PYTHON_PYLRU # runtime
	help
	  Download rendered articles from MediaWiki API to CouchDB

	  https://github.com/itkach/mwscrape
```

## package/python-mypy-extensions/Config.in
```kconfig
config BR2_PACKAGE_PYTHON_MYPY_EXTENSIONS
	bool "python-mypy-extensions"
	help
	  Experimental type system extensions for programs checked
	  with the mypy typechecker.

	  https://github.com/python/mypy_extensions
```

## package/python-mypy/Config.in
```kconfig
config BR2_PACKAGE_PYTHON_MYPY
	bool "python-mypy"
	select BR2_PACKAGE_PYTHON_MYPY_EXTENSIONS # runtime
	select BR2_PACKAGE_PYTHON_TYPING_EXTENSIONS # runtime
	help
	  Optional static typing for Python.

	  https://www.mypy-lang.org/
```

## package/python-oauthlib/Config.in
```kconfig
config BR2_PACKAGE_PYTHON_OAUTHLIB
	bool "python-oauthlib"
	depends on BR2_PACKAGE_PYTHON3
	help
	  A generic, spec-compliant, thorough implementation of the
	  OAuth request-signing logic.

	  https://github.com/oauthlib/oauthlib
```

## package/python-opentrickler/Config.in
```kconfig
config BR2_PACKAGE_PYTHON_OPENTRICKLER
	bool "python-opentrickler"
	depends on BR2_PACKAGE_PYTHON3
	help
	  The OpenTrickler is an open-source program to run a
	  DIY gunpowder trickler.

	  https://github.com/ammolytics/projects/trickler/
```

## package/python-orjson/Config.in
```kconfig
config BR2_PACKAGE_PYTHON_ORJSON
	bool "python-orjson"
	depends on BR2_PACKAGE_HOST_RUSTC_TARGET_ARCH_SUPPORTS
	help
	  orjson is a fast, correct JSON library for Python. It
	  benchmarks as the fastest Python library for JSON and is more
	  correct than the standard json library or other third-party
	  libraries. It serializes dataclass, datetime, numpy, and UUID
	  instances natively.

	  https://github.com/ijl/orjson
```
