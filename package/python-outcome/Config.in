## package/python-outcome/Config.in
```kconfig
config BR2_PACKAGE_PYTHON_OUTCOME
	bool "python-outcome"
	select BR2_PACKAGE_PYTHON_ATTRS # runtime
	help
	  Capture the outcome of Python function calls.

	  https://github.com/python-trio/outcome
```

## package/python-packaging/Config.in
```kconfig
config BR2_PACKAGE_PYTHON_PACKAGING
	bool "python-packaging"
	help
	  Core utilities for Python packages.

	  https://github.com/pypa/packaging
```

## package/python-paramiko/Config.in
```kconfig
config BR2_PACKAGE_PYTHON_PARAMIKO
	bool "python-paramiko"
	depends on BR2_PACKAGE_HOST_RUSTC_TARGET_ARCH_SUPPORTS # python-cryptography
	depends on BR2_PACKAGE_PYTHON3 # python-bcrypt, python-cryptography, python-pynacl
	select BR2_PACKAGE_PYTHON_BCRYPT # runtime
	select BR2_PACKAGE_PYTHON_CRYPTOGRAPHY # runtime
	select BR2_PACKAGE_PYTHON_PYNACL # runtime
	select BR2_PACKAGE_PYTHON3_ZLIB # runtime
	help
	  SSH2 protocol library.

	  https://github.com/paramiko/paramiko/
```

## package/python-parso/Config.in
```kconfig
config BR2_PACKAGE_PYTHON_PARSO
	bool "python-parso"
	depends on BR2_PACKAGE_PYTHON3
	help
	  A Python Parser.

	  https://github.com/davidhalter/parso
```

## package/python-patch-ng/Config.in
```kconfig
config BR2_PACKAGE_PYTHON_PATCH_NG
	bool "python-patch-ng"
	help
	  Library to parse and apply unified diffs.

	  https://github.com/conan-io/python-patch
```

## package/python-path/Config.in
```kconfig
config BR2_PACKAGE_PYTHON_PATH
	bool "python-path"
	help
	  Object-oriented file system path manipulation.

	  https://github.com/jaraco/path
```

## package/python-pathspec/Config.in
```kconfig
config BR2_PACKAGE_PYTHON_PATHSPEC
	bool "python-pathspec"
	help
	  pathspec is a utility library for pattern matching of file
	  paths.

	  https://github.com/cpburnz/python-pathspec
```

## package/python-pathvalidate/Config.in
```kconfig
config BR2_PACKAGE_PYTHON_PATHVALIDATE
	bool "python-pathvalidate"
	depends on BR2_PACKAGE_PYTHON3
	help
	  pathvalidate is a python library to validate/sanitize a string
	  such as filename/variable-name.

	  https://github.com/thombashi/pathvalidate
```

## package/python-pickleshare/Config.in
```kconfig
config BR2_PACKAGE_PYTHON_PICKLESHARE
	bool "python-pickleshare"
	help
	  Tiny 'shelve'-like database with concurrency support

	  https://pypi.python.org/pypi/pickleshare
```

## package/python-pillow/Config.in
```kconfig
config BR2_PACKAGE_PYTHON_PILLOW
	bool "python-pillow"
	depends on BR2_INSTALL_LIBSTDCPP # python-pybind
	select BR2_PACKAGE_PYTHON3_PYEXPAT # runtime
	select BR2_PACKAGE_PYTHON3_ZLIB
	select BR2_PACKAGE_PYTHON_PYBIND
	help
	  Pillow is the "friendly" PIL fork by Alex Clark and
	  Contributors. PIL is the Python Imaging Library by Fredrik
	  Lundh and Contributors.

	  Pillow relies on external libraries to provide support
	  various image formats. Select the corresponding package(s)
	  to get this support. Pillow can use jpeg, zlib (for PNG),
	  tiff, freetype, webp, and openjpeg (JPEG-2000).

	  https://pypi.python.org/pypi/Pillow/

comment "python-pillow needs a toolchain w/ C++"
	depends on !BR2_INSTALL_LIBSTDCPP
```

## package/python-pip/Config.in
```kconfig
config BR2_PACKAGE_PYTHON_PIP
	bool "python-pip"
	depends on BR2_PACKAGE_PYTHON3
	select BR2_PACKAGE_PYTHON_SETUPTOOLS # runtime
	select BR2_PACKAGE_PYTHON3_SSL
	help
	  The PyPA recommended tool for installing Python packages.

	  https://pip.pypa.io/
```

## package/python-platformdirs/Config.in
```kconfig
config BR2_PACKAGE_PYTHON_PLATFORMDIRS
	bool "python-platformdirs"
	help
	  A small Python package for determining appropriate
	  platform-specific dirs, e.g. a "user data dir".

	  https://github.com/tox-dev/platformdirs
```

## package/python-priority/Config.in
```kconfig
config BR2_PACKAGE_PYTHON_PRIORITY
	bool "python-priority"
	depends on BR2_PACKAGE_PYTHON3
	help
	  A pure-Python implementation of the HTTP/2 priority tree.

	  http://python-hyper.org/priority/
```

## package/python-prompt-toolkit/Config.in
```kconfig
config BR2_PACKAGE_PYTHON_PROMPT_TOOLKIT
	bool "python-prompt-toolkit"
	select BR2_PACKAGE_PYTHON_SIX # runtime
	select BR2_PACKAGE_PYTHON_WCWIDTH # runtime
	select BR2_PACKAGE_PYTHON3_PYEXPAT # runtime
	help
	  Library for building powerful interactive command lines in
	  Python.

	  https://github.com/prompt-toolkit/python-prompt-toolkit
```

## package/python-propcache/Config.in
```kconfig
config BR2_PACKAGE_PYTHON_PROPCACHE
	bool "python-propcache"
	help
	  Accelerated property cache.

	  https://github.com/aio-libs/propcache
```

## package/python-proto-plus/Config.in
```kconfig
config BR2_PACKAGE_PYTHON_PROTO_PLUS
	bool "python-proto-plus"
	depends on BR2_PACKAGE_HOST_PROTOBUF_ARCH_SUPPORTS
	select BR2_PACKAGE_PYTHON_PROTOBUF # runtime
	help
	  Beautiful, Pythonic protocol buffers.

	  https://github.com/googleapis/proto-plus-python
```

## package/python-protobuf/Config.in
```kconfig
config BR2_PACKAGE_PYTHON_PROTOBUF
	bool "python-protobuf"
	# host-protobuf only builds on certain architectures
	depends on BR2_PACKAGE_HOST_PROTOBUF_ARCH_SUPPORTS
	select BR2_PACKAGE_PYTHON_SIX # runtime
	help
	  Python implementation of the Google Protocol Buffers.

	  Protocol buffers are Google's language-neutral,
	  platform-neutral, extensible mechanism for serializing
	  structured data.

	  https://developers.google.com/protocol-buffers
```

## package/python-psycopg2/Config.in
```kconfig
config BR2_PACKAGE_PYTHON_PSYCOPG2
	bool "python-psycopg2"
	depends on BR2_USE_MMU # postgresql
	depends on BR2_USE_WCHAR # postgresql
	depends on BR2_ENABLE_LOCALE # postgresql
	depends on BR2_TOOLCHAIN_HAS_THREADS_NPTL # postgresql
	depends on !BR2_STATIC_LIBS # postgresql
	depends on !BR2_OPTIMIZE_FAST # postgresql
	select BR2_PACKAGE_POSTGRESQL
	help
	  Psycopg is the most popular PostgreSQL database adapter for
	  the Python programming language. Its main features are the
	  complete implementation of the Python DB API 2.0 specification
	  and the thread safety (several threads can share the same
	  connection). It was designed for heavily multi-threaded
	  applications that create and destroy lots of cursors and make
	  a large number of concurrent INSERTs or UPDATEs.

	  Psycopg 2 is mostly implemented in C as a libpq wrapper,
	  resulting in being both efficient and secure. It features
	  client-side and server-side cursors, asynchronous
	  communication and notifications, COPY support. Many Python
	  types are supported out-of-the-box and adapted to matching
	  PostgreSQL data types; adaptation can be extended and
	  customized thanks to a flexible objects adaptation system.
	  Psycopg 2 is both Unicode and Python 3 friendly.

	  https://github.com/psycopg/psycopg2/

comment "python-psycopg2 needs a toolchain w/ dynamic library, wchar"
	depends on BR2_USE_MMU
	depends on BR2_STATIC_LIBS || !BR2_USE_WCHAR

comment "python-psycopg2 can't be built with Optimize for fast"
	depends on BR2_OPTIMIZE_FAST
```

## package/python-psygnal/Config.in
```kconfig
config BR2_PACKAGE_PYTHON_PSYGNAL
	bool "python-psygnal"
	help
	  Python observer pattern (callback/event system).

	  https://github.com/pyapp-kit/psygnal
```

## package/python-pure-eval/Config.in
```kconfig
config BR2_PACKAGE_PYTHON_PURE_EVAL
	bool "python-pure-eval"
	help
	  Safely evaluate AST nodes without side effects.

	  http://github.com/alexmojaki/pure_eval
```

## package/python-pure_eval/Config.in
```kconfig
config BR2_PACKAGE_PYTHON_PURE_EVAL
	bool "python-pure_eval"
	help
	This is a Python package that lets you safely evaluate certain AST nodes without
	triggering arbitrary code that may have unwanted side effects.

	  https://github.com/alexmojaki/pure_eval
```

## package/python-py/Config.in
```kconfig
config BR2_PACKAGE_PYTHON_PY
	bool "python-py"
	depends on BR2_PACKAGE_PYTHON3 # host-python-setuptools-scm
	help
	  library with cross-python path, ini-parsing, io, code, log
	  facilities.

	  http://py.readthedocs.io/
```

## package/python-pyaml/Config.in
```kconfig
config BR2_PACKAGE_PYTHON_PYAML
	bool "python-pyaml"
	select BR2_PACKAGE_PYTHON_PYYAML # runtime
	help
	  PyYAML-based module to produce a bit more pretty and
	  readable YAML-serialized data.

	  https://github.com/mk-fg/pretty-yaml
```

## package/python-pyasynchat/Config.in
```kconfig
config BR2_PACKAGE_PYTHON_PYASYNCHAT
	bool "python-pyasynchat"
	select BR2_PACKAGE_PYTHON_PYASYNCORE # runtime
	help
	  Make asynchat available for Python 3.12 onwards.

	  This is a compatibility package using the code removed from
	  the standard library, upstream does not intend any
	  maintenance.

	  https://github.com/simonrob/pyasynchat
```

## package/python-pyasyncore/Config.in
```kconfig
config BR2_PACKAGE_PYTHON_PYASYNCORE
	bool "python-pyasyncore"
	help
	  Make asyncore available for Python 3.12 onwards.

	  This is a compatibility package using the code removed from
	  the standard library, upstream does not intend any
	  maintenance.

	  https://github.com/simonrob/pyasyncore
```
