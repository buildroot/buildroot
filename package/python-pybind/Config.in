## package/python-pybind/Config.in
```kconfig
config BR2_PACKAGE_PYTHON_PYBIND
	bool "python-pybind"
	depends on BR2_INSTALL_LIBSTDCPP
	help
	  PyBind is a lightweight header-only library that exposes C++
	  types in Python and vice versa, mainly to create Python
	  bindings of existing C++ code.

	  http://pybind11.readthedocs.org/en/master

comment "python-pybind needs a toolchain w/ C++"
	depends on !BR2_INSTALL_LIBSTDCPP
```

## package/python-pybleno/Config.in
```kconfig
config BR2_PACKAGE_PYTHON_PYBLENO
	bool "python-pybleno"
	help
	  A direct port of the Bleno bluetooth LE peripheral role
	  library to Python2/3.

	  https://github.com/Adam-Langley/pybleno
```

## package/python-pycares/Config.in
```kconfig
config BR2_PACKAGE_PYTHON_PYCARES
	bool "python-pycares"
	select BR2_PACKAGE_PYTHON_CFFI # runtime
	help
	  Python interface for c-ares.

	  http://github.com/saghul/pycares
```

## package/python-pycrate/Config.in
```kconfig
config BR2_PACKAGE_PYTHON_PYCRATE
	bool "python-pycrate"
	help
	  A software suite to handle various data and protocol
	  formats.

	  https://github.com/pycrate-org/pycrate/
```

## package/python-pycryptodomex/Config.in
```kconfig
config BR2_PACKAGE_PYTHON_PYCRYPTODOMEX
	bool "python-pycryptodomex"
	help
	  Cryptographic library for Python.

	  https://www.pycryptodome.org
```

## package/python-pycups/Config.in
```kconfig
config BR2_PACKAGE_PYTHON_PYCUPS
	bool "python-pycups"
	depends on BR2_PACKAGE_CUPS
	help
	  Python bindings for libcups.

	  https://github.com/zdohnal/pycups
```

## package/python-pydantic-core/Config.in
```kconfig
config BR2_PACKAGE_PYTHON_PYDANTIC_CORE
	bool "python-pydantic-core"
	depends on BR2_PACKAGE_HOST_RUSTC_TARGET_ARCH_SUPPORTS
	select BR2_PACKAGE_PYTHON_TYPING_EXTENSIONS # runtime
	help
	  Core functionality for Pydantic validation and
	  serialization.

	  https://github.com/pydantic/pydantic-core
```

## package/python-pydantic-settings/Config.in
```kconfig
config BR2_PACKAGE_PYTHON_PYDANTIC_SETTINGS
	bool "python-pydantic-settings"
	depends on BR2_PACKAGE_HOST_RUSTC_TARGET_ARCH_SUPPORTS # python-pydantic -> python-pydantic-core
	select BR2_PACKAGE_PYTHON_DOTENV # runtime
	select BR2_PACKAGE_PYTHON_PYDANTIC # runtime
	help
	  Settings management using Pydantic.

	  https://github.com/pydantic/pydantic-settings
```

## package/python-pydantic/Config.in
```kconfig
config BR2_PACKAGE_PYTHON_PYDANTIC
	bool "python-pydantic"
	depends on BR2_PACKAGE_HOST_RUSTC_TARGET_ARCH_SUPPORTS # python-pydantic-core
	select BR2_PACKAGE_PYTHON_ANNOTATED_TYPES # runtime
	select BR2_PACKAGE_PYTHON_PYDANTIC_CORE # runtime
	select BR2_PACKAGE_PYTHON_TYPING_EXTENSIONS # runtime
	select BR2_PACKAGE_PYTHON_TYPING_INSPECTION # runtime
	help
	  Data validation using Python type hints.

	  https://github.com/pydantic/pydantic
```

## package/python-pydevmem/Config.in
```kconfig
config BR2_PACKAGE_PYTHON_PYDEVMEM
	bool "python-pydevmem"
	help
	  Python DevMem is designed primarily for use with accessing
	  /dev/mem on OMAP platforms. It should work on other platforms
	  and work to mmap() files rather then just /dev/mem, but these
	  use cases aren't well tested.

	  https://github.com/kylemanna/pydevmem
```

## package/python-pydyf/Config.in
```kconfig
config BR2_PACKAGE_PYTHON_PYDYF
	bool "python-pydyf"
	help
	  A low-level PDF generator.

	  https://www.courtbouillon.org/pydyf
```

## package/python-pyftpdlib/Config.in
```kconfig
config BR2_PACKAGE_PYTHON_PYFTPDLIB
	bool "python-pyftpdlib"
	select BR2_PACKAGE_PYTHON_PYASYNCHAT # runtime
	select BR2_PACKAGE_PYTHON_PYASYNCORE # runtime
	help
	  Extremely fast and scalable Python FTP server library.

	  https://github.com/giampaolo/pyftpdlib
```

## package/python-pyhamcrest/Config.in
```kconfig
config BR2_PACKAGE_PYTHON_PYHAMCREST
	bool "python-pyhamcrest"
	help
	  Hamcrest framework for matcher objects.

	  https://github.com/hamcrest/PyHamcrest
```

## package/python-pylibfdt/Config.in
```kconfig
config BR2_PACKAGE_PYTHON_PYLIBFDT
	bool "python-pylibfdt"
	help
	  Python bindings for the Device Tree Compiler (dtc) toolchain.

	  https://github.com/devicetree-org/pylibfdt
```

## package/python-pymemcache/Config.in
```kconfig
config BR2_PACKAGE_PYTHON_PYMEMCACHE
	bool "python-pymemcache"
	select BR2_PACKAGE_PYTHON_SETUPTOOLS_SCM
	select BR2_PACKAGE_PYTHON_SIX
	depends on BR2_arm
	help
	  A comprehensive, fast, pure-Python memcached client.

	  https://github.com/pinterest/pymemcache
```

## package/python-pymodbus/Config.in
```kconfig
config BR2_PACKAGE_PYTHON_PYMODBUS
	bool "python-pymodbus"
	help
	  A fully featured modbus protocol stack in python.

	  https://github.com/pymodbus-dev/pymodbus/
```

## package/python-pymupdf/Config.in
```kconfig
config BR2_PACKAGE_PYTHON_PYMUPDF
	bool "python-pymupdf"
	depends on BR2_INSTALL_LIBSTDCPP # mupdf -> harfbuzz
	depends on BR2_TOOLCHAIN_HAS_SYNC_4 # mupdf -> harfbuzz
	depends on BR2_TOOLCHAIN_GCC_AT_LEAST_4_9 # mupdf -> harfbuzz
	depends on !BR2_STATIC_LIBS # runtime failure
	select BR2_PACKAGE_HOST_SWIG
	select BR2_PACKAGE_FREETYPE
	select BR2_PACKAGE_MUPDF
	select BR2_PACKAGE_PYTHON3_ZLIB # runtime
	help
	  Python bindings for the PDF rendering library MuPDF.

	  https://github.com/pymupdf/PyMuPDF

comment "python-pymupdf needs a toolchain w/ C++, gcc >= 4.9, dynamic library"
	depends on BR2_TOOLCHAIN_HAS_SYNC_4
	depends on !BR2_INSTALL_LIBSTDCPP || \
		!BR2_TOOLCHAIN_GCC_AT_LEAST_4_9 || \
		BR2_STATIC_LIBS
```

## package/python-pynacl/Config.in
```kconfig
config BR2_PACKAGE_PYTHON_PYNACL
	bool "python-pynacl"
	select BR2_PACKAGE_PYTHON_CFFI # runtime
	select BR2_PACKAGE_LIBSODIUM
	help
	  Python binding to the Networking and Cryptography (NaCl)
	  library.

	  https://pypi.python.org/pypi/PyNaCl
```

## package/python-pyndiff/Config.in
```kconfig
config BR2_PACKAGE_PYTHON_PYNDIFF
	bool "python-pyndiff"
	select BR2_PACKAGE_PYTHON_XMLJSON # runtime
	select BR2_PACKAGE_PYTHON_SETUPTOOLS # runtime
	help
	  Generate human-readable ndiff output when comparing 2 Nmap
	  XML scan files.

	  https://github.com/rackerlabs/pyndiff
```

## package/python-pyopenssl/Config.in
```kconfig
config BR2_PACKAGE_PYTHON_PYOPENSSL
	bool "python-pyopenssl"
	depends on BR2_PACKAGE_HOST_RUSTC_TARGET_ARCH_SUPPORTS # python-cryptography
	select BR2_PACKAGE_PYTHON_CRYPTOGRAPHY # runtime
	help
	  Python wrapper module around the OpenSSL library.

	  https://github.com/pyca/pyopenssl
```

## package/python-pyparted/Config.in
```kconfig
config BR2_PACKAGE_PYTHON_PYPARTED
	bool "python-pyparted"
	depends on BR2_ENABLE_LOCALE # parted
	depends on BR2_TOOLCHAIN_GCC_AT_LEAST_5 # parted
	depends on BR2_USE_WCHAR
	select BR2_PACKAGE_PARTED
	help
	  Python bindings for GNU parted (libparted).

	  https://github.com/rhinstaller/pyparted

comment "pyparted needs a toolchain w/ locale, wchar, gcc >= 5"
	depends on !BR2_ENABLE_LOCALE || !BR2_USE_WCHAR || \
		!BR2_TOOLCHAIN_GCC_AT_LEAST_5
```

## package/python-pyphen/Config.in
```kconfig
config BR2_PACKAGE_PYTHON_PYPHEN
	bool "python-pyphen"
	help
	  Pure Python module to hyphenate text.

	  https://www.courtbouillon.org/pyphen
```

## package/python-pypika-tortoise/Config.in
```kconfig
config BR2_PACKAGE_PYTHON_PYPIKA_TORTOISE
	bool "python-pypika-tortoise"
	help
	  Forked from pypika and streamline just for tortoise-orm.

	  https://github.com/tortoise/pypika-tortoise
```

## package/python-pypng/Config.in
```kconfig
config BR2_PACKAGE_PYTHON_PYPNG
	bool "python-pypng"
	select BR2_PACKAGE_PYTHON3_ZLIB # runtime
	help
	  Pure Python library for saving and loading PNG images.

	  https://gitlab.com/drj11/pypng
```

## package/python-pyproj/Config.in
```kconfig
config BR2_PACKAGE_PYTHON_PYPROJ
	bool "python-pyproj"
	depends on BR2_INSTALL_LIBSTDCPP # proj
	depends on BR2_TOOLCHAIN_GCC_AT_LEAST_4_7 # proj
	depends on BR2_TOOLCHAIN_HAS_THREADS_NPTL # proj
	depends on BR2_USE_WCHAR # proj
	select BR2_PACKAGE_PYTHON_CERTIFI # runtime
	select BR2_PACKAGE_PROJ # runtime
	help
	  Python interface to PROJ (cartographic projections and
	  coordinate transformations library).

	  https://github.com/pyproj4/pyproj

comment "python-pyproj needs a toolchain w/ C++, gcc >= 4.7, NPTL, wchar"
	depends on !BR2_INSTALL_LIBSTDCPP || \
		!BR2_TOOLCHAIN_GCC_AT_LEAST_4_7 || \
		!BR2_TOOLCHAIN_HAS_THREADS_NPTL || !BR2_USE_WCHAR
```
