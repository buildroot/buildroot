## package/parsec/Config.in
```kconfig
config BR2_PACKAGE_PARSEC
	bool "parsec"
	depends on BR2_PACKAGE_HOST_RUSTC_TARGET_ARCH_SUPPORTS
	select BR2_PACKAGE_HOST_RUSTC
	help
	  Hardware/platform abstraction service for TPMs, HSMs, and
	  Root of Trust
	  PARSEC is the Platform AbstRaction for SECurity, an
	  open-source initiative to provide a common API to hardware
	  security and cryptographic services in a platform-agnostic
	  way. This abstraction layer keeps workloads decoupled from
	  physical platform details, enabling cloud-native delivery
	  flows within the data center and at the edge.

	  https://github.com/parallaxsecond/parsec.git
```

## package/parted/Config.in
```kconfig
config BR2_PACKAGE_PARTED
	bool "parted"
	depends on BR2_ENABLE_LOCALE
	depends on BR2_USE_WCHAR
	depends on BR2_TOOLCHAIN_GCC_AT_LEAST_5
	select BR2_PACKAGE_UTIL_LINUX
	select BR2_PACKAGE_UTIL_LINUX_LIBUUID
	help
	  parted, the GNU partition resizing program

	  http://www.gnu.org/software/parted/

comment "parted needs a toolchain w/ locale, wchar, gcc >=5"
	depends on !BR2_ENABLE_LOCALE || !BR2_USE_WCHAR || \
		!BR2_TOOLCHAIN_GCC_AT_LEAST_5
```

## package/passt/Config.in
```kconfig
config BR2_PACKAGE_PASST
	bool "passt"
	help
	  passt: Plug A Simple Socket Transport
	  pasta: Pack A Subtle Tap Abstraction

	  passt implements a translation layer between a Layer-2
	  network interface and native Layer-4 sockets (TCP, UDP,
	  ICMP/ICMPv6 echo) on a host. It doesn't require any
	  capabilities or privileges, and it can be used as a simple
	  replacement for Slirp.

	  pasta (same binary as passt, different command) offers
	  equivalent functionality, for network namespaces: traffic
	  is forwarded using a tap interface inside the namespace,
	  without the need to create further interfaces on the host,
	  hence not requiring any capabilities or privileges.

	  https://passt.top/passt/about/
```

## package/paxtest/Config.in
```kconfig
config BR2_PACKAGE_PAXTEST
	bool "paxtest"
	depends on !BR2_microblaze
	# No UCLIBC or MUSL because __NO_A_OUT_SUPPORT
	depends on BR2_TOOLCHAIN_USES_GLIBC
	help
	  PaX regression test suite

	  http://pax.grsecurity.net/docs

comment "paxtest needs a glibc toolchain"
	depends on !BR2_microblaze
	depends on !BR2_TOOLCHAIN_USES_GLIBC
```

## package/pciutils/Config.in
```kconfig
config BR2_PACKAGE_PCIUTILS
	bool "pciutils"
	help
	  Various utilities dealing with the PCI bus.
	  Provides things like setpci and lspci.

	  https://mj.ucw.cz/sw/pciutils/
```

## package/pcm-tools/Config.in
```kconfig
comment "pcm-tools needs a toolchain w/ C++, NPTL"
	depends on BR2_i386 || BR2_x86_64
	depends on !BR2_INSTALL_LIBSTDCPP || \
		!BR2_TOOLCHAIN_HAS_THREADS_NPTL

config BR2_PACKAGE_PCM_TOOLS
	bool "pcm-tools"
	depends on BR2_i386 || BR2_x86_64
	depends on BR2_INSTALL_LIBSTDCPP
	depends on BR2_TOOLCHAIN_HAS_THREADS_NPTL
	select BR2_PACKAGE_HWDATA
	select BR2_PACKAGE_HWDATA_PCI_IDS
	help
	  Processor Counter Monitor (PCM) is an application programming
	  interface (API) and a set of tools based on the API to monitor
	  performance and energy metrics of Intel(R) Core(TM), Xeon(R),
	  Atom(TM) and Xeon Phi(TM) processors.

	  https://github.com/opcm/pcm

if BR2_PACKAGE_PCM_TOOLS

config BR2_PACKAGE_PCM_TOOLS_PMU_QUERY
	bool "install the pmu-query script"
	default y
	depends on BR2_PACKAGE_PYTHON3
	select BR2_PACKAGE_CA_CERTIFICATES # https
	select BR2_PACKAGE_PYTHON3_SSL # urllib2

comment "pmu-query needs Python3"
	depends on !BR2_PACKAGE_PYTHON3

endif
```

## package/pcmanfm/Config.in
```kconfig
config BR2_PACKAGE_PCMANFM
	bool "pcmanfm"
	depends on BR2_PACKAGE_HOST_RUSTC_ARCH_SUPPORTS # libfm
	depends on BR2_USE_WCHAR # libfm
	depends on BR2_TOOLCHAIN_HAS_THREADS # libfm
	depends on BR2_USE_MMU # libfm
	depends on BR2_INSTALL_LIBSTDCPP # libfm
	depends on BR2_TOOLCHAIN_HAS_SYNC_4 # libfm
	depends on BR2_TOOLCHAIN_GCC_AT_LEAST_4_9 # libfm
	depends on BR2_PACKAGE_HAS_LIBEGL || BR2_PACKAGE_HAS_LIBGL # libfm
	depends on BR2_PACKAGE_XORG7 # libfm
	depends on BR2_PACKAGE_HAS_LIBGL # libfm
	select BR2_PACKAGE_LIBFM
	select BR2_PACKAGE_MENU_CACHE
	select BR2_PACKAGE_LIBGLIB2
	select BR2_PACKAGE_LIBGTK3
	select BR2_PACKAGE_LIBGTK3_X11
	help
	  PCMan File Manager (PCManFM) is a file manager application
	  developed by Hong Jen Yee from Taiwan which is meant to be a
	  replacement for Nautilus, Konqueror and Thunar.

	  http://wiki.lxde.org/en/PCManFM

comment "pcmanfm a toolchain w/ wchar, threads, C++, gcc >= 4.9"
	depends on BR2_PACKAGE_HOST_RUSTC_ARCH_SUPPORTS
	depends on BR2_USE_MMU
	depends on BR2_TOOLCHAIN_HAS_SYNC_4
	depends on !BR2_USE_WCHAR || !BR2_TOOLCHAIN_HAS_THREADS || \
		!BR2_INSTALL_LIBSTDCPP || !BR2_TOOLCHAIN_GCC_AT_LEAST_4_9

comment "pcmanfm needs X.org with an OpenGL backend"
	depends on BR2_PACKAGE_HOST_RUSTC_ARCH_SUPPORTS
	depends on BR2_USE_MMU
	depends on BR2_TOOLCHAIN_HAS_SYNC_4
	depends on !BR2_PACKAGE_XORG7 || BR2_PACKAGE_HAS_LIBGL
```

## package/peervpn/Config.in
```kconfig
config BR2_PACKAGE_PEERVPN
	bool "peervpn"
	depends on BR2_USE_MMU # fork()
	depends on BR2_PACKAGE_OPENSSL
	select BR2_PACKAGE_ZLIB
	help
	  PeerVPN is a software that builds virtual ethernet networks
	  between multiple computers.

	  A virtual network built by PeerVPN uses a full mesh topology.
	  All nodes talk directly to each other, there is no need for a
	  central server. If one node goes down, the rest of the network
	  is unaffected.

	  https://peervpn.net/
```

## package/perftest/Config.in
```kconfig
config BR2_PACKAGE_PERFTEST_ARCH_SUPPORTS
	bool
	# Accurate cycle measurement in perftest is implemented for a
	# limited set of architectures, see:
	# https://github.com/linux-rdma/perftest/blob/v4.5-0.20/src/get_clock.h
	# Note: the package has also a fallback to use "asm/timex.h"
	# from the Kernel, in
	# "$(LINUX_DIR)/arch/$(KERNEL_ARCH)/include". It is not
	# reflected here as this path is not well tested.
	default y if BR2_i386 || BR2_x86_64
	default y if BR2_arm && !BR2_ARM_CPU_ARMV4 && !BR2_ARM_CPU_ARMV5 && !BR2_ARM_CPU_ARMV6
	default y if BR2_aarch64
	default y if BR2_powerpc || BR2_powerpc64 || BR2_powerpc64le
	default y if BR2_s390x
	default y if BR2_sparc || BR2_sparc64
	default y if BR2_riscv
	depends on BR2_USE_MMU # rdma-core
	depends on BR2_TOOLCHAIN_HAS_SYNC_4 # rdma-core

config BR2_PACKAGE_PERFTEST
	bool "perftest"
	depends on BR2_PACKAGE_PERFTEST_ARCH_SUPPORTS
	depends on BR2_TOOLCHAIN_HEADERS_AT_LEAST_3_4 # rdma-core
	depends on BR2_TOOLCHAIN_HAS_THREADS_NPTL # rdma-core
	depends on !BR2_STATIC_LIBS # rdma-core
	# musl does not define sysconf(_SC_LEVEL1_DCACHE_LINESIZE)
	depends on !BR2_TOOLCHAIN_USES_MUSL
	select BR2_PACKAGE_PCIUTILS
	select BR2_PACKAGE_RDMA_CORE
	help
	  Open Fabrics Performance Tests.

	  This is a collection of tests written over uverbs intended
	  for use as a performance micro-benchmark. The tests may be
	  used for HW or SW tuning as well as for functional testing.

	  https://github.com/linux-rdma/perftest

comment "perftest needs a glibc or uClibc toolchain w/ threads, dynamic library"
	depends on BR2_PACKAGE_PERFTEST_ARCH_SUPPORTS
	depends on !BR2_TOOLCHAIN_HAS_THREADS || BR2_STATIC_LIBS \
		|| BR2_TOOLCHAIN_USES_MUSL
```

## package/perl-cgi/Config.in
```kconfig
config BR2_PACKAGE_PERL_CGI
	bool "perl-cgi"
	depends on !BR2_STATIC_LIBS
	select BR2_PACKAGE_PERL_HTML_PARSER # runtime
	select BR2_PACKAGE_PERL_URI # runtime
	help
	  Handle Common Gateway Interface requests and responses.

	  https://metacpan.org/module/CGI

comment "perl-cgi needs a toolchain w/ dynamic library"
	depends on BR2_STATIC_LIBS
```

## package/perl-clone/Config.in
```kconfig
config BR2_PACKAGE_PERL_CLONE
	bool "perl-clone"
	depends on !BR2_STATIC_LIBS
	help
	  recursively copy Perl datatypes.

	  https://metacpan.org/release/Clone

comment "perl-clone needs a toolchain w/ dynamic library"
	depends on BR2_STATIC_LIBS
```

## package/perl-crypt-openssl-rsa/Config.in
```kconfig
config BR2_PACKAGE_PERL_CRYPT_OPENSSL_RSA
	bool "perl-crypt-openssl-rsa"
	depends on !BR2_STATIC_LIBS
	select BR2_PACKAGE_OPENSSL
	select BR2_PACKAGE_PERL_CRYPT_OPENSSL_RANDOM # runtime
	select BR2_PACKAGE_LIBOPENSSL_ENABLE_RMD160 if BR2_PACKAGE_LIBOPENSSL
	help
	  RSA encoding and decoding, using the openSSL libraries.

	  http://github.com/toddr/Crypt-OpenSSL-RSA

comment "perl-crypt-openssl-rsa needs a toolchain w/ dynamic library"
	depends on BR2_STATIC_LIBS
```

## package/perl-digest-hmac/Config.in
```kconfig
config BR2_PACKAGE_PERL_DIGEST_HMAC
	bool "perl-digest-hmac"
	help
	  Keyed-Hashing for Message Authentication.

	  http://metacpan.org/release/Digest-HMAC
```

## package/perl-exporter-tiny/Config.in
```kconfig
config BR2_PACKAGE_PERL_EXPORTER_TINY
	bool "perl-exporter-tiny"
	help
	  an exporter with the features of Sub::Exporter but only core
	  dependencies.

	  https://exportertiny.github.io/
```

## package/perl-html-parser/Config.in
```kconfig
config BR2_PACKAGE_PERL_HTML_PARSER
	bool "perl-html-parser"
	depends on !BR2_STATIC_LIBS
	select BR2_PACKAGE_PERL_HTML_TAGSET # runtime
	select BR2_PACKAGE_PERL_HTTP_MESSAGE # runtime
	select BR2_PACKAGE_PERL_URI # runtime
	help
	  HTML parser class.

	  https://github.com/libwww-perl/HTML-Parser

comment "perl-html-parser needs a toolchain w/ dynamic library"
	depends on BR2_STATIC_LIBS
```

## package/perl-http-cookies/Config.in
```kconfig
config BR2_PACKAGE_PERL_HTTP_COOKIES
	bool "perl-http-cookies"
	depends on !BR2_STATIC_LIBS # perl-http-message -> perl-clone
	select BR2_PACKAGE_PERL_HTTP_DATE # runtime
	select BR2_PACKAGE_PERL_HTTP_MESSAGE # runtime
	help
	  HTTP cookie jars.

	  https://github.com/libwww-perl/HTTP-Cookies

comment "perl-http-cookies needs a toolchain w/ dynamic library"
	depends on BR2_STATIC_LIBS
```

## package/perl-http-daemon/Config.in
```kconfig
config BR2_PACKAGE_PERL_HTTP_DAEMON
	bool "perl-http-daemon"
	depends on !BR2_STATIC_LIBS # perl-http-message -> perl-clone
	select BR2_PACKAGE_PERL_HTTP_DATE # runtime
	select BR2_PACKAGE_PERL_HTTP_MESSAGE # runtime
	select BR2_PACKAGE_PERL_LWP_MEDIATYPES # runtime
	help
	  A simple http server class.

	  https://github.com/libwww-perl/HTTP-Daemon

comment "perl-http-daemon needs a toolchain w/ dynamic library"
	depends on BR2_STATIC_LIBS
```

## package/perl-http-message/Config.in
```kconfig
config BR2_PACKAGE_PERL_HTTP_MESSAGE
	bool "perl-http-message"
	depends on !BR2_STATIC_LIBS # perl-clone
	select BR2_PACKAGE_PERL_CLONE # runtime
	select BR2_PACKAGE_PERL_ENCODE_LOCALE # runtime
	select BR2_PACKAGE_PERL_HTTP_DATE # runtime
	select BR2_PACKAGE_PERL_IO_HTML # runtime
	select BR2_PACKAGE_PERL_LWP_MEDIATYPES # runtime
	select BR2_PACKAGE_PERL_URI # runtime
	help
	  HTTP style message (base class).

	  https://github.com/libwww-perl/HTTP-Message

comment "perl-http-message needs a toolchain w/ dynamic library"
	depends on BR2_STATIC_LIBS
```

## package/perl-http-negotiate/Config.in
```kconfig
config BR2_PACKAGE_PERL_HTTP_NEGOTIATE
	bool "perl-http-negotiate"
	depends on !BR2_STATIC_LIBS # perl-http-message -> perl-clone
	select BR2_PACKAGE_PERL_HTTP_MESSAGE # runtime
	help
	  choose a variant to serve.

	  https://metacpan.org/release/HTTP-Negotiate

comment "perl-http-negotiate needs a toolchain w/ dynamic library"
	depends on BR2_STATIC_LIBS
```

## package/perl-image-exiftool/Config.in
```kconfig
config BR2_PACKAGE_PERL_IMAGE_EXIFTOOL
	bool "perl-image-exiftool"
	help
	  ExifTool is a customizable set of Perl modules plus a
	  full-featured command-line application for reading and writing
	  meta information in a wide variety of image files.

	  https://metacpan.org/release/Image-ExifTool
```

## package/perl-mime-base32/Config.in
```kconfig
config BR2_PACKAGE_PERL_MIME_BASE32
	bool "perl-mime-base32"
	help
	  Base32 encoder and decoder.

	  https://metacpan.org/release/MIME-Base32
```

## package/perl-mojolicious-plugin-authentication/Config.in
```kconfig
config BR2_PACKAGE_PERL_MOJOLICIOUS_PLUGIN_AUTHENTICATION
	bool "perl-mojolicious-plugin-authentication"
	select BR2_PACKAGE_PERL_MOJOLICIOUS # runtime
	help
	  A plugin to make authentication a bit easier.

	  https://github.com/benvanstaveren/Mojolicious-Plugin-Authentication
```

## package/perl-plack/Config.in
```kconfig
config BR2_PACKAGE_PERL_PLACK
	bool "perl-plack"
	depends on !BR2_STATIC_LIBS # perl-http-message -> perl-clone
	select BR2_PACKAGE_PERL_APACHE_LOGFORMAT_COMPILER # runtime
	select BR2_PACKAGE_PERL_COOKIE_BAKER # runtime
	select BR2_PACKAGE_PERL_DEVEL_STACKTRACE # runtime
	select BR2_PACKAGE_PERL_DEVEL_STACKTRACE_ASHTML # runtime
	select BR2_PACKAGE_PERL_FILE_SHAREDIR # runtime
	select BR2_PACKAGE_PERL_FILESYS_NOTIFY_SIMPLE # runtime
	select BR2_PACKAGE_PERL_HTTP_ENTITY_PARSER # runtime
	select BR2_PACKAGE_PERL_HTTP_HEADERS_FAST # runtime
	select BR2_PACKAGE_PERL_HTTP_MESSAGE # runtime
	select BR2_PACKAGE_PERL_HASH_MULTIVALUE # runtime
	select BR2_PACKAGE_PERL_STREAM_BUFFERED # runtime
	select BR2_PACKAGE_PERL_TRY_TINY # runtime
	select BR2_PACKAGE_PERL_URI # runtime
	select BR2_PACKAGE_PERL_WWW_FORM_URLENCODED # runtime
	help
	  Perl Superglue for Web frameworks and Web Servers (PSGI
	  toolkit).

	  https://github.com/plack/Plack

comment "perl-plack needs a toolchain w/ dynamic library"
	depends on BR2_STATIC_LIBS
```

## package/perl-uri/Config.in
```kconfig
config BR2_PACKAGE_PERL_URI
	bool "perl-uri"
	select BR2_PACKAGE_PERL_MIME_BASE32 # runtime
	help
	  Uniform Resource Identifiers (absolute and relative).

	  https://github.com/libwww-perl/URI
```

## package/petitboot/Config.in
```kconfig
config BR2_PACKAGE_PETITBOOT
	bool "petitboot"
	depends on BR2_PACKAGE_KEXEC_ARCH_SUPPORTS || BR2_PACKAGE_KEXEC_LITE_ARCH_SUPPORTS
	depends on BR2_USE_MMU # lvm2
	depends on BR2_USE_WCHAR # elfutils, kexec-lite
	depends on !BR2_STATIC_LIBS # elfutils, kexec-lite, lvm2
	depends on BR2_TOOLCHAIN_HAS_THREADS # elfutils, kexec-lite, lvm2
	depends on BR2_PACKAGE_HAS_UDEV
	depends on BR2_TOOLCHAIN_HEADERS_AT_LEAST_3_17 || !BR2_PACKAGE_KEXEC_ARCH_SUPPORTS # kexec
	select BR2_PACKAGE_ELFUTILS
	select BR2_PACKAGE_LVM2 # devmapper
	select BR2_PACKAGE_NCURSES
	select BR2_PACKAGE_NCURSES_WCHAR
	# run-time dependencies
	select BR2_PACKAGE_KEXEC if !BR2_PACKAGE_KEXEC_LITE_ARCH_SUPPORTS
	select BR2_PACKAGE_KEXEC_LITE if BR2_PACKAGE_KEXEC_LITE_ARCH_SUPPORTS && !BR2_PACKAGE_KEXEC
	select BR2_PACKAGE_NVME if ( BR2_powerpc || BR2_powerpc64 || BR2_powerpc64le )
	select BR2_PACKAGE_POWERPC_UTILS if ( BR2_powerpc || BR2_powerpc64 || BR2_powerpc64le )
	help
	  Petitboot is a small kexec-based bootloader

	  NOTE: petitboot looks best in a UTF-8 locale; be sure there
	  is one listed in BR2_GENERATE_LOCALE.

	  http://www.kernel.org/pub/linux/kernel/people/geoff/petitboot/petitboot.html

if BR2_PACKAGE_PETITBOOT

config BR2_PACKAGE_PETITBOOT_GETTY_PORT
	string "TTY port(s)"
	default "console"
	help
	  Specify a space-separated list of ports to run the petitboot
	  UI on. Wildcards are allowed. Example: "hvc* ttys0 ttyS*"

endif # BR2_PACKAGE_PETITBOOT

comment "petitboot needs a toolchain w/ wchar, dynamic library, threads, udev /dev management"
	depends on BR2_PACKAGE_KEXEC_ARCH_SUPPORTS
	depends on BR2_USE_MMU
	depends on !BR2_USE_WCHAR || BR2_STATIC_LIBS || \
		!BR2_TOOLCHAIN_HAS_THREADS || \
		!BR2_PACKAGE_HAS_UDEV

comment "petitboot w/ kexec needs a toolchain w/ headers >= 3.17"
	depends on BR2_PACKAGE_KEXEC_ARCH_SUPPORTS && !BR2_PACKAGE_KEXEC_LITE_ARCH_SUPPORTS
	depends on !BR2_TOOLCHAIN_HEADERS_AT_LEAST_3_17
```
