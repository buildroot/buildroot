## package/cppsdk/Config.in
```kconfig
config BR2_PACKAGE_CPPSDK
	bool "cppsdk"
	select BR2_PACKAGE_ZLIB
	help
	  Lightweight C++ platform abstraction wrapper classes 
	  to assist C++ developers to build platform abstracted
	  applications. 

	  The library is developed to abstract the Windows OS
	  and the linux OS.

	  Abstractions for Threading, Sockets, Synchronisation,
	  Web/WebSockets etc..

if BR2_PACKAGE_CPPSDK

config BR2_PACKAGE_CPPSDK_DEBUG
	bool "debug"
	default n
	help
	  Build the cppsdk in debug mode. Always usefull to have a
	  partial enabled debug stack.

config BR2_PACKAGE_CPPSDK_DEADLOCK_DETECTION
	bool "deadlock-detection"
	default n
	help
	  Adds tooling to eliminate deadlocks.

config BR2_PACKAGE_CPPSDK_GENERICS
	bool "generics"
	help
	  Base set of platform abstraction wrappers, part opf cppsdk.
	  Minimal set, required to use any part of this library.

config BR2_PACKAGE_CPPSDK_CRYPTALGO
	bool "cryptalgo"
	select BR2_PACKAGE_CPPSDK_GENERICS
	help
	  Functionality to realize crypto algorithms used to encrypt and
	  decrypt contenet in an object oriented design.

config BR2_PACKAGE_CPPSDK_DEVICES
	bool "devices"
	select BR2_PACKAGE_CPPSDK_GENERICS
	help
	  Functionality to handle hardware specific device in an
	  object oriented design.

config BR2_PACKAGE_CPPSDK_TRACING
	bool "tracing"
	select BR2_PACKAGE_CPPSDK_GENERICS
	help
	  Functionality to handle runtime enabling and disabling of 
	  tracing. This is NOT intended for LOGGING !!!

config BR2_PACKAGE_CPPSDK_PROFILER
	bool "profiler"
	select BR2_PACKAGE_CPPSDK_GENERICS
	help
	  Functionality to handle runtime enabling and disabling of 
	  profiler information. This is NOT intended for PRODUCTION !!!

config BR2_PACKAGE_CPPSDK_RPC
	bool "rpc"
	select BR2_PACKAGE_CPPSDK_GENERICS
	help
	  Functionality to allow for RPC easy implementation of marshalling
	  and unmarshalling of data to pass process boundaries.

config BR2_PACKAGE_CPPSDK_MQC
	bool "mqc"
	select BR2_PACKAGE_CPPSDK_GENERICS
	help
	  Functionality to allow for an easy MessageQueue Communication
          transport layer in an object oriented design.

config BR2_PACKAGE_CPPSDK_PROCESS
	bool "process"
	select BR2_PACKAGE_CPPSDK_GENERICS
	select BR2_PACKAGE_CPPSDK_RPC
	help
	  Functionality to start services out of process space.
          Add the additional package (proxystub/process) to be added for out-of-process building.

config BR2_PACKAGE_CPPSDK_WEBSOCKET
	bool "websocket"
	select BR2_PACKAGE_CPPSDK_GENERICS
	select BR2_PACKAGE_CPPSDK_CRYPTALGO
	select BR2_PACKAGE_ZLIB
	help
	  Functionality to handle web communiciation and web socket
	  communication.

config BR2_PACKAGE_CPPSDK_TESTS
	bool "tests"
	default n
	help
	  Build test associated with the CPPSDK.

if BR2_PACKAGE_CPPSDK_TESTS

config BR2_PACKAGE_CPPSDK_TESTS_RASPIO
	bool "raspio"
        depends on BR2_PACKAGE_RPI_USERLAND && BR2_PACKAGE_CPPSDK_DEVICES
	help
	  Tests the GPIO interface in Devices from a C++ sperspective

comment "raspio depends on package devices and needs to be on a raspbberypi."
        depends on !BR2_PACKAGE_RPI_USERLAND ||! BR2_PACKAGE_CPPSDK_DEVICES

config BR2_PACKAGE_CPPSDK_TESTS_NRF24L01
	bool "nrf24l01"
        depends on BR2_PACKAGE_RPI_USERLAND && BR2_PACKAGE_CPPSDK_DEVICES
	help
	  Tests the serial wireless communication device nRF24l01 on a Rasberry Pi SPI.

comment "nrf24l01 depends on package devices and needs to be on a raspbberypi."
        depends on !BR2_PACKAGE_RPI_USERLAND ||! BR2_PACKAGE_CPPSDK_DEVICES

endif

endif
```

## package/cpuinfo/Config.in
```kconfig
config BR2_PACKAGE_CPUINFO_ARCH_SUPPORTS
	bool
	default y if BR2_aarch64
	default y if BR2_arm
	default y if BR2_i386
	default y if BR2_x86_64

config BR2_PACKAGE_CPUINFO
	bool "cpuinfo"
	depends on BR2_PACKAGE_CPUINFO_ARCH_SUPPORTS
	depends on BR2_TOOLCHAIN_HAS_THREADS
	help
	  CPU INFOrmation library, cpuinfo is a library to detect
	  essential for performance optimization information about
	  host CPU.

	  https://github.com/pytorch/cpuinfo

comment "cpuinfo needs a toolchain w/ threads"
	depends on !BR2_TOOLCHAIN_HAS_THREADS
```

## package/cpulimit/Config.in
```kconfig
comment "cpulimit needs a toolchain w/ threads"
	depends on BR2_USE_MMU
	depends on !BR2_TOOLCHAIN_HAS_THREADS

config BR2_PACKAGE_CPULIMIT
	bool "cpulimit"
	depends on BR2_USE_MMU # fork()
	depends on BR2_TOOLCHAIN_HAS_THREADS
	help
	  Cpulimit is a tool which limits the CPU usage of a process
	  (expressed in percentage, not in CPU time)

	  https://github.com/opsengine/cpulimit
```
