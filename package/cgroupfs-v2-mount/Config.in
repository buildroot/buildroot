## package/cgroupfs-v2-mount/Config.in
```kconfig
config BR2_PACKAGE_CGROUPFS_V2_MOUNT
	bool "cgroupfs-v2-mount"
	depends on !BR2_INIT_SYSTEMD
	depends on !BR2_PACKAGE_CGROUPFS_MOUNT
	help
	  Mount the cgroup v2 hierarchy filesystem.

comment "cgroupfs-v2-mount is incompatible with cgroupfs-mount"
	depends on !BR2_INIT_SYSTEMD
	depends on BR2_PACKAGE_CGROUPFS_MOUNT
```

## package/check/Config.in
```kconfig
config BR2_PACKAGE_CHECK
	bool "check"
	depends on !BR2_STATIC_LIBS
	help
	  Check is a unit testing framework for C.

	  https://libcheck.github.io/check/

comment "check needs a toolchain w/ dynamic library"
	depends on BR2_STATIC_LIBS
```

## package/checkpolicy/Config.in
```kconfig
config BR2_PACKAGE_CHECKPOLICY
	bool "checkpolicy"
	depends on BR2_TOOLCHAIN_HAS_THREADS # libselinux
	depends on !BR2_STATIC_LIBS # libselinux
	depends on BR2_TOOLCHAIN_GCC_AT_LEAST_5 # libselinux -> libsepol
	select BR2_PACKAGE_LIBSELINUX
	select BR2_PACKAGE_FLEX
	help
	  checkpolicy is the SELinux policy compiler. It uses libsepol
	  to generate the binary policy. checkpolicy uses the static
	  libsepol since it deals with low level details of the policy
	  that have not been encapsulated/abstracted by a proper
	  shared library interface.

	  http://selinuxproject.org/page/Main_Page

comment "checkpolicy needs a toolchain w/ threads, dynamic library, gcc >= 5"
	depends on !BR2_TOOLCHAIN_HAS_THREADS || BR2_STATIC_LIBS || \
		!BR2_TOOLCHAIN_GCC_AT_LEAST_5
```

## package/checkpolicy/Config.in.host
```kconfig
config BR2_PACKAGE_HOST_CHECKPOLICY
	bool "host checkpolicy"
	depends on BR2_HOST_GCC_AT_LEAST_5 # host-libselinux -> host-libsepol
	help
	  checkpolicy is the SELinux policy compiler. It uses libsepol
	  to generate the binary policy. checkpolicy uses the static
	  libsepol since it deals with low level details of the policy
	  that have not been encapsulated/abstracted by a proper
	  shared library interface.

	  http://selinuxproject.org/page/Main_Page

comment "host checkpolicy needs a toolchain w/ host gcc >= 5"
	depends on !BR2_HOST_GCC_AT_LEAST_5
```

## package/chicken/Config.in
```kconfig
config BR2_PACKAGE_CHICKEN
	bool "chicken"
	depends on BR2_USE_MMU
	help
	  CHICKEN is a compiler for the Scheme programming language.
	  This package contains the runtime, the interpreter, and
	  the (native for target) compiler.

	  https://call-cc.org
```

## package/chrony/Config.in
```kconfig
config BR2_PACKAGE_CHRONY
	bool "chrony"
	depends on BR2_USE_MMU # fork()
	depends on BR2_TOOLCHAIN_HAS_THREADS
	select BR2_PACKAGE_LIBCAP
	help
	  Chrony is a pair of programs which are used to maintain the
	  accuracy of the system clock.

	  https://chrony-project.org/

if BR2_PACKAGE_CHRONY

config BR2_PACKAGE_CHRONY_DEBUG_LOGGING
	bool "enable debug logging support"
	help
	  Enable support for debug logging output from Chrony when
	  enabled at runtime. If disabled, code for debug logging will
	  not be compiled in.

endif

comment "chrony needs a toolchain w/ threads"
	depends on BR2_USE_MMU
	depends on !BR2_TOOLCHAIN_HAS_THREADS
```

## package/cimplog/Config.in
```kconfig
config BR2_PACKAGE_CIMPLOG
    bool "cimplog"
    default n
    help
       Simple logging library

if BR2_PACKAGE_CIMPLOG
    config BR2_PACKAGE_CIMPLOG_SUPPORT_ONBOARD_LOGGING
    bool "cimplog enable logging"
    default n

    config BR2_PACKAGE_CIMPLOG_LEVEL_DEFAULT
    string "default log level Error(0), Info(1) and Debug(2)
    default "0"
endif
```

## package/civetweb/Config.in
```kconfig
config BR2_PACKAGE_CIVETWEB
	bool "civetweb"
	depends on BR2_TOOLCHAIN_HAS_THREADS
	depends on BR2_USE_MMU # fork()
	select BR2_PACKAGE_CIVETWEB_SERVER if !BR2_PACKAGE_CIVETWEB_LIB
	help
	  Full featured embedded web server with Lua support.

	  https://sourceforge.net/projects/civetweb

if BR2_PACKAGE_CIVETWEB

config BR2_PACKAGE_CIVETWEB_SERVER
	bool "enable the web server application"
	help
	  Include the web server and its config files.

config BR2_PACKAGE_CIVETWEB_LIB
	bool "enable library for embedding"
	help
	  Enable the civetweb library for embedding in another
	  application.

endif

comment "civetweb needs a toolchain w/ threads"
	depends on BR2_USE_MMU
	depends on !BR2_TOOLCHAIN_HAS_THREADS
```

## package/cjson/Config.in
```kconfig
config BR2_PACKAGE_CJSON
	bool "cJSON"
	help
	  An ultra-lightweight, portable, single-file, simple-as-can-be
	  ANSI-C compliant JSON parser, under MIT license.

	  https://github.com/DaveGamble/cJSON

if BR2_PACKAGE_CJSON

config BR2_PACKAGE_CJSON_UTILS
	bool "cJSON utils"
	help
	  Supplementary library with support for JSON Pointer
	  (RFC-6901), JSON Patch (RFC-6902), JSON Merge Patch
	  (RFC-7386), and more.

endif
```

## package/cjwt/Config.in
```kconfig
config BR2_PACKAGE_CJWT
    bool "cjwt"
    default n
    select BR2_PACKAGE_TROWER_BASE64
    select BR2_PACKAGE_OPENSSL
    help
       Recipe to build c library for processing jwt token
```

## package/cli11/Config.in
```kconfig
config BR2_PACKAGE_CLI11
	bool "cli11"
	depends on BR2_INSTALL_LIBSTDCPP
	depends on BR2_TOOLCHAIN_GCC_AT_LEAST_4_8 # C++11
	help
	  CLI11 is a command line parser for C++11 and beyond that
	  provides a rich feature set with a simple and intuitive
	  interface.

	  https://github.com/CLIUtils/CLI11

comment "cli11 needs a toolchain w/ C++, gcc >= 4.8"
	depends on !BR2_INSTALL_LIBSTDCPP || !BR2_TOOLCHAIN_GCC_AT_LEAST_4_8
```

## package/cloudflared/Config.in
```kconfig
config BR2_PACKAGE_CLOUDFLARED
	bool "cloudflared"
	depends on BR2_PACKAGE_HOST_GO_TARGET_ARCH_SUPPORTS
	select BR2_PACKAGE_HOST_GO
	help
	  Cloudflare Tunnel client (formerly Argo Tunnel).

	  https://github.com/cloudflare/cloudflared
```

## package/clpeak/Config.in
```kconfig
config BR2_PACKAGE_CLPEAK
	bool "clpeak"
	depends on BR2_PACKAGE_HAS_LIBOPENCL
	depends on BR2_INSTALL_LIBSTDCPP
	depends on BR2_TOOLCHAIN_GCC_AT_LEAST_4_8 # C++11
	select BR2_PACKAGE_OPENCL_CLHPP
	help
	  clpeak is a tool that profiles OpenCL devices
	  to find their peak capacities

	  https://github.com/krrishnarraj/clpeak

comment "clpeak needs an OpenCL provider, a toolchain w/ C++, gcc >= 4.8"
	depends on !BR2_PACKAGE_HAS_LIBOPENCL \
		|| !BR2_INSTALL_LIBSTDCPP || !BR2_TOOLCHAIN_GCC_AT_LEAST_4_8
```

## package/cmake/Config.in.host
```kconfig
config BR2_PACKAGE_HOST_CMAKE
	bool "host cmake"
	help
	  CMake is an open-source, cross-platform family of tools
	  designed to build, test and package software. CMake is used
	  to control the software compilation process using simple
	  platform and compiler independent configuration files, and
	  generate native makefiles and workspaces that can be used in
	  the compiler environment of your choice.

	  http://www.cmake.org/

# The minimum system cmake version we expect if 3.18 as provided by
# Debian bullseye, that we use in our reference build docker image.
config BR2_HOST_CMAKE_AT_LEAST_3_19
	bool

config BR2_HOST_CMAKE_AT_LEAST_3_20
	bool
	select BR2_HOST_CMAKE_AT_LEAST_3_19

config BR2_HOST_CMAKE_AT_LEAST_3_21
	bool
	select BR2_HOST_CMAKE_AT_LEAST_3_20

config BR2_HOST_CMAKE_AT_LEAST_3_22
	bool
	select BR2_HOST_CMAKE_AT_LEAST_3_21

config BR2_HOST_CMAKE_AT_LEAST_3_23
	bool
	select BR2_HOST_CMAKE_AT_LEAST_3_22

config BR2_HOST_CMAKE_AT_LEAST_3_24
	bool
	select BR2_HOST_CMAKE_AT_LEAST_3_23

config BR2_HOST_CMAKE_AT_LEAST_3_25
	bool
	select BR2_HOST_CMAKE_AT_LEAST_3_24

config BR2_HOST_CMAKE_AT_LEAST_3_26
	bool
	select BR2_HOST_CMAKE_AT_LEAST_3_25

config BR2_HOST_CMAKE_AT_LEAST_3_27
	bool
	select BR2_HOST_CMAKE_AT_LEAST_3_26

config BR2_HOST_CMAKE_AT_LEAST_3_28
	bool
	select BR2_HOST_CMAKE_AT_LEAST_3_27

config BR2_HOST_CMAKE_AT_LEAST_3_29
	bool
	select BR2_HOST_CMAKE_AT_LEAST_3_28

config BR2_HOST_CMAKE_AT_LEAST_3_30
	bool
	select BR2_HOST_CMAKE_AT_LEAST_3_29

config BR2_HOST_CMAKE_AT_LEAST_3_31
	bool
	select BR2_HOST_CMAKE_AT_LEAST_3_30

# This order guarantees that the highest version is set, as kconfig
# stops affecting a value on the first matching default.
config BR2_HOST_CMAKE_AT_LEAST
	string
	default "3.31"	if BR2_HOST_CMAKE_AT_LEAST_3_31
	default "3.30"	if BR2_HOST_CMAKE_AT_LEAST_3_30
	default "3.29"	if BR2_HOST_CMAKE_AT_LEAST_3_29
	default "3.28"	if BR2_HOST_CMAKE_AT_LEAST_3_28
	default "3.27"	if BR2_HOST_CMAKE_AT_LEAST_3_27
	default "3.26"	if BR2_HOST_CMAKE_AT_LEAST_3_26
	default "3.25"	if BR2_HOST_CMAKE_AT_LEAST_3_25
	default "3.24"	if BR2_HOST_CMAKE_AT_LEAST_3_24
	default "3.23"	if BR2_HOST_CMAKE_AT_LEAST_3_23
	default "3.22"	if BR2_HOST_CMAKE_AT_LEAST_3_22
	default "3.21"	if BR2_HOST_CMAKE_AT_LEAST_3_21
	default "3.20"	if BR2_HOST_CMAKE_AT_LEAST_3_20
	default "3.19"	if BR2_HOST_CMAKE_AT_LEAST_3_19
	default "3.18"
```

## package/cni-plugins/Config.in
```kconfig
config BR2_PACKAGE_CNI_PLUGINS
	bool "cni-plugins"
	depends on BR2_PACKAGE_HOST_GO_TARGET_ARCH_SUPPORTS
	depends on BR2_PACKAGE_HOST_GO_TARGET_CGO_LINKING_SUPPORTS
	depends on BR2_TOOLCHAIN_HAS_THREADS
	depends on !BR2_TOOLCHAIN_USES_UCLIBC # no fexecve
	depends on BR2_USE_MMU
	help
	  Container Networking Interface plugins.

	  https://github.com/containernetworking/plugins

comment "cni-plugins needs a glibc or musl toolchain w/ threads"
	depends on BR2_PACKAGE_HOST_GO_TARGET_ARCH_SUPPORTS && \
		BR2_PACKAGE_HOST_GO_TARGET_CGO_LINKING_SUPPORTS
	depends on !BR2_TOOLCHAIN_HAS_THREADS || BR2_TOOLCHAIN_USES_UCLIBC
```

## package/cobalt/Config.in
```kconfig
config BR2_PACKAGE_COBALT
    bool "cobalt"
        select BR2_PACKAGE_WPEFRAMEWORK_COMPOSITORCLIENT
        select BR2_PACKAGE_GST1_PLUGINS_BAD
        select BR2_PACKAGE_GST1_PLUGINS_GOOD
	select BR2_PACKAGE_GST1_BCM if BR2_PACKAGE_HAS_NEXUS

if BR2_PACKAGE_COBALT

config BR2_PACKAGE_COBALT_IMAGE_AS_LIB
    bool "Create cobalt as .so"
    default y
    help
       This option allows to create cobalt.so,
       default is cobalt bin

choice BR2_PACKAGE_COBALT_BUILD_TYPE
    prompt "Build type"
    default BR2_PACKAGE_COBALT_BUILD_TYPE_GOLD
    help
        Select the type of build.

config BR2_PACKAGE_COBALT_BUILD_TYPE_QA
    bool "Debug(QA)"
    help
        Debug (QA) build type.

config BR2_PACKAGE_COBALT_BUILD_TYPE_GOLD
    bool "Production(Gold)"
    help
        Production (Gold) build type.
endchoice

endif
```

## package/compiler-rt/Config.in
```kconfig
config BR2_PACKAGE_COMPILER_RT
	bool "compiler-rt"
	depends on BR2_PACKAGE_LLVM
	depends on BR2_TOOLCHAIN_USES_GLIBC # asan lib requires
	help
	  A collection of runtime libraries primarily used by clang and
	  llvm to provide builtins, sanitizer runtimes, and profiling
	  at runtime.

	  https://compiler-rt.llvm.org/

comment "compiler-rt requires llvm to be enabled and a glibc toolchain"
	depends on !BR2_PACKAGE_LLVM
	depends on !BR2_TOOLCHAIN_USES_GLIBC
```

## package/composer/Config.in.host
```kconfig
config BR2_PACKAGE_HOST_COMPOSER
	bool "host composer"
	help
	  Composer is a tool for dependency management in PHP. It
	  allows you to declare the libraries your project depends on
	  and it will manage (install/update) them for you.

	  https://getcomposer.org/
```

## package/containerd/Config.in
```kconfig
config BR2_PACKAGE_CONTAINERD
	bool "containerd"
	depends on BR2_PACKAGE_HOST_GO_TARGET_ARCH_SUPPORTS
	depends on BR2_PACKAGE_HOST_GO_TARGET_CGO_LINKING_SUPPORTS
	depends on BR2_TOOLCHAIN_HAS_THREADS
	depends on !BR2_TOOLCHAIN_USES_UCLIBC # runc
	depends on BR2_USE_MMU # util-linux
	select BR2_PACKAGE_HOST_GO
	select BR2_PACKAGE_RUNC if !BR2_PACKAGE_CRUN # runtime dependency
	select BR2_PACKAGE_UTIL_LINUX # runtime dependency
	select BR2_PACKAGE_UTIL_LINUX_BINARIES
	select BR2_PACKAGE_UTIL_LINUX_PIVOT_ROOT
	select BR2_PACKAGE_UTIL_LINUX_MOUNTPOINT
	select BR2_PACKAGE_UTIL_LINUX_MOUNT
	help
	  containerd is a daemon to control runC.

	  https://containerd.io/

if BR2_PACKAGE_CONTAINERD

config BR2_PACKAGE_CONTAINERD_DRIVER_BTRFS
	bool "btrfs snapshot driver"
	depends on BR2_TOOLCHAIN_HEADERS_AT_LEAST_4_12
	help
	  Build the btrfs snapshot driver for containerd.

comment "brtfs snapshot driver needs headers >= 4.12"
	depends on !BR2_TOOLCHAIN_HEADERS_AT_LEAST_4_12

config BR2_PACKAGE_CONTAINERD_DRIVER_DEVMAPPER
	bool "devmapper snapshot driver"
	depends on BR2_TOOLCHAIN_HAS_THREADS # lvm2
	depends on BR2_USE_MMU # lvm2
	depends on !BR2_STATIC_LIBS # lvm2
	select BR2_PACKAGE_LVM2
	help
	  Build the devmapper snapshot driver for containerd.

comment "devmapper snapshot driver needs a toolchain w/ threads, dynamic library"
	depends on BR2_USE_MMU
	depends on BR2_STATIC_LIBS || !BR2_TOOLCHAIN_HAS_THREADS

config BR2_PACKAGE_CONTAINERD_DRIVER_ZFS
	bool "zfs snapshot driver"
	depends on BR2_LINUX_KERNEL # zfs
	depends on BR2_PACKAGE_HAS_UDEV # zfs
	depends on BR2_USE_MMU  # zfs
	depends on BR2_TOOLCHAIN_HAS_THREADS  # zfs
	select BR2_PACKAGE_ZFS
	help
	  Build the zfs snapshot driver for containerd.

comment "zfs snapshot driver needs a Linux kernel, udev, toolchain w/ threads"
	depends on BR2_USE_MMU
	depends on !BR2_LINUX_KERNEL || !BR2_PACKAGE_HAS_UDEV || \
		!BR2_TOOLCHAIN_HAS_THREADS

config BR2_PACKAGE_CONTAINERD_CRI
	bool "Kubernetes CRI support"
	help
	  Build containerd with Kubernetes CRI support.

endif

comment "containerd needs a glibc or musl toolchain w/ threads"
	depends on BR2_PACKAGE_HOST_GO_TARGET_ARCH_SUPPORTS
	depends on BR2_PACKAGE_HOST_GO_TARGET_CGO_LINKING_SUPPORTS
	depends on BR2_USE_MMU
	depends on !BR2_TOOLCHAIN_HAS_THREADS || BR2_TOOLCHAIN_USES_UCLIBC
```

## package/containers-image-config/Config.in
```kconfig
config BR2_PACKAGE_CONTAINERS_IMAGE_CONFIG
	bool "containers-image-config"
	help
	  Install default, minimalist configuration files used by the
	  various tools dealing with containers images, like podman,
	  skopeo...

	  https://github.com/containers/image
```

## package/coremark-pro/Config.in
```kconfig
config BR2_PACKAGE_COREMARK_PRO
	bool "coremark-pro"
	depends on BR2_USE_MMU # perl uses fork()
	depends on BR2_TOOLCHAIN_HAS_THREADS
	select BR2_PACKAGE_PERL
	help
	  CoreMark-PRO is a comprehensive, advanced processor benchmark.

	  https://www.eembc.org/coremark-pro/

comment "coremark-pro needs a toolchain w/ threads"
	depends on BR2_USE_MMU
	depends on !BR2_TOOLCHAIN_HAS_THREADS
```

## package/cpp-httplib/Config.in
```kconfig
comment "cpp-httplib needs a toolchain w/ C++, wchar, threads"
	depends on !BR2_INSTALL_LIBSTDCPP || !BR2_USE_WCHAR || !BR2_TOOLCHAIN_HAS_THREADS

config BR2_PACKAGE_CPP_HTTPLIB
	bool "cpp-httplib"
	depends on BR2_INSTALL_LIBSTDCPP
	depends on BR2_TOOLCHAIN_HAS_THREADS
	depends on BR2_USE_WCHAR
	help
	  A C++ header-only HTTP/HTTPS server and client library.

	  https://github.com/yhirose/cpp-httplib

if BR2_PACKAGE_CPP_HTTPLIB
config BR2_PACKAGE_CPP_HTTPLIB_COMPILE
	bool "compile as a shared library"
	select BR2_PACKAGE_HOST_PYTHON3
	help
	  Build as library

endif # BR2_PACKAGE_CPP_HTTPLIB
```
